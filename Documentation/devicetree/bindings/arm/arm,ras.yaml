## Documentation/devicetree/bindings/phy/qcom,x1e80100-csi2-phy.yaml
```yaml
# SPDX-License-Identifier: (GPL-2.0 OR BSD-2-Clause)
%YAML 1.2
---
$id: http://devicetree.org/schemas/phy/qcom,x1e80100-csi2-phy.yaml#
$schema: http://devicetree.org/meta-schemas/core.yaml#

title: Qualcomm SoC CSI2 PHY

maintainers:
  - Bryan O'Donoghue <bod@kernel.org>

description:
  Qualcomm MIPI CSI2 C-PHY/D-PHY combination PHY. Connects MIPI CSI2 sensors
  to Qualcomm's Camera CSI Decoder. The PHY supports both C-PHY and D-PHY
  modes.

properties:
  compatible:
    const: qcom,x1e80100-csi2-phy

  reg:
    maxItems: 1

  "#phy-cells":
    const: 1
    description:
      The single cell specifies the PHY operating mode.

  clocks:
    maxItems: 3

  clock-names:
    items:
      - const: core
      - const: timer
      - const: ahb

  interrupts:
    maxItems: 1

  operating-points-v2: true

  power-domains:
    items:
      - description: Titan Top GDSC - Titan ISP Block, Global Distributed Switch Controller.
      - description: MMCX voltage rail
      - description: MXC or MXA voltage rail

  power-domain-names:
    items:
      - const: top
      - const: mmcx
      - const: mx

  vdda-0p8-supply:
    description: Phandle to a 0.8V regulator supply to a PHY.

  vdda-1p2-supply:
    description: Phandle to 1.2V regulator supply to a PHY.

  ports:
    $ref: /schemas/graph.yaml#/properties/ports

    properties:
      port@0:
        $ref: /schemas/graph.yaml#/$defs/port-base
        description:
          Sensor input. Always present. A single sensor is described by a
          single endpoint with one to four data lanes. DPHY split mode,
          where two independent sensors share the same PHY, is described
          by two endpoints; endpoint@0 with exactly two-data lanes and
          endpoint@1 with exactly one data-lane.
        unevaluatedProperties: false

        patternProperties:
          "^endpoint(@[0-9a-f]+)?$":
            $ref: /schemas/media/video-interfaces.yaml#
            unevaluatedProperties: false
            properties:
              data-lanes:
                minItems: 1
                maxItems: 4
              remote-endpoint: true
            required:
              - data-lanes
              - remote-endpoint

        allOf:
          - if:
              required:
                - endpoint@1
            then:
              properties:
                endpoint@0:
                  properties:
                    data-lanes:
                      minItems: 2
                      maxItems: 2
                endpoint@1:
                  properties:
                    data-lanes:
                      maxItems: 1
              required:
                - endpoint@0

      port@1:
        $ref: /schemas/graph.yaml#/$defs/port-base
        description: Output to the CAMSS CSID controller.
        unevaluatedProperties: false

        patternProperties:
          "^endpoint(@[0-9a-f]+)?$":
            $ref: /schemas/graph.yaml#/$defs/endpoint-base
            unevaluatedProperties: false
            properties:
              remote-endpoint: true
            required:
              - remote-endpoint

    required:
      - port@0
      - port@1

required:
  - compatible
  - reg
  - "#phy-cells"
  - clocks
  - clock-names
  - interrupts
  - operating-points-v2
  - power-domains
  - power-domain-names
  - vdda-0p8-supply
  - vdda-1p2-supply
  - ports

additionalProperties: false

examples:
  - |
    #include <dt-bindings/interrupt-controller/arm-gic.h>
    #include <dt-bindings/clock/qcom,x1e80100-camcc.h>
    #include <dt-bindings/clock/qcom,x1e80100-gcc.h>
    #include <dt-bindings/power/qcom,rpmhpd.h>

    phy@ace4000 {
        compatible = "qcom,x1e80100-csi2-phy";
        reg = <0x0ace4000 0x2000>;
        #phy-cells = <1>;

        clocks = <&camcc CAM_CC_CSIPHY0_CLK>,
                 <&camcc CAM_CC_CSI0PHYTIMER_CLK>,
                 <&camcc CAM_CC_CORE_AHB_CLK>;
        clock-names = "core",
                      "timer",
                      "ahb";

        interrupts = <GIC_SPI 477 IRQ_TYPE_EDGE_RISING>;

        operating-points-v2 = <&csiphy_opp_table>;

        power-domains = <&camcc CAM_CC_TITAN_TOP_GDSC>,
                        <&rpmhpd RPMHPD_MMCX>,
                        <&rpmhpd RPMHPD_MX>;
        power-domain-names = "top",
                             "mmcx",
                             "mx";

        vdda-0p8-supply = <&vreg_l2c_0p8>;
        vdda-1p2-supply = <&vreg_l1c_1p2>;

        ports {
            #address-cells = <1>;
            #size-cells = <0>;

            port@0 {
                reg = <0>;
                csiphy0_in: endpoint {
                    data-lanes = <0 1 2 3>;
                    remote-endpoint = <&sensor_out>;
                };
            };

            port@1 {
                reg = <1>;
                csiphy0_out: endpoint {
                    remote-endpoint = <&csid_in>;
                };
            };
        };
    };

    csiphy_opp_table: opp-table {
        compatible = "operating-points-v2";

        opp-300000000 {
            opp-hz = /bits/ 64 <300000000>;
            required-opps = <&rpmhpd_opp_low_svs_d1>,
                            <&rpmhpd_opp_low_svs_d1>;
        };
    };
```

## Documentation/devicetree/bindings/pinctrl/qcom,qcs615-lpass-lpi-pinctrl.yaml
```yaml
# SPDX-License-Identifier: (GPL-2.0-only OR BSD-2-Clause)
%YAML 1.2
---
$id: http://devicetree.org/schemas/pinctrl/qcom,qcs615-lpass-lpi-pinctrl.yaml#
$schema: http://devicetree.org/meta-schemas/core.yaml#

title: Qualcomm QCS615 SoC LPASS LPI TLMM

maintainers:
  - Karthik S <karthik.s@oss.qualcomm.com>

description:
  Top Level Mode Multiplexer pin controller in the Low Power Audio SubSystem
  (LPASS) Low Power Island (LPI) of Qualcomm QCS615 SoC.

properties:
  compatible:
    const: qcom,qcs615-lpass-lpi-pinctrl

  reg:
    items:
      - description: LPASS LPI TLMM Control and Status registers
      - description: LPASS LPI MCC registers

  clocks:
    items:
      - description: LPASS Core voting clock

  clock-names:
    items:
      - const: core

patternProperties:
  "-state$":
    oneOf:
      - $ref: "#/$defs/qcom-qcs615-lpass-state"
      - patternProperties:
          "-pins$":
            $ref: "#/$defs/qcom-qcs615-lpass-state"
        additionalProperties: false

$defs:
  qcom-qcs615-lpass-state:
    type: object
    description:
      Pinctrl node's client devices use subnodes for desired pin configuration.
      Client device subnodes use below standard properties.
    $ref: qcom,lpass-lpi-common.yaml#/$defs/qcom-tlmm-state
    unevaluatedProperties: false

    properties:
      pins:
        description:
          List of gpio pins affected by the properties specified in this
          subnode.
        items:
          pattern: "^gpio([0-9]|1[0-9]|2[0-9]|3[0-1])$"

      function:
        enum: [ dmic1_clk, dmic1_data, dmic2_clk, dmic2_data, gpio, i2s1_clk,
                i2s1_data, i2s1_ws, spkr_i2s_mclk_a ]
        description:
          Specify the alternative function to be configured for the specified
          pins.

allOf:
  - $ref: qcom,lpass-lpi-common.yaml#

required:
  - compatible
  - reg
  - clocks
  - clock-names

unevaluatedProperties: false

examples:
  - |
    #include <dt-bindings/sound/qcom,q6afe.h>
    lpi_tlmm: pinctrl@62b40000 {
        compatible = "qcom,qcs615-lpass-lpi-pinctrl";
        reg = <0x62b40000 0x20000>,
              <0x62b00000 0x10000>;
        clocks = <&q6afecc LPASS_HW_MACRO_VOTE LPASS_CLK_ATTRIBUTE_COUPLE_NO>;
        clock-names = "core";
        gpio-controller;
        #gpio-cells = <2>;
        gpio-ranges = <&lpi_tlmm 0 0 32>;

        i2s1-active-state {
            clk-pins {
                pins = "gpio8";
                function = "i2s1_clk";
                drive-strength = <8>;
                bias-disable;
                output-high;
            };

            ws-pins {
                pins = "gpio9";
                function = "i2s1_ws";
                drive-strength = <8>;
                bias-disable;
                output-high;
            };

            data-pins {
                pins = "gpio10", "gpio11";
                function = "i2s1_data";
                drive-strength = <8>;
                bias-disable;
            };
        };
    };
```

## Documentation/devicetree/bindings/sound/qcom,q6apm-dai.yaml
```yaml
# SPDX-License-Identifier: (GPL-2.0 OR BSD-2-Clause)
%YAML 1.2
---
$id: http://devicetree.org/schemas/sound/qcom,q6apm-dai.yaml#
$schema: http://devicetree.org/meta-schemas/core.yaml#

title: Qualcomm Audio Process Manager Digital Audio Interfaces

maintainers:
  - Srinivas Kandagatla <srinivas.kandagatla@linaro.org>

description: |
  This binding describes the Qualcomm APM DAIs in DSP.

  The DSP that runs the APM must be able to reach the PCM buffers. On
  existing targets the DSP runs in a stage-1 context and the buffers are
  described to the SMMU via iommus. On targets whose APM DSP runs in a
  stage-2 protected context that cannot use the SMMU, the buffers are
  reachable only after hypervisor (SCM) memory assignment to the fixed
  set of consumer VMIDs that own that protected context, described by
  qcom,vmids. The two access models are mutually exclusive.

properties:
  compatible:
    const: qcom,q6apm-dais

  iommus:
    minItems: 1
    maxItems: 2

  memory-region:
    description:
      Reserved-memory carveouts (shared-dma-pool, no-map) that hold the
      PCM buffers and must be SCM-assigned to the VMIDs in qcom,vmids.
      The first entry is the control-path buffer; the second entry is
      the data-path buffer. Only used together with qcom,vmids.
    minItems: 1
    maxItems: 2

  qcom,vmids:
    description:
      Virtual Machine IDs (VMIDs) of the processors that consume the PCM
      buffers and therefore must be granted access through SCM memory
      assignment. Required on targets whose APM DSP runs in a stage-2
      protected context and cannot use the SMMU; mutually exclusive with
      iommus. SCM assignment replaces the buffer's current owners with the
      supplied set, so the driver always adds HLOS to the destination list
      itself to retain host access; HLOS must not be listed here. All
      listed VMIDs and HLOS receive read-write access.
    $ref: /schemas/types.yaml#/definitions/uint32-array
    minItems: 1
    maxItems: 2
    uniqueItems: true

required:
  - compatible

oneOf:
  - required:
      - iommus
  - required:
      - qcom,vmids

dependentRequired:
  memory-region:
    - qcom,vmids

additionalProperties: false

examples:
  - |
    dais {
        compatible = "qcom,q6apm-dais";
        iommus = <&apps_smmu 0x1801 0x0>;
    };
  - |
    #include <dt-bindings/firmware/qcom,scm.h>

    reserved-memory {
        #address-cells = <2>;
        #size-cells = <2>;
        ranges;

        audio_heap_mem: audio-heap@a1000000 {
            compatible = "shared-dma-pool";
            reg = <0x0 0xa1000000 0x0 0x100000>;
            no-map;
        };

        audio_mdsp_carveout_mem: audio-carveout@a1100000 {
            compatible = "shared-dma-pool";
            reg = <0x0 0xa1100000 0x0 0x400000>;
            no-map;
        };
    };

    dais {
        compatible = "qcom,q6apm-dais";
        /* index 0: control path, index 1: data path */
        memory-region = <&audio_heap_mem>, <&audio_mdsp_carveout_mem>;
        qcom,vmids = <QCOM_SCM_VMID_LPASS QCOM_SCM_VMID_MSS_MSA>;
    };
```
