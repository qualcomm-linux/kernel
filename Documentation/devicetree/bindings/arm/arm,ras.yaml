## Documentation/devicetree/bindings/media/qcom,hawi-camss.yaml
```yaml
# SPDX-License-Identifier: (GPL-2.0 OR BSD-2-Clause)
%YAML 1.2
---
$id: http://devicetree.org/schemas/media/qcom,hawi-camss.yaml#
$schema: http://devicetree.org/meta-schemas/core.yaml#

title: Qualcomm Hawi and Maili Camera Subsystem (CAMSS)

maintainers:
  - Hangxiang Ma <hangxiang.ma@oss.qualcomm.com>
  - Nihal Kumar Gupta <nihal.gupta@oss.qualcomm.com>

description:
  The CAMSS IP is a CSI decoder and ISP present on Qualcomm platforms.

properties:
  compatible:
    oneOf:
      - const: qcom,hawi-camss
      - items:
          - const: qcom,maili-camss
          - const: qcom,hawi-camss

  reg:
    maxItems: 13

  reg-names:
    items:
      - const: csid0
      - const: csid1
      - const: csid2
      - const: csid_lite0
      - const: csid_lite1
      - const: csitpg0
      - const: csitpg1
      - const: csitpg2
      - const: vfe0
      - const: vfe1
      - const: vfe2
      - const: vfe_lite0
      - const: vfe_lite1

  clocks:
    maxItems: 26

  clock-names:
    items:
      - const: camnoc_nrt_axi
      - const: camnoc_rt_axi
      - const: camnoc_dcd_xo
      - const: cpas_ahb
      - const: cpas_fast_ahb
      - const: cpas_mnoc_hf
      - const: cpas_mnoc_sf
      - const: cpas_vfe0
      - const: cpas_vfe1
      - const: cpas_vfe2
      - const: cpas_vfe_lite
      - const: csid
      - const: csid_csiphy_rx
      - const: gcc_axi_hf
      - const: gcc_axi_sf
      - const: vfe0
      - const: vfe0_fast_ahb
      - const: vfe1
      - const: vfe1_fast_ahb
      - const: vfe2
      - const: vfe2_fast_ahb
      - const: vfe_lite
      - const: vfe_lite_ahb
      - const: vfe_lite_cphy_rx
      - const: vfe_lite_csid
      - const: qdss_debug_xo

  interrupts:
    maxItems: 10

  interrupt-names:
    items:
      - const: csid0
      - const: csid1
      - const: csid2
      - const: csid_lite0
      - const: csid_lite1
      - const: vfe0
      - const: vfe1
      - const: vfe2
      - const: vfe_lite0
      - const: vfe_lite1

  interconnects:
    maxItems: 2

  interconnect-names:
    items:
      - const: ahb
      - const: hf_mnoc

  iommus:
    maxItems: 1

  power-domains:
    items:
      - description: IFE0 GDSC - Global Distributed Switch Controller for IFE0.
      - description: IFE1 GDSC - Global Distributed Switch Controller for IFE1.
      - description: IFE2 GDSC - Global Distributed Switch Controller for IFE2.
      - description: Titan GDSC - Global Distributed Switch Controller for the entire camss.

  power-domain-names:
    items:
      - const: ife0
      - const: ife1
      - const: ife2
      - const: top

  ports:
    $ref: /schemas/graph.yaml#/properties/ports

    description:
      CSI input ports.

    patternProperties:
      "^port@[0-5]$":
        $ref: /schemas/graph.yaml#/$defs/port-base
        unevaluatedProperties: false
        description:
          Input ports for receiving CSI data on CSIPHY 0-5.

        properties:
          endpoint:
            $ref: video-interfaces.yaml#
            unevaluatedProperties: false

            properties:
              data-lanes:
                minItems: 1
                maxItems: 4

              bus-type:
                enum:
                  - 1 # MEDIA_BUS_TYPE_CSI2_CPHY
                  - 4 # MEDIA_BUS_TYPE_CSI2_DPHY

required:
  - compatible
  - reg
  - reg-names
  - clocks
  - clock-names
  - interrupts
  - interrupt-names
  - interconnects
  - interconnect-names
  - iommus
  - power-domains
  - power-domain-names
  - ports

additionalProperties: false

examples:
  - |
    #include <dt-bindings/clock/qcom,hawi-gcc.h>
    #include <dt-bindings/clock/qcom,hawi-camcc.h>
    #include <dt-bindings/interconnect/qcom,icc.h>
    #include <dt-bindings/interconnect/qcom,hawi-rpmh.h>
    #include <dt-bindings/interrupt-controller/arm-gic.h>
    #include <dt-bindings/power/qcom,rpmhpd.h>

    soc {
        #address-cells = <2>;
        #size-cells = <2>;

        isp@9253000 {
            compatible = "qcom,hawi-camss";

            reg = <0x0 0x09253000 0x0 0x5e80>,
                  <0x0 0x09263000 0x0 0x5e80>,
                  <0x0 0x09273000 0x0 0x5e80>,
                  <0x0 0x092d3000 0x0 0x3880>,
                  <0x0 0x092e7000 0x0 0x3880>,
                  <0x0 0x093fd000 0x0 0x400>,
                  <0x0 0x093fe000 0x0 0x400>,
                  <0x0 0x093ff000 0x0 0x400>,
                  <0x0 0x09151000 0x0 0x20000>,
                  <0x0 0x09171000 0x0 0x20000>,
                  <0x0 0x09191000 0x0 0x20000>,
                  <0x0 0x092dc000 0x0 0x6800>,
                  <0x0 0x092f0000 0x0 0x6800>;
            reg-names = "csid0",
                        "csid1",
                        "csid2",
                        "csid_lite0",
                        "csid_lite1",
                        "csitpg0",
                        "csitpg1",
                        "csitpg2",
                        "vfe0",
                        "vfe1",
                        "vfe2",
                        "vfe_lite0",
                        "vfe_lite1";

            clocks = <&camcc CAM_CC_CAMNOC_NRT_AXI_CLK>,
                     <&camcc CAM_CC_CAMNOC_RT_AXI_CLK>,
                     <&camcc CAM_CC_CAMNOC_DCD_XO_CLK>,
                     <&camcc CAM_CC_CAM_TOP_AHB_CLK>,
                     <&camcc CAM_CC_CAM_TOP_FAST_AHB_CLK>,
                     <&camcc CAM_CC_TITAN_MNOC_HF_CLK>,
                     <&camcc CAM_CC_TITAN_MNOC_SF_CLK>,
                     <&camcc CAM_CC_CAMNOC_RT_TFE_0_MAIN_CLK>,
                     <&camcc CAM_CC_CAMNOC_RT_TFE_1_MAIN_CLK>,
                     <&camcc CAM_CC_CAMNOC_RT_TFE_2_MAIN_CLK>,
                     <&camcc CAM_CC_CAMNOC_RT_IFE_LITE_CLK>,
                     <&camcc CAM_CC_CSID_CLK>,
                     <&camcc CAM_CC_CSID_CSIPHY_RX_CLK>,
                     <&gcc GCC_CAMERA_HF_AXI_CLK>,
                     <&gcc GCC_CAMERA_SF_AXI_CLK>,
                     <&camcc CAM_CC_TFE_0_MAIN_CLK>,
                     <&camcc CAM_CC_TFE_0_MAIN_FAST_AHB_CLK>,
                     <&camcc CAM_CC_TFE_1_MAIN_CLK>,
                     <&camcc CAM_CC_TFE_1_MAIN_FAST_AHB_CLK>,
                     <&camcc CAM_CC_TFE_2_MAIN_CLK>,
                     <&camcc CAM_CC_TFE_2_MAIN_FAST_AHB_CLK>,
                     <&camcc CAM_CC_IFE_LITE_CLK>,
                     <&camcc CAM_CC_IFE_LITE_AHB_CLK>,
                     <&camcc CAM_CC_IFE_LITE_CPHY_RX_CLK>,
                     <&camcc CAM_CC_IFE_LITE_CSID_CLK>,
                     <&camcc CAM_CC_QDSS_DEBUG_XO_CLK>;
            clock-names = "camnoc_nrt_axi",
                          "camnoc_rt_axi",
                          "camnoc_dcd_xo",
                          "cpas_ahb",
                          "cpas_fast_ahb",
                          "cpas_mnoc_hf",
                          "cpas_mnoc_sf",
                          "cpas_vfe0",
                          "cpas_vfe1",
                          "cpas_vfe2",
                          "cpas_vfe_lite",
                          "csid",
                          "csid_csiphy_rx",
                          "gcc_axi_hf",
                          "gcc_axi_sf",
                          "vfe0",
                          "vfe0_fast_ahb",
                          "vfe1",
                          "vfe1_fast_ahb",
                          "vfe2",
                          "vfe2_fast_ahb",
                          "vfe_lite",
                          "vfe_lite_ahb",
                          "vfe_lite_cphy_rx",
                          "vfe_lite_csid",
                          "qdss_debug_xo";

            interrupts = <GIC_SPI 601 IRQ_TYPE_EDGE_RISING>,
                         <GIC_SPI 603 IRQ_TYPE_EDGE_RISING>,
                         <GIC_SPI 431 IRQ_TYPE_EDGE_RISING>,
                         <GIC_SPI 605 IRQ_TYPE_EDGE_RISING>,
                         <GIC_SPI 376 IRQ_TYPE_EDGE_RISING>,
                         <GIC_SPI 433 IRQ_TYPE_EDGE_RISING>,
                         <GIC_SPI 436 IRQ_TYPE_EDGE_RISING>,
                         <GIC_SPI 457 IRQ_TYPE_EDGE_RISING>,
                         <GIC_SPI 606 IRQ_TYPE_EDGE_RISING>,
                         <GIC_SPI 377 IRQ_TYPE_EDGE_RISING>;
            interrupt-names = "csid0",
                              "csid1",
                              "csid2",
                              "csid_lite0",
                              "csid_lite1",
                              "vfe0",
                              "vfe1",
                              "vfe2",
                              "vfe_lite0",
                              "vfe_lite1";

            interconnects = <&gem_noc MASTER_APPSS_PROC QCOM_ICC_TAG_ACTIVE_ONLY
                             &config_noc SLAVE_CAMERA_CFG QCOM_ICC_TAG_ACTIVE_ONLY>,
                            <&mmss_noc MASTER_CAMNOC_HF QCOM_ICC_TAG_ALWAYS
                             &mc_virt SLAVE_EBI1 QCOM_ICC_TAG_ALWAYS>;
            interconnect-names = "ahb",
                                 "hf_mnoc";

            iommus = <&apps_smmu 0x1800 0x00>;

            power-domains = <&camcc CAM_CC_TFE_0_GDSC>,
                            <&camcc CAM_CC_TFE_1_GDSC>,
                            <&camcc CAM_CC_TFE_2_GDSC>,
                            <&camcc CAM_CC_TITAN_TOP_GDSC>;
            power-domain-names = "ife0",
                                 "ife1",
                                 "ife2",
                                 "top";

            ports {
                #address-cells = <1>;
                #size-cells = <0>;

                port@0 {
                    reg = <0>;

                    camss_csiphy0_ep: endpoint {
                        data-lanes = <1 2 3 4>;
                        remote-endpoint = <&csiphy0_out>;
                    };
                };
            };
        };
    };
```
