## Documentation/devicetree/bindings/arm/arm,ras.yaml
```yaml
# SPDX-License-Identifier: (GPL-2.0-only OR BSD-2-Clause)
%YAML 1.2
---
$id: http://devicetree.org/schemas/arm/arm,ras.yaml#
$schema: http://devicetree.org/meta-schemas/core.yaml#

title: ARM RAS error source

maintainers:
  - Umang Chheda <umang.chheda@oss.qualcomm.com>

description: |
  ARMv8 and later processors implement the Reliability, Availability and
  Serviceability (RAS) extensions.  Hardware blocks that support RAS expose
  one or more error records through a standardised register interface.  Each
  error record captures information about a detected hardware error (cache
  ECC fault, TLB parity error, interconnect error, etc.) and can optionally
  signal the OS via an interrupt.

  Each DT node described by this binding represents one RAS error source —
  a hardware block that exposes a set of error records.  Error records are
  accessed either through system registers (for processor-local resources
  such as L1/L2 caches and TLBs) or through a memory-mapped register window
  (for shared or off-core resources such as L3 caches, SMMUs and GICs).

properties:
  compatible:
    description:
      Identifies the class of hardware block this error source belongs to.
      arm,ras-processor covers processor error sources (cache, TLB, etc.).
      arm,ras-smmu covers SMMU error sources.
      arm,ras-gic covers GIC error sources.
    enum:
      - arm,ras-processor
      - arm,ras-smmu
      - arm,ras-gic

  reg:
    description:
      Register windows for this error source.  When absent the error records
      are accessed through system registers (ERRSELR_EL1 + ERX*_EL1).
      When present, each range must have a corresponding entry in reg-names.
      The primary error-record window is named "err-records"; additional
      optional windows are named "err-group", "fault-inject", and "irq-config".
    minItems: 1
    maxItems: 4

  reg-names:
    description:
      Names for the register windows listed in reg. The first entry must be
      "err-records" for the primary error-record window.
      err-group is the error group status register window (ERRGSR).
      fault-inject is the fault injection register window (ERXPFG*).
      irq-config is the interrupt routing configuration window.
    minItems: 1
    maxItems: 4
    items:
      enum:
        - err-records
        - err-group
        - fault-inject
        - irq-config

  interrupts:
    minItems: 1
    items:
      - description:
          Fault Handling Interrupt (FHI), fired when a corrected error
          counter overflows or a deferred error is detected.
      - description:
          Error Recovery Interrupt (ERI), fired when an uncorrected
          recoverable error is detected.

  interrupt-names:
    minItems: 1
    items:
      - const: fhi
      - const: eri

  arm,group-format:
    $ref: /schemas/types.yaml#/definitions/uint32
    description:
      Layout of the memory-mapped error-record group window.
      Determines the number of ERRGSR registers available.
      A 4 KiB group provides 1 ERRGSR, a 16 KiB group provides
      4 ERRGSRs, and a 64 KiB group provides 14 ERRGSRs.
      Each ERRGSR reports status for up to 56 error records.
    enum: [0, 1, 2]

  arm,num-records:
    $ref: /schemas/types.yaml#/definitions/uint32
    description:
      Total number of error records in this error source, including both
      implemented and unimplemented slots.
    minimum: 1

  arm,record-impl:
    $ref: /schemas/types.yaml#/definitions/uint64-array
    description:
      Bitmap of implemented error records.  Bit N set to 1 means error
      record N is present and active in this error source.  Bit N set to 0
      means record N is not implemented and must be skipped.  The array
      length must equal the number of ERRGSRs implied by arm,group-format
      (1 element for 4K, 4 for 16K, 14 for 64K).  For system-register
      nodes (no reg property) a single u64 element is used.
    minItems: 1
    maxItems: 14

  arm,status-reporting:
    $ref: /schemas/types.yaml#/definitions/uint64-array
    description:
      Bitmap indicating which implemented error records require direct
      polling of ERX_STATUS by software. Bit N set to 1 means error
      record N is not represented in an ERRGSR status register and must
      be checked by reading ERX_STATUS directly. Bit N set to 0 means
      error record N is represented in an ERRGSR status register and can
      be discovered through the ERRGSR scan path.
      For system-register error sources (no reg property), ERRGSR
      registers are not present. Therefore all implemented error records
      must be polled directly and arm,status-reporting shall be identical
      to arm,record-impl.
      The number of array elements shall match arm,record-impl.
    minItems: 1
    maxItems: 14

  arm,addressing-mode:
    $ref: /schemas/types.yaml#/definitions/uint64-array
    description:
      Bitmap indicating the address type reported in ERR_ADDR for each
      implemented error record.  Bit N set to 1 means error record N
      reports a Logical Address (LA); bit N set to 0 means it reports a
      System Physical Address (SPA).  When absent all records are assumed
      to report SPA.  The number of array elements shall match
      arm,record-impl.
    minItems: 1
    maxItems: 14

  # Processor error source properties (arm,ras-processor only)
  arm,cache-ref:
    $ref: /schemas/types.yaml#/definitions/phandle
    description:
      Phandle to the cache node (L1, L2, or L3) that this processor error
      source monitors.

  # SMMU error source properties (arm,ras-smmu only)
  arm,smmu-ref:
    $ref: /schemas/types.yaml#/definitions/phandle
    description:
      Phandle to the SMMU node that this error source monitors.

  # GIC error source properties (arm,ras-gic only)
  arm,gic-ref:
    $ref: /schemas/types.yaml#/definitions/phandle
    description:
      Phandle to the GIC node that this error source monitors.

required:
  - compatible
  - arm,num-records
  - arm,record-impl
  - arm,status-reporting

dependentRequired:
  reg: ['arm,group-format']

allOf:
  - if:
      properties:
        compatible:
          contains:
            const: arm,ras-processor
    then:
      required:
        - arm,cache-ref
    else:
      properties:
        arm,cache-ref: false

  - if:
      properties:
        compatible:
          contains:
            const: arm,ras-smmu
    then:
      required:
        - arm,smmu-ref
    else:
      properties:
        arm,smmu-ref: false

  - if:
      properties:
        compatible:
          contains:
            const: arm,ras-gic
    then:
      required:
        - arm,gic-ref
    else:
      properties:
        arm,gic-ref: false

unevaluatedProperties: false

examples:
  - |
    #include <dt-bindings/interrupt-controller/arm-gic.h>
    #include <dt-bindings/arm/arm,ras.h>

    cache-error-l2 {
        compatible = "arm,ras-processor";
        arm,num-records = <1>;
        arm,record-impl = /bits/ 64 <0x1>;
        arm,status-reporting = /bits/ 64 <0x1>;
        arm,cache-ref = <&l2_0>;
        interrupts = <GIC_PPI 0 IRQ_TYPE_LEVEL_HIGH>;
        interrupt-names = "fhi";
    };

  - |
    #include <dt-bindings/interrupt-controller/arm-gic.h>
    #include <dt-bindings/arm/arm,ras.h>

    gic-error@17a00000 {
        compatible = "arm,ras-gic";
        reg = <0x0 0x17a00000 0x0 0x10000>;
        reg-names = "err-records";
        arm,group-format = <ARM_RAS_GROUP_4K>;
        arm,num-records = <1>;
        arm,record-impl = /bits/ 64 <0x1>;
        arm,status-reporting = /bits/ 64 <0x0>;
        arm,gic-ref = <&gic>;
        interrupts = <GIC_SPI 200 IRQ_TYPE_LEVEL_HIGH>;
        interrupt-names = "fhi";
    };
```

## Documentation/devicetree/bindings/clock/qcom,glymur-lpasscc.yaml
```yaml
# SPDX-License-Identifier: (GPL-2.0-only OR BSD-2-Clause)
%YAML 1.2
---
$id: http://devicetree.org/schemas/clock/qcom,glymur-lpasscc.yaml#
$schema: http://devicetree.org/meta-schemas/core.yaml#

title: Qualcomm LPASS Core Clock Controller on Glymur

maintainers:
  - Srinivas Kandagatla <srinivas.kandagatla@oss.qualcomm.com>

description: |
  Qualcomm LPASS core and audio clock control module provides the clocks,
  and reset on Glymur.

  See also::
    include/dt-bindings/clock/qcom,lpasscc-glymur.h

properties:
  compatible:
    - qcom,glymur-lpasscc

  reg:
    maxItems: 1

  '#clock-cells':
    const: 1

  '#reset-cells':
    const: 1

required:
  - compatible
  - reg
  - '#clock-cells'
  - '#reset-cells'

additionalProperties: false

examples:
  - |
    #include <dt-bindings/clock/qcom,glymur-lpasscc.h>
    lpass_audiocc: clock-controller@32a9000 {
        compatible = "qcom,glymur-lpasscc";
        reg = <0x032a9000 0x1000>;
        #clock-cells = <1>;
        #reset-cells = <1>;
    };

...
```

## Documentation/devicetree/bindings/clock/qcom,hawi-lpass-va-csr.yaml
```yaml
# SPDX-License-Identifier: (GPL-2.0-only OR BSD-2-Clause)
%YAML 1.2
---
$id: http://devicetree.org/schemas/clock/qcom,hawi-lpass-va-csr.yaml#
$schema: http://devicetree.org/meta-schemas/core.yaml#

title: Qualcomm LPASS VA CSR heartbeat pulse clock provider

maintainers:
  - Srinivas Kandagatla <srinivas.kandagatla@oss.qualcomm.com>
  - Sarath Ganapathiraju <sarath.ganapathiraju@oss.qualcomm.com>

description:
  The Hawi LPASS (Low Power Audio Subsystem) VA CSR block contains a
  rate generator that produces a periodic HeartBeat Pulse, also known
  as the RateGen Pulse. This pulse synchronizes the start of DMAs and
  Codec Interfaces for audio usecases and can serve as a periodic wakeup
  source for the DSP.

properties:
  compatible:
    enum:
      - qcom,hawi-lpass-va-csr

  reg:
    maxItems: 1
    description: Address and size of the VA CSR register block.

  clocks:
    items:
      - description: LPASS LPR (Low Power Resource) voting clock
      - description: LPASS Audio voting clock

  clock-names:
    items:
      - const: lpr
      - const: audio

  "#clock-cells":
    const: 0

required:
  - compatible
  - reg
  - clocks
  - clock-names
  - "#clock-cells"

additionalProperties: false

examples:
  - |
    #include <dt-bindings/sound/qcom,q6dsp-lpass-ports.h>

    clock-controller@7ee0000 {
      compatible = "qcom,hawi-lpass-va-csr";
      reg = <0x07ee0000 0xe000>;
      clocks = <&q6prmcc LPASS_HW_LPR_VOTE LPASS_CLK_ATTRIBUTE_COUPLE_NO>,
               <&q6prmcc LPASS_HW_DCODEC_VOTE LPASS_CLK_ATTRIBUTE_COUPLE_NO>;
      clock-names = "lpr", "audio";
      #clock-cells = <0>;
    };
```

## Documentation/devicetree/bindings/connector/pcie-m2-b-connector.yaml
```yaml
# SPDX-License-Identifier: (GPL-2.0-only OR BSD-2-Clause)
%YAML 1.2
---
$id: http://devicetree.org/schemas/connector/pcie-m2-b-connector.yaml#
$schema: http://devicetree.org/meta-schemas/core.yaml#

title: PCIe M.2 Mechanical Key B Connector

maintainers:
  - Krishna Chaitanya Chundru <krishna.chundru@oss.qualcomm.com>

description:
  A PCIe M.2 B connector node represents a physical PCIe M.2 Mechanical Key B
  connector. Mechanical Key B connectors are used to connect WWAN devices to
  the host machine over interfaces like PCIe, USB3.1 Gen1, SSIC, or USB 2.0,
  selected by the Adapter's configuration pins.

properties:
  compatible:
    const: pcie-m2-b-connector

  vpcie3v3-supply:
    description: A phandle to the regulator for the 3.3v/VBAT supply.

  full-card-power-off-gpios:
    description: GPIO output to FULL_CARD_POWER_OFF# signal. This signal is
      used by the host system to turn off the entire Adapter. Refer, PCI
      Express M.2 Specification r4.0, sec 3.2.13.1 for more details.
    maxItems: 1

  reset-gpios:
    description: GPIO output to RESET# signal. This signal is used by the
      host system to place the WWAN Adapter into a power-on reset condition.
      Refer, PCI Express M.2 Specification r4.0, sec 3.2.13.2 for more
      details.
    maxItems: 1

  w-disable1-gpios:
    description: GPIO output to W_DISABLE1# signal. This signal is used by
      the host system to disable the WWAN radio on the Adapter. Refer, PCI
      Express M.2 Specification r4.0, sec 3.1.12.3 for more details.
    maxItems: 1

  w-disable2-gpios:
    description: GPIO output to W_DISABLE2# signal (default function of
      GPIO_10). This signal is used by the host system to disable a second
      radio on the Adapter. Refer, PCI Express M.2 Specification r4.0,
      sec 3.1.12.3 for more details.
    maxItems: 1

  wowwan-gpios:
    description: GPIO input to WAKE_ON_WWAN# (WoWWAN#) signal. The Adapter
      asserts this signal to wake up the host system. Refer, PCI Express M.2
      Specification r4.0, sec 3.2.13.3.6 for more details.
    maxItems: 1

  dpr-gpios:
    description: GPIO output to the Dynamic Power Reduction (DPR) signal.
      This signal is provided by a host system proximity sensor to the
      Adapter to trigger a reduction in the radio transmit output power to
      meet regulatory SAR requirements. Refer, PCI Express M.2 Specification
      r4.0, sec 3.2.13.4 for more details.
    maxItems: 1

  clocks:
    description: 32.768 KHz Suspend Clock (SUSCLK) input from the host system to
      the M.2 card. Refer, PCI Express M.2 Specification r4.0, sec 3.1.12.1 for
      more details.
    maxItems: 1

  ports:
    $ref: /schemas/graph.yaml#/properties/ports
    description: OF graph bindings modeling the interfaces exposed on the
      connector. Since a single connector can have multiple interfaces, every
      interface has an assigned OF graph port number as described below.

    properties:
      port@0:
        $ref: /schemas/graph.yaml#/properties/port
        description: PCIe interface for WWAN

      port@1:
        $ref: /schemas/graph.yaml#/properties/port
        description: SSIC interface for WWAN

      port@2:
        $ref: /schemas/graph.yaml#/properties/port
        description: USB 2.0 interface for WWAN

      port@3:
        $ref: /schemas/graph.yaml#/properties/port
        description: USB3.1 Gen1 interface for WWAN

    anyOf:
      - required:
          - port@0
      - required:
          - port@1
      - required:
          - port@3

required:
  - compatible
  - vpcie3v3-supply

additionalProperties: false

examples:
  # PCI M.2 Key B connector for WWAN with PCIe interface
  - |
    #include <dt-bindings/gpio/gpio.h>

    connector {
        compatible = "pcie-m2-b-connector";
        vpcie3v3-supply = <&vreg_wwan>;
        full-card-power-off-gpios = <&tlmm 121 GPIO_ACTIVE_LOW>;
        w-disable1-gpios = <&tlmm 122 GPIO_ACTIVE_LOW>;
        wowwan-gpios = <&tlmm 123 GPIO_ACTIVE_LOW>;

        ports {
            #address-cells = <1>;
            #size-cells = <0>;

            port@0 {
                reg = <0>;
                #address-cells = <1>;
                #size-cells = <0>;

                endpoint@0 {
                    reg = <0>;
                    remote-endpoint = <&pcie6_port0_ep>;
                };
            };

            port@2 {
                reg = <2>;
                #address-cells = <1>;
                #size-cells = <0>;

                endpoint@0 {
                    reg = <0>;
                    remote-endpoint = <&usb_hs_ep>;
                };
            };
        };
    };
```
