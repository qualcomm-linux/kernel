## Documentation/devicetree/bindings/display/msm/qcom,dcp-dsi.yaml
```yaml
# SPDX-License-Identifier: GPL-2.0-only OR BSD-2-Clause
%YAML 1.2
---
$id: http://devicetree.org/schemas/display/msm/qcom,dcp-dsi.yaml#
$schema: http://devicetree.org/meta-schemas/core.yaml#

title: Qualcomm DCP DSI host

maintainers:
  - Jayant Shekhar <jayant.shekhar@oss.qualcomm.com>

description: |
  A MIPI DSI host exposed by the Qualcomm DCP VirtIO device (see
  qcom,dcp.yaml). It follows the generic DSI controller binding, with panel
  devices described as child nodes. The DCP INTF graph endpoint connects
  directly to the panel; the DSI host node is not a graph endpoint. The host
  node uses the dsi@N naming convention, and its reg property identifies the
  DSI host index.

allOf:
  - $ref: /schemas/display/dsi-controller.yaml#

properties:
  reg:
    maxItems: 1
    description: DSI host index matching the DCP output port.

required:
  - reg
  - "#address-cells"
  - "#size-cells"

unevaluatedProperties: false

examples:
  - |
    #include <dt-bindings/gpio/gpio.h>

    dcp-subsystem {
        compatible = "virtio,device34";
        iommus = <&apps_smmu 0x400 0x2>;

        #address-cells = <1>;
        #size-cells = <0>;

        ports {
            #address-cells = <1>;
            #size-cells = <0>;

            port@0 {
                reg = <0>;
                dcp_intf0_out: endpoint {
                    remote-endpoint = <&panel_dcp_in>;
                };
            };
        };

        dsi@0 {
            reg = <0>;
            #address-cells = <1>;
            #size-cells = <0>;

            panel@0 {
                compatible = "novatek,nt37801";
                reg = <0>;

                vddio-supply = <&vreg_l12b_1p8>;
                vci-supply = <&vreg_l13b_3p0>;
                vdd-supply = <&display_panel_vdd>;
                reset-gpios = <&tlmm 210 GPIO_ACTIVE_LOW>;

                port {
                    panel_dcp_in: endpoint {
                        remote-endpoint = <&dcp_intf0_out>;
                    };
                };
            };
        };
    };
```

## Documentation/devicetree/bindings/display/msm/qcom,dcp.yaml
```yaml
# SPDX-License-Identifier: GPL-2.0-only OR BSD-2-Clause
%YAML 1.2
---
$id: http://devicetree.org/schemas/display/msm/qcom,dcp.yaml#
$schema: http://devicetree.org/meta-schemas/core.yaml#

title: Qualcomm Display Co-Processor (DCP)

maintainers:
  - Jayant Shekhar <jayant.shekhar@oss.qualcomm.com>

description: |
  The Display Co-Processor (DCP) is a firmware-owned display subsystem.
  Linux communicates with DCP over HFI through VirtIO and does not access
  display hardware registers directly.

  This node describes the externally connected display graph between DCP
  INTF outputs and attached DSI panels. It is assigned to the VirtIO device
  by the Qualcomm transport driver and is not independently enumerated.
  Firmware capabilities and internal resources, including pipes, mixers,
  CRTCs, and clocks, are discovered at runtime.

allOf:
  - $ref: /schemas/virtio/virtio-device.yaml#

properties:
  compatible:
    const: virtio,device34

  iommus:
    maxItems: 1
    description:
      SMMU context used by DCP firmware to access GEM framebuffers. This
      is separate from the HFI transport context specified by the
      iommus property on the parent DCP transport node.
      The child context is used for framebuffer DMA performed by DCP
      firmware, while the parent context is used for VirtIO transport and HFI
      queue buffers. These contexts represent distinct firmware-visible DMA
      address spaces and must not be used interchangeably.

  "#address-cells":
    const: 1

  "#size-cells":
    const: 0

  ports:
    $ref: /schemas/graph.yaml#/properties/ports
    description: |
      DPU INTF output-only ports. The port number matches the firmware INTF
      index. The corresponding DSI host is the child node whose reg value
      matches the port number; the graph endpoint itself connects directly to
      the attached panel. Unused INTF ports are omitted.
    unevaluatedProperties: false
    patternProperties:
      "^port@[0-9a-f]+$":
        $ref: /schemas/graph.yaml#/$defs/port-base
        unevaluatedProperties: false
        properties:
          endpoint:
            $ref: /schemas/graph.yaml#/$defs/endpoint-base
            unevaluatedProperties: false
            required:
              - remote-endpoint

patternProperties:
  "^dsi@[0-9a-f]+$":
    $ref: qcom,dcp-dsi.yaml#

required:
  - compatible
  - iommus
  - "#address-cells"
  - "#size-cells"
  - ports

unevaluatedProperties: false

examples:
  - |
    #include <dt-bindings/gpio/gpio.h>

    dcp-subsystem {
        compatible = "virtio,device34";
        iommus = <&apps_smmu 0x400 0x2>;

        #address-cells = <1>;
        #size-cells = <0>;

        ports {
            #address-cells = <1>;
            #size-cells = <0>;

            port@0 {
                reg = <0>;
                dcp_intf0_out: endpoint {
                    remote-endpoint = <&panel_dcp_in>;
                };
            };
        };

        dsi@0 {
            reg = <0>;
            #address-cells = <1>;
            #size-cells = <0>;

            panel@0 {
                compatible = "novatek,nt37801";
                reg = <0>;

                vddio-supply = <&vreg_l12b_1p8>;
                vci-supply = <&vreg_l13b_3p0>;
                vdd-supply = <&display_panel_vdd>;
                reset-gpios = <&tlmm 210 GPIO_ACTIVE_LOW>;

                port {
                    panel_dcp_in: endpoint {
                        remote-endpoint = <&dcp_intf0_out>;
                    };
                };
            };
        };
    };
```
