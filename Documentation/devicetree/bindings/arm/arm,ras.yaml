## Documentation/devicetree/bindings/media/qcom,x1p42100-camss.yaml
```yaml
# SPDX-License-Identifier: (GPL-2.0 OR BSD-2-Clause)
%YAML 1.2
---
$id: http://devicetree.org/schemas/media/qcom,x1p42100-camss.yaml#
$schema: http://devicetree.org/meta-schemas/core.yaml#

title: Qualcomm X1P42100 Camera Subsystem (CAMSS)

maintainers:
  - Wenmeng Liu <wenmeng.liu@oss.qualcomm.com>

description:
  The CAMSS IP is a CSI decoder and ISP present on Qualcomm platforms.

properties:
  compatible:
    const: qcom,x1p42100-camss

  reg:
    maxItems: 12

  reg-names:
    items:
      - const: csid0
      - const: csid1
      - const: csid2
      - const: csid_lite0
      - const: csid_lite1
      - const: csid_wrapper
      - const: csitpg0
      - const: csitpg1
      - const: csitpg2
      - const: vfe0
      - const: vfe_lite0
      - const: vfe_lite1

  clocks:
    maxItems: 14

  clock-names:
    items:
      - const: camnoc_rt_axi
      - const: cpas_ahb
      - const: cpas_fast_ahb
      - const: cpas_vfe0
      - const: cpas_vfe_lite
      - const: csid
      - const: csid_csiphy_rx
      - const: gcc_axi_hf
      - const: vfe0
      - const: vfe0_fast_ahb
      - const: vfe_lite
      - const: vfe_lite_ahb
      - const: vfe_lite_cphy_rx
      - const: vfe_lite_csid

  interrupts:
    maxItems: 8

  interrupt-names:
    items:
      - const: csid0
      - const: csid1
      - const: csid2
      - const: csid_lite0
      - const: csid_lite1
      - const: vfe0
      - const: vfe_lite0
      - const: vfe_lite1

  interconnects:
    maxItems: 2

  interconnect-names:
    items:
      - const: ahb
      - const: hf_mnoc

  iommus:
    items:
      - description: S1 HLOS IFE and IFE_LITE non-protected read
      - description: S1 HLOS IFE and IFE_LITE non-protected write

  power-domains:
    items:
      - description: IFE0 GDSC - Image Front End, Global Distributed Switch Controller.
      - description: Titan Top GDSC - Titan ISP Block, Global Distributed Switch Controller.

  power-domain-names:
    items:
      - const: ife0
      - const: top

  ports:
    $ref: /schemas/graph.yaml#/properties/ports

    description:
      CSI input ports, one per CSID. Each port receives the CSI data
      decoded by the matching CSIPHY.

    patternProperties:
      "^port@[01]$":
        $ref: /schemas/graph.yaml#/$defs/port-base
        unevaluatedProperties: false
        description:
          Input port for receiving CSI data from a CSIPHY.

        properties:
          endpoint:
            $ref: video-interfaces.yaml#
            unevaluatedProperties: false

            properties:
              data-lanes:
                minItems: 1
                maxItems: 4

              bus-type:
                enum:
                  - 1 # MEDIA_BUS_TYPE_CSI2_CPHY
                  - 4 # MEDIA_BUS_TYPE_CSI2_DPHY

            required:
              - data-lanes

required:
  - compatible
  - reg
  - reg-names
  - clocks
  - clock-names
  - interrupts
  - interrupt-names
  - interconnects
  - interconnect-names
  - iommus
  - power-domains
  - power-domain-names
  - ports

additionalProperties: false

examples:
  - |
    #include <dt-bindings/interrupt-controller/arm-gic.h>
    #include <dt-bindings/clock/qcom,x1e80100-gcc.h>
    #include <dt-bindings/clock/qcom,x1e80100-camcc.h>
    #include <dt-bindings/interconnect/qcom,icc.h>
    #include <dt-bindings/interconnect/qcom,x1e80100-rpmh.h>
    #include <dt-bindings/power/qcom-rpmpd.h>

    soc {
        #address-cells = <2>;
        #size-cells = <2>;

        isp@acb7000 {
            compatible = "qcom,x1p42100-camss";

            reg = <0 0x0acb7000 0 0x2000>,
                  <0 0x0acb9000 0 0x2000>,
                  <0 0x0acbb000 0 0x2000>,
                  <0 0x0acc6000 0 0x1000>,
                  <0 0x0acca000 0 0x1000>,
                  <0 0x0acb6000 0 0x1000>,
                  <0 0x0acf6000 0 0x1000>,
                  <0 0x0acf7000 0 0x1000>,
                  <0 0x0acf8000 0 0x1000>,
                  <0 0x0ac62000 0 0xf000>,
                  <0 0x0acc7000 0 0x1000>,
                  <0 0x0accb000 0 0x1000>;

            reg-names = "csid0",
                        "csid1",
                        "csid2",
                        "csid_lite0",
                        "csid_lite1",
                        "csid_wrapper",
                        "csitpg0",
                        "csitpg1",
                        "csitpg2",
                        "vfe0",
                        "vfe_lite0",
                        "vfe_lite1";

            clocks = <&camcc CAM_CC_CAMNOC_AXI_RT_CLK>,
                     <&camcc CAM_CC_CPAS_AHB_CLK>,
                     <&camcc CAM_CC_CPAS_FAST_AHB_CLK>,
                     <&camcc CAM_CC_CPAS_IFE_0_CLK>,
                     <&camcc CAM_CC_CPAS_IFE_LITE_CLK>,
                     <&camcc CAM_CC_CSID_CLK>,
                     <&camcc CAM_CC_CSID_CSIPHY_RX_CLK>,
                     <&gcc GCC_CAMERA_HF_AXI_CLK>,
                     <&camcc CAM_CC_IFE_0_CLK>,
                     <&camcc CAM_CC_IFE_0_FAST_AHB_CLK>,
                     <&camcc CAM_CC_IFE_LITE_CLK>,
                     <&camcc CAM_CC_IFE_LITE_AHB_CLK>,
                     <&camcc CAM_CC_IFE_LITE_CPHY_RX_CLK>,
                     <&camcc CAM_CC_IFE_LITE_CSID_CLK>;

            clock-names = "camnoc_rt_axi",
                          "cpas_ahb",
                          "cpas_fast_ahb",
                          "cpas_vfe0",
                          "cpas_vfe_lite",
                          "csid",
                          "csid_csiphy_rx",
                          "gcc_axi_hf",
                          "vfe0",
                          "vfe0_fast_ahb",
                          "vfe_lite",
                          "vfe_lite_ahb",
                          "vfe_lite_cphy_rx",
                          "vfe_lite_csid";

            interrupts = <GIC_SPI 464 IRQ_TYPE_EDGE_RISING>,
                         <GIC_SPI 466 IRQ_TYPE_EDGE_RISING>,
                         <GIC_SPI 431 IRQ_TYPE_EDGE_RISING>,
                         <GIC_SPI 468 IRQ_TYPE_EDGE_RISING>,
                         <GIC_SPI 359 IRQ_TYPE_EDGE_RISING>,
                         <GIC_SPI 465 IRQ_TYPE_EDGE_RISING>,
                         <GIC_SPI 469 IRQ_TYPE_EDGE_RISING>,
                         <GIC_SPI 360 IRQ_TYPE_EDGE_RISING>;

            interrupt-names = "csid0",
                              "csid1",
                              "csid2",
                              "csid_lite0",
                              "csid_lite1",
                              "vfe0",
                              "vfe_lite0",
                              "vfe_lite1";

            interconnects = <&gem_noc MASTER_APPSS_PROC QCOM_ICC_TAG_ACTIVE_ONLY
                             &config_noc SLAVE_CAMERA_CFG QCOM_ICC_TAG_ACTIVE_ONLY>,
                            <&mmss_noc MASTER_CAMNOC_HF QCOM_ICC_TAG_ALWAYS
                             &mc_virt SLAVE_EBI1 QCOM_ICC_TAG_ALWAYS>;

            interconnect-names = "ahb",
                                 "hf_mnoc";

            iommus = <&apps_smmu 0x800 0x60>,
                     <&apps_smmu 0x820 0x60>;

            power-domains = <&camcc CAM_CC_IFE_0_GDSC>,
                            <&camcc CAM_CC_TITAN_TOP_GDSC>;

            power-domain-names = "ife0",
                                 "top";

            ports {
                #address-cells = <1>;
                #size-cells = <0>;

                port@0 {
                    reg = <0>;
                    camss_csiphy0_ep: endpoint {
                        data-lanes = <1 2>;
                        remote-endpoint = <&csiphy0_out>;
                    };
                };
            };
        };
    };
```

## Documentation/devicetree/bindings/mfd/qcom,apsshm-shared-intu.yaml
```yaml
# SPDX-License-Identifier: GPL-2.0-only OR BSD-2-Clause
%YAML 1.2
---
$id: http://devicetree.org/schemas/mfd/qcom,apsshm-shared-intu.yaml#
$schema: http://devicetree.org/meta-schemas/core.yaml#

title: Qualcomm APSS Shared Memory Interrupt Notification Unit registers

maintainers:
  - Ram Sargar <rsargar@qti.qualcomm.com>

description:
  A block of SoC-level APSS HM CSR registers used to trigger doorbells that
  notify special event notifications to one or more subsystems within SOC.

properties:
  compatible:
    items:
      - enum:
          - qcom,sa8775p-apsshm-shared-intu
          - qcom,qcs8300-apsshm-shared-intu
      - const: syscon

  reg:
    maxItems: 1

required:
  - compatible
  - reg

additionalProperties: false

examples:
  - |
    apsshm_shared_intu: syscon@17c00000 {
        compatible = "qcom,sa8775p-apsshm-shared-intu", "syscon";
        reg = <0x0 0x17c00000 0x0 0x38>;
    };
```

## Documentation/devicetree/bindings/nvmem/layouts/pscrr-nvmem.yaml
```yaml
# SPDX-License-Identifier: (GPL-2.0-only OR BSD-2-Clause)
%YAML 1.2
---
$id: http://devicetree.org/schemas/nvmem/layouts/pscrr-nvmem.yaml#
$schema: http://devicetree.org/meta-schemas/core.yaml#

title: NVMEM layout for the Power State Change Reason recorder (PSCRR)

maintainers:
  - Faruque Ansari <faruque.ansari@oss.qualcomm.com>
  - Oleksij Rempel <o.rempel@pengutronix.de>

description:
  An NVMEM layout for a Power State Change Reason (PSCRR) recorder. The
  reboot or shutdown cause is persisted into a single small NVMEM cell,
  such as an RTC scratch register, a PMIC SDAM (Scratch Data Access Memory)
  byte, or an EEPROM byte, so the reason survives a power cycle and can be
  read back on the next boot.

select: false

properties:
  compatible:
    const: pscrr-nvmem

  "#address-cells":
    const: 1

  "#size-cells":
    const: 1

patternProperties:
  "^.*@[0-9a-f]+$":
    type: object
    description:
      The single NVMEM cell used to persist the power state change reason.

    properties:
      reg:
        items:
          - items:
              - description: Offset, in bytes, of the cell within the
                  parent NVMEM device.
              - const: 1
        description:
          Offset and size, in bytes, of the cell within the parent NVMEM
          device. The reason value occupies a single byte, so the size
          must be 1.

      bits:
        $ref: /schemas/types.yaml#/definitions/uint32-array
        items:
          - minimum: 0
            maximum: 7
            description:
              Bit offset within the byte addressed by reg.
          - minimum: 1
            maximum: 8
            description:
              Number of bits used to store the reason. Must be wide enough
              to hold every value of enum psc_reason (currently 4 bits or
              more).
        description:
          Optional. When absent, the whole byte addressed by reg is used.

    required:
      - reg

    additionalProperties: false

required:
  - compatible

additionalProperties: false

examples:
  - |
    nvmem-layout {
        compatible = "pscrr-nvmem";
        #address-cells = <1>;
        #size-cells = <1>;

        reboot-reason-persist@49 {
            reg = <0x49 0x1>;
            bits = <0 4>;
        };
    };
```

## Documentation/devicetree/bindings/phy/qcom,snps-eusb2-phy.yaml
```yaml
# SPDX-License-Identifier: (GPL-2.0 OR BSD-2-Clause)
%YAML 1.2
---
$id: http://devicetree.org/schemas/phy/qcom,snps-eusb2-phy.yaml#
$schema: http://devicetree.org/meta-schemas/core.yaml#

title: Qualcomm SNPS eUSB2 phy controller

maintainers:
  - Abel Vesa <abel.vesa@linaro.org>

description:
  eUSB2 controller supports LS/FS/HS usb connectivity on Qualcomm chipsets.

properties:
  compatible:
    oneOf:
      - items:
          - enum:
              - qcom,eliza-snps-eusb2-phy
              - qcom,milos-snps-eusb2-phy
              - qcom,nord-snps-eusb2-phy
              - qcom,sar2130p-snps-eusb2-phy
              - qcom,sdx75-snps-eusb2-phy
              - qcom,sm8650-snps-eusb2-phy
              - qcom,x1e80100-snps-eusb2-phy
          - const: qcom,sm8550-snps-eusb2-phy
      - const: qcom,sm8550-snps-eusb2-phy

  reg:
    maxItems: 1

  "#phy-cells":
    const: 0

  clocks:
    minItems: 1
    items:
      - description: ref
      - description: AHB2PHY bridge clock for register access

  clock-names:
    minItems: 1
    items:
      - const: ref
      - const: bus

  resets:
    maxItems: 1

  phys:
    maxItems: 1
    description:
      Phandle to eUSB2 to USB 2.0 repeater

  vdd-supply:
    description:
      Phandle to 0.88V regulator supply to PHY digital circuit.

  vdda12-supply:
    description:
      Phandle to 1.2V regulator supply to PHY refclk pll block.

required:
  - compatible
  - reg
  - "#phy-cells"
  - clocks
  - clock-names
  - vdd-supply
  - vdda12-supply

allOf:
  - if:
      not:
        properties:
          compatible:
            contains:
              const: qcom,nord-snps-eusb2-phy
    then:
      required:
        - resets

  - if:
      properties:
        compatible:
          contains:
            const: qcom,nord-snps-eusb2-phy
    then:
      properties:
        clocks:
          minItems: 2
        clock-names:
          minItems: 2
    else:
      properties:
        clocks:
          maxItems: 1
        clock-names:
          maxItems: 1

additionalProperties: false

examples:
  - |
    #include <dt-bindings/clock/qcom,sm8550-gcc.h>
    #include <dt-bindings/clock/qcom,rpmh.h>
    #include <dt-bindings/clock/qcom,sm8550-tcsr.h>

    usb_1_hsphy: phy@88e3000 {
        compatible = "qcom,sm8550-snps-eusb2-phy";
        reg = <0x88e3000 0x154>;
        #phy-cells = <0>;

        clocks = <&tcsrcc TCSR_USB2_CLKREF_EN>;
        clock-names = "ref";

        vdd-supply = <&vreg_l1e_0p88>;
        vdda12-supply = <&vreg_l3e_1p2>;

        resets = <&gcc GCC_QUSB2PHY_PRIM_BCR>;
    };
```
