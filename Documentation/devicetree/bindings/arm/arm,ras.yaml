## Documentation/devicetree/bindings/display/panel/novatek,nt37802.yaml
```yaml
# SPDX-License-Identifier: GPL-2.0-only OR BSD-2-Clause
%YAML 1.2
---
$id: http://devicetree.org/schemas/display/panel/novatek,nt37802.yaml#
$schema: http://devicetree.org/meta-schemas/core.yaml#

title: Novatek NT37802 AMOLED DSI Command-Mode Panel

maintainers:
  - Jayant Shekhar <jshekhar@oss.qualcomm.com>

description:
  The Novatek NT37802 command-mode AMOLED panel described by the Maili/Pebble
  platform. The downstream panel description identifies the module as CSOT.

allOf:
  - $ref: panel-common.yaml#

properties:
  compatible:
    const: novatek,nt37802

  reg:
    maxItems: 1
    description: DSI virtual channel number

  exvdd-supply: true
  vci-supply: true
  vdd-supply: true
  vddio-supply: true
  reset-gpios: true
  port: true

required:
  - compatible
  - reg
  - exvdd-supply
  - vci-supply
  - vdd-supply
  - vddio-supply
  - reset-gpios
  - port

additionalProperties: false

examples:
  - |
    #include <dt-bindings/gpio/gpio.h>

    dsi {
        #address-cells = <1>;
        #size-cells = <0>;

        panel@0 {
            compatible = "novatek,nt37802";
            reg = <0>;
            reset-gpios = <&tlmm 210 GPIO_ACTIVE_LOW>;
            vddio-supply = <&vreg_l12b_1p8>;
            vdd-supply = <&vreg_l11b_1p2>;
            vci-supply = <&vreg_l13b_3p0>;
            exvdd-supply = <&display_panel_vdd>;

            port {
                endpoint {
                    remote-endpoint = <&dsi0_out>;
                };
            };
        };
    };
```

## Documentation/devicetree/bindings/i2c/qcom,i2c-target.yaml
```yaml
# SPDX-License-Identifier: (GPL-2.0-only OR BSD-2-Clause)
%YAML 1.2
---
$id: http://devicetree.org/schemas/i2c/qcom,i2c-target.yaml#
$schema: http://devicetree.org/meta-schemas/core.yaml#

title: Qualcomm I2C Target Controller

maintainers:
  - Mukesh Kumar Savaliya <mukesh.savaliya@oss.qualcomm.com>
  - Viken Dadhaniya <viken.dadhaniya@oss.qualcomm.com>

description:
  Dedicated hardware IP found on Qualcomm SoCs that operates exclusively
  as an I2C target (slave) device on the bus. Supports FIFO (PIO) mode
  for data transfer.

properties:
  compatible:
    enum:
      - qcom,qdu1000-i2c-target

  reg:
    maxItems: 1

  interrupts:
    maxItems: 1

  clocks:
    items:
      - description: XO reference clock
      - description: AHB bus clock

  clock-names:
    items:
      - const: xo
      - const: ahb

  interconnects:
    maxItems: 1

  interconnect-names:
    const: i2c

  pinctrl-0: true
  pinctrl-1: true

  pinctrl-names:
    items:
      - const: default
      - const: sleep

required:
  - compatible
  - reg
  - interrupts
  - clocks
  - clock-names
  - interconnects
  - interconnect-names

allOf:
  - $ref: /schemas/i2c/i2c-controller.yaml#

unevaluatedProperties: false

examples:
  - |
    #include <dt-bindings/interrupt-controller/arm-gic.h>
    #include <dt-bindings/clock/qcom,qdu1000-gcc.h>
    #include <dt-bindings/interconnect/qcom,qdu1000-rpmh.h>

    i2c@88ca000 {
        compatible = "qcom,qdu1000-i2c-target";
        reg = <0x88ca000 0x64>;
        clocks = <&gcc GCC_SM_BUS_XO_CLK>, <&gcc GCC_SM_BUS_AHB_CLK>;
        clock-names = "xo", "ahb";
        interrupts = <GIC_SPI 358 IRQ_TYPE_LEVEL_HIGH>;
        #address-cells = <1>;
        #size-cells = <0>;
        interconnect-names = "i2c";
        interconnects = <&gem_noc MASTER_APPSS_PROC 0 &config_noc SLAVE_SMBUS_CFG 0>;
    };
...
```

## Documentation/devicetree/bindings/mailbox/qcom,rtss-mailbox.yaml
```yaml
# SPDX-License-Identifier: GPL-2.0 OR BSD-2-Clause
%YAML 1.2
---
$id: http://devicetree.org/schemas/mailbox/qcom,rtss-mailbox.yaml#
$schema: http://devicetree.org/meta-schemas/core.yaml#

title: Qualcomm Technologies, Inc. RTSS Mailbox

maintainers:
  - Ram Sargar <rsargar@qti.qualcomm.com>

description:
  The RTSS mailbox exposes a shared-memory and IPCC doorbell channel between
  the application processor and the RTSS subsystem, and manages handshake
  with the RTSS subsystem to handle different milestones in mission mode.

properties:
  compatible:
    items:
      - enum:
          - qcom,sa8775p-rtss-mailbox
          - qcom,qcs8300-rtss-mailbox
      - const: qcom,rtss-mailbox

  qcom,syscon-tcsr-req:
    $ref: /schemas/types.yaml#/definitions/phandle-array
    items:
      - items:
          - description: phandle to the TCSR syscon node
          - description: offset of the RTSS request register from the syscon base
    description:
      Reference to the TCSR syscon node and register offset used to write
      the boot/suspend handshake magic that RTSS reads.

  qcom,syscon-tcsr-resp:
    $ref: /schemas/types.yaml#/definitions/phandle-array
    items:
      - items:
          - description: phandle to the TCSR syscon node
          - description: offset of the RTSS response register from the syscon base
    description:
      Reference to the TCSR syscon node and register offset used to read
      back the handshake magic RTSS acknowledges with.

  qcom,syscon-ipc:
    $ref: /schemas/types.yaml#/definitions/phandle-array
    items:
      - items:
          - description: phandle to the APSS shared IPC syscon node
          - description: offset of the IPC trigger register from the syscon base
    description:
      Reference to the syscon node and register offset used to trigger the
      IPC interrupt that notifies RTSS a TCSR handshake register was updated.

  mboxes:
    description:
      IPCC mailbox channels used to send interrupts to the RTSS-facing IPCC
      client/signal pairs.

  interrupts-extended:
    description:
      IPCC channels used to receive interrupts from the RTSS-facing IPCC
      client/signal pairs.

  memory-region:
    items:
      - description: reserved-memory carveout for the RTSS mailbox descriptor region
      - description: reserved-memory carveout for the OTA region
    description:
      Reference to the reserved-memory regions used for the mailbox
      descriptor and for OTA.

required:
  - compatible
  - qcom,syscon-tcsr-req
  - qcom,syscon-tcsr-resp
  - qcom,syscon-ipc
  - mboxes
  - interrupts-extended
  - memory-region

additionalProperties: false

examples:
  - |
    #include <dt-bindings/interrupt-controller/irq.h>
    #include <dt-bindings/mailbox/qcom-ipcc.h>

    rtss-ipcc-mailbox {
        compatible = "qcom,sa8775p-rtss-mailbox", "qcom,rtss-mailbox";
        qcom,syscon-tcsr-req  = <&tcsr 0x3e02c>;
        qcom,syscon-tcsr-resp = <&tcsr 0x3d018>;
        qcom,syscon-ipc = <&apsshm_shared_intu 0xc>;
        mboxes = <&ipcc1 IPCC_CLIENT_RTSS0 0x2>,
                 <&ipcc1 IPCC_CLIENT_RTSS1 0x3>;
        interrupts-extended = <&ipcc1 IPCC_CLIENT_RTSS0 0x2 IRQ_TYPE_EDGE_RISING>,
                               <&ipcc1 IPCC_CLIENT_RTSS1 0x3 IRQ_TYPE_EDGE_RISING>;
        memory-region = <&sail_mailbox_mem>, <&sail_ota_mem>;
    };
```
