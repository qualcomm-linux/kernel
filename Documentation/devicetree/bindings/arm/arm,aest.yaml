## Documentation/devicetree/bindings/hwmon/qcom,bcl-hwmon.yaml
```yaml
# SPDX-License-Identifier: (GPL-2.0-only OR BSD-2-Clause)
%YAML 1.2
---
$id: http://devicetree.org/schemas/hwmon/qcom,bcl-hwmon.yaml#
$schema: http://devicetree.org/meta-schemas/core.yaml#

title: Qualcomm SPMI PMIC Battery Current Limiting (BCL) Hardware Monitor

maintainers:
  - Manaf Meethalavalappu Pallikunhi <manaf.pallikunhi@oss.qualcomm.com>

description: |
  SPMI PMIC Battery Current Limiting (BCL) hardware provides monitoring and
  alarm functionality for battery overcurrent and battery or system under
  voltage conditions. It monitors battery voltage and current, and
  can trigger interrupts when configurable thresholds are exceeded.

properties:
  compatible:
    oneOf:
      - description: v1 based BCL
        items:
          - enum:
              - qcom,pm7250b-bcl
              - qcom,pm8250b-bcl
          - const: qcom,bcl-v1

      - description: v2 based BCL
        items:
          - enum:
              - qcom,pm8350b-bcl
              - qcom,pm8350c-bcl
          - const: qcom,bcl-v2

      - description: v3 bmx based BCL
        items:
          - enum:
              - qcom,pm8550b-bcl
              - qcom,pm7550ba-bcl
          - const: qcom,bcl-v3-bmx

      - description: v3 core based BCL
        items:
          - enum:
              - qcom,pm8550-bc0l
              - qcom,pm7550-bcl
          - const: qcom,bcl-v3-core

      - description: v3 wb based BCL
        items:
          - enum:
              - qcom,pmw5100-bcl
          - const: qcom,bcl-v3-wb

      - description: v4 bmx based BCL
        items:
          - enum:
              - qcom,pmih010-bcl
          - const: qcom,bcl-v4-bmx

      - description: v4 bmx with different scale based BCL
        items:
          - enum:
              - qcom,pmv010-bcl
          - const: qcom,bcl-v4-pmv010

      - description: v4 core based BCL
        items:
          - enum:
              - qcom,pmh010-bcl
          - const: qcom,bcl-v4-core

      - description: v4 wb based BCL
        items:
          - enum:
              - qcom,pmw6100-bcl
          - const: qcom,bcl-v4-wb

  reg:
    maxItems: 1
    description: BCL base address in the SPMI PMIC register map

  interrupts:
    minItems: 2
    maxItems: 2
    description:
      BCL alarm interrupts for different threshold levels

  interrupt-names:
    items:
      - const: bcl-max-min
      - const: bcl-critical

  overcurrent-thresholds-milliamp:
    description:
      Current thresholds in milliamperes for the two configurable current
      alarm levels (max and critical). These values are used to override
      default thresholds if a platform has different battery ocp specification.
    $ref: /schemas/types.yaml#/definitions/uint32-array
    minItems: 2
    maxItems: 2

required:
  - compatible
  - reg
  - interrupts
  - interrupt-names

unevaluatedProperties: false

examples:
  - |
    #include <dt-bindings/interrupt-controller/irq.h>

    pmic {
        #address-cells = <1>;
        #size-cells = <0>;

        sensor@1d00 {
            compatible = "qcom,pm7250b-bcl", "qcom,bcl-v1";
            reg = <0x1d00>;
            interrupts = <0x2 0x1d 0x0 IRQ_TYPE_EDGE_RISING>,
                         <0x2 0x1d 0x1 IRQ_TYPE_EDGE_RISING>;
            interrupt-names = "bcl-max-min",
                              "bcl-critical";
            overcurrent-thresholds-milliamp = <5500 6000>;
        };
    };
```

## Documentation/devicetree/bindings/interconnect/qcom,shikra-epss-l3.yaml
```yaml
# SPDX-License-Identifier: (GPL-2.0-only OR BSD-2-Clause)
%YAML 1.2
---
$id: http://devicetree.org/schemas/interconnect/qcom,shikra-epss-l3.yaml#
$schema: http://devicetree.org/meta-schemas/core.yaml#

title: Qualcomm Operating State Manager (OSM) L3 Shikra Interconnect Provider

maintainers:
  - Raviteja Laggyshetty <raviteja.laggyshetty@oss.qualcomm.com>

description:
  L3 cache bandwidth requirements on Qualcomm SoCs is serviced by the OSM.
  The OSM L3 interconnect provider aggregates the L3 bandwidth requests
  from CPU/GPU and relays it to the OSM.

properties:
  compatible:
    enum:
      - qcom,shikra-epss-l3

  reg:
    maxItems: 1

  clocks:
    items:
      - description: xo clock
      - description: alternate clock

  clock-names:
    items:
      - const: xo
      - const: alternate

  '#interconnect-cells':
    const: 1

required:
  - compatible
  - reg
  - clocks
  - clock-names
  - '#interconnect-cells'

additionalProperties: false

examples:
  - |

    #define GPLL0               165
    #define RPMH_CXO_CLK        0

    epss_l3: interconnect@fd90000 {
      compatible = "qcom,shikra-epss-l3";
      reg = <0xfd90000 0x1000>;

      clocks = <&rpmhcc RPMH_CXO_CLK>, <&gcc GPLL0>;
      clock-names = "xo", "alternate";

      #interconnect-cells = <1>;
    };
```

## Documentation/devicetree/bindings/media/qcom,glymur-iris.yaml
```yaml
# SPDX-License-Identifier: (GPL-2.0-only OR BSD-2-Clause)
%YAML 1.2
---
$id: http://devicetree.org/schemas/media/qcom,glymur-iris.yaml#
$schema: http://devicetree.org/meta-schemas/core.yaml#

title: Qualcomm Glymur SoC Iris video encoder and decoder

maintainers:
  - Vishnu Reddy <busanna.reddy@oss.qualcomm.com>

description:
  The Iris video processing unit on Qualcomm Glymur SoC is a video encode and
  decode accelerator.

properties:
  compatible:
    const: qcom,glymur-iris

  clocks:
    maxItems: 9

  clock-names:
    items:
      - const: iface
      - const: core
      - const: vcodec0_core
      - const: iface1
      - const: core_freerun
      - const: vcodec0_core_freerun
      - const: iface2
      - const: vcodec1_core
      - const: vcodec1_core_freerun

  dma-coherent: true

  interconnects:
    maxItems: 2

  interconnect-names:
    items:
      - const: cpu-cfg
      - const: video-mem

  iommus:
    maxItems: 4

  iommu-map:
    maxItems: 1

  operating-points-v2: true
  opp-table:
    type: object

  power-domains:
    maxItems: 5

  power-domain-names:
    items:
      - const: venus
      - const: vcodec0
      - const: mxc
      - const: mmcx
      - const: vcodec1

  resets:
    maxItems: 6

  reset-names:
    items:
      - const: bus0
      - const: bus1
      - const: core
      - const: vcodec0_core
      - const: bus2
      - const: vcodec1_core

required:
  - compatible
  - reg
  - clocks
  - clock-names
  - dma-coherent
  - interconnects
  - interconnect-names
  - interrupts
  - iommus
  - memory-region
  - power-domains
  - power-domain-names
  - resets
  - reset-names

allOf:
  - $ref: qcom,venus-common.yaml#

unevaluatedProperties: false

examples:
  - |
    #include <dt-bindings/interrupt-controller/arm-gic.h>
    #include <dt-bindings/media/qcom,glymur-iris.h>
    #include <dt-bindings/power/qcom,rpmhpd.h>

    video-codec@aa00000 {
        compatible = "qcom,glymur-iris";
        reg = <0x0aa00000 0xf0000>;

        clocks = <&gcc_video_axi0_clk>,
                 <&videocc_mvs0c_clk>,
                 <&videocc_mvs0_clk>,
                 <&gcc_video_axi0c_clk>,
                 <&videocc_mvs0c_freerun_clk>,
                 <&videocc_mvs0_freerun_clk>,
                 <&gcc_video_axi1_clk>,
                 <&videocc_mvs1_clk>,
                 <&videocc_mvs1_freerun_clk>;
        clock-names = "iface",
                      "core",
                      "vcodec0_core",
                      "iface1",
                      "core_freerun",
                      "vcodec0_core_freerun",
                      "iface2",
                      "vcodec1_core",
                      "vcodec1_core_freerun";

        dma-coherent;

        interconnects = <&hsc_noc_master_appss_proc &config_noc_slave_venus_cfg>,
                        <&mmss_noc_master_video &mc_virt_slave_ebi1>;
        interconnect-names = "cpu-cfg",
                             "video-mem";

        interrupts = <GIC_SPI 174 IRQ_TYPE_LEVEL_HIGH>;

        iommus = <&apps_smmu 0x1940 0x0>,
                 <&apps_smmu 0x1943 0x0>,
                 <&apps_smmu 0x1944 0x0>,
                 <&apps_smmu 0x19e0 0x0>;

        iommu-map = <IOMMU_FID_IRIS_FIRMWARE &apps_smmu 0x19e2 0x1>;

        memory-region = <&video_mem>;

        operating-points-v2 = <&iris_opp_table>;

        power-domains = <&videocc_mvs0c_gdsc>,
                        <&videocc_mvs0_gdsc>,
                        <&rpmhpd RPMHPD_MXC>,
                        <&rpmhpd RPMHPD_MMCX>,
                        <&videocc_mvs1_gdsc>;
        power-domain-names = "venus",
                             "vcodec0",
                             "mxc",
                             "mmcx",
                             "vcodec1";

        resets = <&gcc_video_axi0_clk_ares>,
                 <&gcc_video_axi0c_clk_ares>,
                 <&videocc_mvs0c_freerun_clk_ares>,
                 <&videocc_mvs0_freerun_clk_ares>,
                 <&gcc_video_axi1_clk_ares>,
                 <&videocc_mvs1_freerun_clk_ares>;
        reset-names = "bus0",
                      "bus1",
                      "core",
                      "vcodec0_core",
                      "bus2",
                      "vcodec1_core";

        iris_opp_table: opp-table {
            compatible = "operating-points-v2";

            opp-240000000 {
                opp-hz = /bits/ 64 <240000000 240000000 360000000>;
                required-opps = <&rpmhpd_opp_svs>,
                                <&rpmhpd_opp_low_svs>;
            };

            opp-338000000 {
                opp-hz = /bits/ 64 <338000000 338000000 507000000>;
                required-opps = <&rpmhpd_opp_svs>,
                                <&rpmhpd_opp_svs>;
            };

            opp-366000000 {
                opp-hz = /bits/ 64 <366000000 366000000 549000000>;
                required-opps = <&rpmhpd_opp_svs_l1>,
                                <&rpmhpd_opp_svs_l1>;
            };

            opp-444000000 {
                opp-hz = /bits/ 64 <444000000 444000000 666000000>;
                required-opps = <&rpmhpd_opp_svs_l1>,
                                <&rpmhpd_opp_nom>;
            };

            opp-533333334 {
                opp-hz = /bits/ 64 <533333334 533333334 800000000>;
                required-opps = <&rpmhpd_opp_svs_l1>,
                                <&rpmhpd_opp_turbo>;
            };

            opp-655000000 {
                opp-hz = /bits/ 64 <655000000 655000000 982000000>;
                required-opps = <&rpmhpd_opp_nom>,
                                <&rpmhpd_opp_turbo_l1>;
            };
        };
    };
```
