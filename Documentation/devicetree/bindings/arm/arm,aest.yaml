## Documentation/devicetree/bindings/sound/qcom,shikra-qaif.yaml
```yaml
# SPDX-License-Identifier: (GPL-2.0-only OR BSD-2-Clause)
%YAML 1.2
---
$id: http://devicetree.org/schemas/sound/qcom,shikra-qaif.yaml#
$schema: http://devicetree.org/meta-schemas/core.yaml#

title: Qualcomm Audio Interface on Shikra

maintainers:
  - Qualcomm Innovation Center, Inc. <quic_kernel@quicinc.com>

description:
  Qualcomm Audio Interface CPU DAI controller used by the Shikra audio core.

properties:
  compatible:
    const: qcom,shikra-qaif-cpu

  reg:
    maxItems: 1

  reg-names:
    const: audio-qaif-core

  iommus:
    maxItems: 1

  clocks:
    minItems: 15
    maxItems: 15

  clock-names:
    items:
      - const: gcc_lpass_config_clk
      - const: gcc_lpass_core_axim_clk
      - const: audio_core_cc_aud_dma_clk
      - const: audio_core_cc_aud_dma_mem_clk
      - const: audio_core_cc_bus_clk
      - const: audio_core_cc_aif_if0_ebit_clk
      - const: audio_core_cc_aif_if0_ibit_clk
      - const: audio_core_cc_aif_if1_ebit_clk
      - const: audio_core_cc_aif_if1_ibit_clk
      - const: audio_core_cc_aif_if2_ebit_clk
      - const: audio_core_cc_aif_if2_ibit_clk
      - const: audio_core_cc_aif_if3_ebit_clk
      - const: audio_core_cc_aif_if3_ibit_clk
      - const: audio_core_cc_ext_mclka_clk
      - const: audio_core_cc_ext_mclkb_clk

  interrupts:
    maxItems: 1

  interrupt-names:
    const: qaif-irq-audio-core

  '#sound-dai-cells':
    const: 1

  '#address-cells':
    const: 1

  '#size-cells':
    const: 0

  aif-interface:
    $ref: /schemas/types.yaml#/definitions/phandle
    description: TDM/MI2S interface configuration referenced by this controller.

required:
  - compatible
  - reg
  - reg-names
  - iommus
  - clocks
  - clock-names
  - interrupts
  - interrupt-names
  - '#sound-dai-cells'

additionalProperties: false

examples:
  - |
    #include <dt-bindings/clock/qcom,shikra-audiocorecc.h>
    #include <dt-bindings/interrupt-controller/arm-gic.h>
    #include <dt-bindings/interrupt-controller/irq.h>

    audio@a000000 {
        compatible = "qcom,shikra-qaif-cpu";
        reg = <0x0a000000 0x20000>;
        reg-names = "audio-qaif-core";
        iommus = <&apps_smmu 0x1c0 0x0>;
        clocks = <&gcc 0>, <&gcc 1>,
                 <&audiocorecc AUDIO_CORE_CC_AUD_DMA_CLK>,
                 <&audiocorecc AUDIO_CORE_CC_AUD_DMA_MEM_CLK>,
                 <&audiocorecc AUDIO_CORE_CC_BUS_CLK>,
                 <&audiocorecc AUDIO_CORE_CC_AIF_IF0_EBIT_CLK>,
                 <&audiocorecc AUDIO_CORE_CC_AIF_IF0_IBIT_CLK>,
                 <&audiocorecc AUDIO_CORE_CC_AIF_IF1_EBIT_CLK>,
                 <&audiocorecc AUDIO_CORE_CC_AIF_IF1_IBIT_CLK>,
                 <&audiocorecc AUDIO_CORE_CC_AIF_IF2_EBIT_CLK>,
                 <&audiocorecc AUDIO_CORE_CC_AIF_IF2_IBIT_CLK>,
                 <&audiocorecc AUDIO_CORE_CC_AIF_IF3_EBIT_CLK>,
                 <&audiocorecc AUDIO_CORE_CC_AIF_IF3_IBIT_CLK>,
                 <&audiocorecc AUDIO_CORE_CC_EXT_MCLKA_OUT_CLK>,
                 <&audiocorecc AUDIO_CORE_CC_EXT_MCLKB_OUT_CLK>;
        clock-names = "gcc_lpass_config_clk", "gcc_lpass_core_axim_clk",
                      "audio_core_cc_aud_dma_clk",
                      "audio_core_cc_aud_dma_mem_clk",
                      "audio_core_cc_bus_clk",
                      "audio_core_cc_aif_if0_ebit_clk",
                      "audio_core_cc_aif_if0_ibit_clk",
                      "audio_core_cc_aif_if1_ebit_clk",
                      "audio_core_cc_aif_if1_ibit_clk",
                      "audio_core_cc_aif_if2_ebit_clk",
                      "audio_core_cc_aif_if2_ibit_clk",
                      "audio_core_cc_aif_if3_ebit_clk",
                      "audio_core_cc_aif_if3_ibit_clk",
                      "audio_core_cc_ext_mclka_clk",
                      "audio_core_cc_ext_mclkb_clk";
        interrupts = <GIC_SPI 331 IRQ_TYPE_LEVEL_HIGH>;
        interrupt-names = "qaif-irq-audio-core";
        #sound-dai-cells = <1>;
    };

...
```
