## Documentation/devicetree/bindings/arm/qcom,coresight-tgu.yaml
```yaml
# SPDX-License-Identifier: GPL-2.0-only OR BSD-2-Clause
# Copyright (c) 2025 Qualcomm Innovation Center, Inc. All rights reserved.
%YAML 1.2
---
$id: http://devicetree.org/schemas/arm/qcom,coresight-tgu.yaml#
$schema: http://devicetree.org/meta-schemas/core.yaml#

title: Trigger Generation Unit - TGU

description: |
  The Trigger Generation Unit (TGU) is a Data Engine which can be utilized
  to sense a plurality of signals and create a trigger into the CTI or
  generate interrupts to processors. The TGU is like the trigger circuit
  of a Logic Analyzer. The corresponding trigger logic can be realized by
  configuring the conditions for each step after sensing the signal.
  Once setup and enabled, it will observe sense inputs and based upon
  the activity of those inputs, even over clock cycles, may detect a
  preprogrammed state/sequence and then produce a trigger or interrupt.

  The primary use case of the TGU is to detect patterns or sequences on a
  given set of signals within some region to indentify the issue in time
  once there is abnormal behavior in the subsystem.

maintainers:
  - Mao Jinlong <quic_jinlmao@quicinc.com>
  - Sam Chai <quic_songchai@quicinc.com>

# Need a custom select here or 'arm,primecell' will match on lots of nodes
select:
  properties:
    compatible:
      contains:
        enum:
          - qcom,coresight-tgu
  required:
    - compatible

properties:
  compatible:
    items:
      - const: qcom,coresight-tgu
      - const: arm,primecell

  reg:
    maxItems: 1

  clocks:
    maxItems: 1

  clock-names:
    items:
      - const: apb_pclk

  in-ports:
    $ref: /schemas/graph.yaml#/properties/ports
    additionalProperties: false

    properties:
      port:
        description:
          The port mechanism here ensures the relationship between TGU and
          TPDM, as TPDM is one of the inputs for TGU. It will allow TGU to
          function as TPDM's helper and enable TGU when the connected
          TPDM is enabled.
        $ref: /schemas/graph.yaml#/properties/port

required:
  - compatible
  - reg
  - clocks
  - clock-names

additionalProperties: false

examples:
  - |
    tgu@10b0e000 {
        compatible = "qcom,coresight-tgu", "arm,primecell";
        reg = <0x10b0e000 0x1000>;

        clocks = <&aoss_qmp>;
        clock-names = "apb_pclk";

        in-ports {
            port {
                tgu_in_tpdm_swao: endpoint{
                    remote-endpoint = <&tpdm_swao_out_tgu>;
                };
            };
        };
    };
...
```

## Documentation/devicetree/bindings/arm/qcom,tgu.yaml
```yaml
# SPDX-License-Identifier: GPL-2.0-only OR BSD-2-Clause
# Copyright (c) 2025 Qualcomm Innovation Center, Inc. All rights reserved.
%YAML 1.2
---
$id: http://devicetree.org/schemas/arm/qcom,tgu.yaml#
$schema: http://devicetree.org/meta-schemas/core.yaml#

title: Trigger Generation Unit - TGU

description: |
  The Trigger Generation Unit (TGU) is a Data Engine which can be utilized
  to sense a plurality of signals and create a trigger into the CTI or
  generate interrupts to processors. The TGU is like the trigger circuit
  of a Logic Analyzer. The corresponding trigger logic can be realized by
  configuring the conditions for each step after sensing the signal.
  Once setup and enabled, it will observe sense inputs and based upon
  the activity of those inputs, even over clock cycles, may detect a
  preprogrammed state/sequence and then produce a trigger or interrupt.

  The primary use case of the TGU is to detect patterns or sequences on a
  given set of signals within some region to identify the issue in time
  once there is abnormal behavior in the subsystem.

maintainers:
  - Mao Jinlong <jinlong.mao@oss.qualcomm.com>
  - Songwei Chai <songwei.chai@oss.qualcomm.com>

# Need a custom select here or 'arm,primecell' will match on lots of nodes
select:
  properties:
    compatible:
      contains:
        enum:
          - qcom,tgu
  required:
    - compatible

properties:
  compatible:
    items:
      - const: qcom,tgu
      - const: arm,primecell

  reg:
    maxItems: 1

  clocks:
    maxItems: 1

  clock-names:
    items:
      - const: apb_pclk

required:
  - compatible
  - reg
  - clocks
  - clock-names

additionalProperties: false

examples:
  - |
    tgu@10b0e000 {
        compatible = "qcom,tgu", "arm,primecell";
        reg = <0x10b0e000 0x1000>;

        clocks = <&aoss_qmp>;
        clock-names = "apb_pclk";
    };
...
```

## Documentation/devicetree/bindings/clock/qcom,clk-gp-mnd.yaml
```yaml
# SPDX-License-Identifier: (GPL-2.0-only OR BSD-2-Clause)
%YAML 1.2
---
$id: http://devicetree.org/schemas/clock/qcom,clk-gp-mnd.yaml#
$schema: http://devicetree.org/meta-schemas/core.yaml#

title: Qualcomm Peripheral Web's PDM GP_MN Clock Divider

maintainers:
  - Taniya Das <taniya.das@oss.qualcomm.com>

description: |
  The Peripheral Web's PDM GP_MN clock divider receives an input clock
  (TCXO4) with frequency Fin and generates an output clock with
  frequency Fout = Fin * (M / N) and a duty cycle controlled by D
  and routed over a gpio pin.

  The divider is configured using three registers:

  - GP_MN_CLK_MDIV: holds the M value.
  - GP_MN_CLK_NDIV: holds the ones complement of (N - M).
  - GP_MN_CLK_DUTY: holds the D value.

  For every N input clock cycles the GP_MN produces M output clock
  cycles. D is the number of native clock cycles in which the GP_MN
  output is low, counted over 2^13 native clock cycles.

  Hardware constraints:

    M <= 511
    N <= 8191
    N > 2 * M
    M < D < (N - M)
    M and N must be coprime (no common divisor)

properties:
  compatible:
    const: qcom,clk-gp-mnd

  reg:
    maxItems: 1

  clocks:
    items:
      - description: PDM XO4 source clock
      - description: PDM AHB bus clock for register access

  clock-names:
    items:
      - const: pdm_clk
      - const: ahb_clk

  '#clock-cells':
    const: 0

  clock-output-names:
    maxItems: 1

  pinctrl-0:
    description: Pin configuration for the GP_MN output in the active state.

  pinctrl-names:
    items:
      - const: active

  assigned-clocks:
    maxItems: 1
    description: Parent clock phandle used to set the input frequency.

  assigned-clock-rates:
    maxItems: 1
    description: |
      Rate for the parent clock in Hz.
      Supported rates: 19200000, 9600000, 6400000, 4800000.

required:
  - compatible
  - reg
  - clocks
  - clock-names
  - '#clock-cells'
  - clock-output-names
  - pinctrl-0
  - pinctrl-names
  - assigned-clocks
  - assigned-clock-rates

additionalProperties: false

examples:
  - |
    #include <dt-bindings/clock/qcom,gcc-sdm845.h>
    gp_mn: clock-controller@88d3000 {
        compatible = "qcom,clk-gp-mnd";
        reg = <0x88d3000 0xc>;
        clocks = <&gcc GCC_PDM_XO4_CLK>,
                 <&gcc GCC_PDM_AHB_CLK>;
        clock-names = "pdm_clk", "ahb_clk";
        clock-output-names = "gp_mn_clk";
        pinctrl-0 = <&gp_mn_pin_active>;
        pinctrl-names = "active";
        assigned-clocks = <&gcc GCC_PDM_XO4_CLK>;
        assigned-clock-rates = <4800000>;
        #clock-cells = <0>;
    };
```

## Documentation/devicetree/bindings/clock/qcom,shikra-audiocorecc.yaml
```yaml
# SPDX-License-Identifier: (GPL-2.0-only OR BSD-2-Clause)
%YAML 1.2
---
$id: http://devicetree.org/schemas/clock/qcom,shikra-audiocorecc.yaml#
$schema: http://devicetree.org/meta-schemas/core.yaml#

title: Audio Core Clock & Reset Controller for Qualcomm Shikra SoC

maintainers:
  - Imran Shaik <imran.shaik@oss.qualcomm.com>

description: |
  Audio core clock control module provides the clocks and resets
  on Qualcomm Shikra SoC platform.

  See also:
  - include/dt-bindings/clock/qcom,shikra-audiocorecc.h

properties:
  compatible:
    enum:
      - qcom,shikra-cqm-audiocorecc
      - qcom,shikra-cqs-audiocorecc

  clocks:
    items:
      - description: Board XO source
      - description: Board sleep clock
      - description: Audio ref clock source

  reg:
    maxItems: 2

  '#clock-cells':
    const: 1

  '#reset-cells':
    const: 1

required:
  - compatible
  - reg
  - '#clock-cells'
  - '#reset-cells'

additionalProperties: false

examples:
  - |
    #include <dt-bindings/clock/qcom,rpmcc.h>
    #include <dt-bindings/clock/qcom,shikra-gcc.h>
    clock-controller@a0a0000 {
      compatible = "qcom,shikra-cqm-audiocorecc";
      reg = <0x0a0a0000 0x10000>,
            <0x0a0b4000 0x1000>;
      clocks = <&rpmcc RPM_SMD_XO_CLK_SRC>,
               <&sleep_clk>,
               <&aud_ref_clk_src>;
      #clock-cells = <1>;
      #reset-cells = <1>;
    };
...
```

## Documentation/devicetree/bindings/display/bridge/lontium,lt8713sx.yaml
```yaml
# SPDX-License-Identifier: (GPL-2.0-only OR BSD-2-Clause)
%YAML 1.2
---
$id: http://devicetree.org/schemas/display/bridge/lontium,lt8713sx.yaml#
$schema: http://devicetree.org/meta-schemas/core.yaml#

title: Lontium LT8713SX Type-C/DP1.4 to Type-C/DP1.4/HDMI2.0/DP++ bridge-hub

maintainers:
  - Tony <syyang@lontium.com>

description:
  The Lontium LT8713SX is a Type-C/DP1.4 to Type-C/DP1.4/HDMI2.0 converter
  that integrates one DP input and up to three configurable output interfaces
  (DP1.4 / HDMI2.0 / DP++), with SST/MST functionality and audio support.

properties:
  compatible:
    enum:
      - lontium,lt8713sx

  reg:
    maxItems: 1

  vcc-supply:
    description: Regulator for 3.3V vcc.

  vdd-supply:
    description: Regulator for 1.1V vdd.

  reset-gpios:
    description: GPIO connected to active high RESET pin.

required:
  - compatible
  - reg

additionalProperties: false

examples:
  - |
    #include <dt-bindings/gpio/gpio.h>

    i2c {
        #address-cells = <1>;
        #size-cells = <0>;
        bridge@4f {
            compatible = "lontium,lt8713sx";
            reg = <0x4f>;
            reset-gpios = <&tlmm 6 GPIO_ACTIVE_HIGH>;
        };
    };
```

## Documentation/devicetree/bindings/display/panel/dlc,dlc0697.yaml
```yaml
# SPDX-License-Identifier: GPL-2.0-only OR BSD-2-Clause
%YAML 1.2
---
$id: http://devicetree.org/schemas/display/panel/dlc,dlc0697.yaml#
$schema: http://devicetree.org/meta-schemas/core.yaml#

title: DLC DLC0697 1080x1920 video-mode DSI panel

maintainers:
  - Arpit Saini <arpit.saini@oss.qualcomm.com>

allOf:
  - $ref: panel-common.yaml#

properties:
  compatible:
    const: dlc,dlc0697

  reg:
    maxItems: 1
    description: DSI virtual channel

  reset-gpios: true

  enable-gpios: true

  vddio-supply:
    description: I/O voltage supply (1.8V)

  bias-supply:
    description: LCD bias supply (3.3V), typically a GPIO-controlled fixed regulator

  port: true

required:
  - compatible
  - reg
  - reset-gpios
  - vddio-supply
  - port

additionalProperties: false

examples:
  - |
    #include <dt-bindings/gpio/gpio.h>

    dsi {
        #address-cells = <1>;
        #size-cells = <0>;

        panel@0 {
            compatible = "dlc,dlc0697";
            reg = <0>;

            reset-gpios = <&tlmm 41 GPIO_ACTIVE_LOW>;
            vddio-supply = <&vreg_l15>;

            port {
                panel_in: endpoint {
                    remote-endpoint = <&dsi0_out>;
                };
            };
        };
    };
...
```

## Documentation/devicetree/bindings/display/panel/ilitek,ili7807s.yaml
```yaml
# SPDX-License-Identifier: GPL-2.0-only OR BSD-2-Clause
%YAML 1.2
---
$id: http://devicetree.org/schemas/display/panel/ilitek,ili7807s.yaml#
$schema: http://devicetree.org/meta-schemas/core.yaml#

title: Ilitek ILI7807S-based DSI panels

maintainers:
  - Arpit Saini <arpit.saini@oss.qualcomm.com>

allOf:
  - $ref: panel-common.yaml#

properties:
  compatible:
    items:
      - enum:
          - dlc,dlc0697
      - const: ilitek,ili7807s

  reg:
    maxItems: 1
    description: DSI virtual channel

  reset-gpios: true

  backlight-en-gpios:
    description: Backlight enable GPIO (active high)

  vddi-supply:
    description: I/O voltage supply (1.8V)

  avdd-supply:
    description: Positive LCD bias supply (AVDD), typically +5.5V
      (range 4.5V to 6.3V)

  avee-supply:
    description: Negative LCD bias supply (AVEE), typically -5.5V
      (range -6.3V to -4.5V)

  port: true

required:
  - compatible
  - reg
  - reset-gpios
  - vddi-supply
  - avdd-supply
  - avee-supply
  - port

additionalProperties: false

examples:
  - |
    #include <dt-bindings/gpio/gpio.h>

    dsi {
        #address-cells = <1>;
        #size-cells = <0>;

        panel@0 {
            compatible = "dlc,dlc0697", "ilitek,ili7807s";
            reg = <0>;

            reset-gpios = <&tlmm 3 GPIO_ACTIVE_LOW>;
            backlight-en-gpios = <&tlmm 91 GPIO_ACTIVE_HIGH>;

            vddi-supply = <&pm4125_l15>;
            avdd-supply = <&avdd>;
            avee-supply = <&avee>;

            port {
                panel_in: endpoint {
                    remote-endpoint = <&dsi0_out>;
                };
            };
        };
    };
```

## Documentation/devicetree/bindings/firmware/qcom,generic-scmi.yaml
```yaml
# SPDX-License-Identifier: (GPL-2.0 OR BSD-2-Clause)
%YAML 1.2
---
$id: http://devicetree.org/schemas/firmware/qcom,generic-scmi.yaml#
$schema: http://devicetree.org/meta-schemas/core.yaml#

title: Qualcomm System Control and Management Interface(SCMI) Vendor Protocols Extension

maintainers:
  - Sibi Sankar <sibi.sankar@oss.qualcomm.com>
  - Pragnesh Papaniya <pragnesh.papaniya@oss.qualcomm.com>

properties:
  protocol@80:
    description:
      SCMI Qualcomm Generic Vendor Protocol which exposes a number of
      Qualcomm SoC specific features (such as memory bus scaling) through
      a mixture of pre-determined algorithm strings and param_id pairs
      hosted on the SCMI controller.
    $ref: '/schemas/firmware/arm,scmi.yaml#/$defs/protocol-node'
    unevaluatedProperties: false

    properties:
      reg:
        const: 0x80

additionalProperties: true
```
