## Documentation/devicetree/bindings/ptp/qcom,tsc.yaml
```yaml
# SPDX-License-Identifier: (GPL-2.0 OR BSD-2-Clause)
%YAML 1.2
---
$id: http://devicetree.org/schemas/ptp/qcom,tsc.yaml#
$schema: http://devicetree.org/meta-schemas/core.yaml#

title: Qualcomm Timestamp Counter Subsystem (TSCSS)

maintainers:
  - Imran Shaik <imran.shaik@oss.qualcomm.com>
  - Taniya Das <taniya.das@oss.qualcomm.com>

description:
  Qualcomm TSCSS is a time synchronization subsystem composed of two main
  blocks - the Time Stamp Counter (TSC) and the Event Timestamp Unit (ETU).

  The TSC block is a timestamp generator that maintains a running counter used
  for system timekeeping. The ETU block captures timestamps for external events
  using one of the available timestamp sources.

properties:
  compatible:
    enum:
      - qcom,tsc

  reg:
    maxItems: 2

  reg-names:
    items:
      - const: tsc
      - const: etu

  clocks:
    items:
      - description: TSC AHB clock
      - description: TSC cntr clock
      - description: TSC ETU clock

  clock-names:
    items:
      - const: cfg_ahb
      - const: cntr
      - const: etu

  interrupts:
    maxItems: 1

  interrupt-names:
    items:
      - const: etu_summary_irq

  qcom,tsc-nsec-update:
    description:
      Indicates the TSC counters have values in nanoseconds, rather than
      in secs and nanoseconds.
    type: boolean

  qcom,etu-slice:
    $ref: /schemas/types.yaml#/definitions/uint32-array
    description:
      Array of ETU slice numbers corresponding to the ETU sel.
      In case this property is not defined the sel number will be
      considered as the slice number for ETU offset calculation.

  qcom,etu-event-sel:
    $ref: /schemas/types.yaml#/definitions/uint32-array
    description:
      Array of ETU event sel numbers for the corresponding ETU slice
      numbers.

  qcom,etu-event-names:
    $ref: /schemas/types.yaml#/definitions/string-array
    description:
      ETU event sel names for the corresponding event sel numbers.

required:
  - compatible
  - reg
  - clocks
  - clock-names
  - interrupts
  - interrupt-names

additionalProperties: false

examples:
  - |
    #include <dt-bindings/interrupt-controller/arm-gic.h>
    tsc: tsc@1c80000 {
      compatible = "qcom,tsc";
      reg = <0x01c80000 0x2000>,
            <0x01ca0000 0x20000>;
      reg-names = "tsc", "etu";
      clocks = <&tscss_ahb_clock>, <&tscss_cntr_clock>,
               <&tscss_cntr_clock>;
      clock-names = "cfg_ahb", "cntr", "etu";
      interrupts = <GIC_SPI 766 IRQ_TYPE_EDGE_RISING>;
      interrupt-names = "etu_summary_irq";
      qcom,etu-slice = <10 11>;
      qcom,etu-event-sel = <10 11>;
      qcom,etu-event-names = "gps_pps", "tod_pps";
      qcom,tsc-nsec-update;
    };
```

## Documentation/devicetree/bindings/soc/qcom/qcom,eud.yaml
```yaml
# SPDX-License-Identifier: (GPL-2.0 OR BSD-2-Clause)
%YAML 1.2
---
$id: http://devicetree.org/schemas/soc/qcom/qcom,eud.yaml#
$schema: http://devicetree.org/meta-schemas/core.yaml#

title: Qualcomm Embedded USB Debugger

maintainers:
  - Souradeep Chowdhury <quic_schowdhu@quicinc.com>

description:
  This binding is used to describe the Qualcomm Embedded USB Debugger, which is
  mini USB-hub implemented on chip to support USB-based debug capabilities.

properties:
  compatible:
    items:
      - enum:
          - qcom,sc7280-eud
      - const: qcom,eud

  reg:
    items:
      - description: EUD Base Register Region
      - description: EUD Mode Manager Register

  interrupts:
    description: EUD interrupt
    maxItems: 1

  ports:
    $ref: /schemas/graph.yaml#/properties/ports
    description:
      These ports is to be attached to the endpoint of the DWC3 controller node
      and type C connector node. The controller has the "usb-role-switch"
      property.

    properties:
      port@0:
        $ref: /schemas/graph.yaml#/properties/port
        description: This port is to be attached to the DWC3 controller.

      port@1:
        $ref: /schemas/graph.yaml#/properties/port
        description: This port is to be attached to the type C connector.

  '#address-cells':
    const: 1

  '#size-cells':
    const: 0

patternProperties:
  "^eud-path@[0-1]$":
    type: object
    description:
      Represents one High-Speed UTMI path that EUD intercepts. Use eud-path nodes
      to associate role-switching behavior with specific port connections, allowing
      EUD to manage role transitions independently for each UTMI path.

    properties:
      reg:
        maxItems: 1
        description: Path number

      usb-role-switch:
        type: boolean
        description:
          Indicates that EUD should act as a role switch for this path.
          In device role, debug mode inserts the EUD hub into the UTMI path. In
          host role, the EUD hub is bypassed and UTMI traffic flows directly
          between the PHY and the USB controller.

      ports:
        $ref: /schemas/graph.yaml#/properties/ports
        description:
          These ports are to be attached to the endpoint of the USB controller node
          and USB connector node.

        properties:
          port@0:
            $ref: /schemas/graph.yaml#/properties/port
            description: This port is to be attached to the USB controller.

          port@1:
            $ref: /schemas/graph.yaml#/properties/port
            description: This port is to be attached to the USB connector.

    required:
      - reg
      - ports

    additionalProperties: false

required:
  - compatible
  - reg

oneOf:
  - required:
      - ports
  - required:
      - eud-path@0

additionalProperties: false

examples:
  - |
    eud@88e0000 {
        compatible = "qcom,sc7280-eud", "qcom,eud";
        reg = <0x88e0000 0x2000>,
              <0x88e2000 0x1000>;

        ports {
            #address-cells = <1>;
            #size-cells = <0>;
            port@0 {
                reg = <0>;
                eud_ep: endpoint {
                    remote-endpoint = <&usb2_role_switch>;
                };
            };

            port@1 {
                reg = <1>;
                eud_con: endpoint {
                    remote-endpoint = <&con_eud>;
                };
            };
        };
    };
```

## Documentation/devicetree/bindings/sound/qcom,q6apm-lpass-dais.yaml
```yaml
# SPDX-License-Identifier: GPL-2.0 OR BSD-2-Clause
%YAML 1.2
---
$id: http://devicetree.org/schemas/sound/qcom,q6apm-lpass-dais.yaml#
$schema: http://devicetree.org/meta-schemas/core.yaml#

title: Qualcomm DSP LPASS (Low Power Audio SubSystem) Audio Ports

maintainers:
  - Krzysztof Kozlowski <krzk@kernel.org>
  - Srinivas Kandagatla <srinivas.kandagatla@linaro.org>

allOf:
  - $ref: dai-common.yaml#

properties:
  compatible:
    enum:
      - qcom,q6apm-lpass-dais

  '#sound-dai-cells':
    const: 1

  '#address-cells':
    const: 1

  '#size-cells':
    const: 0

patternProperties:
  '^dai@[0-9]+$':
    type: object
    description:
      Optional per-DAI clock description for LPASS backends.

    properties:
      reg:
        description:
          Digital Audio Interface ID.

      clocks:
        minItems: 1
        maxItems: 3

      clock-names:
        description:
          Supported names are `mclk`, `bclk` and `eclk` depending on the
          interface clock required by the backend.
        minItems: 1
        maxItems: 3

    additionalProperties: false

required:
  - compatible
  - '#sound-dai-cells'

additionalProperties: false

unevaluatedProperties: false

examples:
  - |
    #include <dt-bindings/sound/qcom,q6dsp-lpass-ports.h>

    dais {
        compatible = "qcom,q6apm-lpass-dais";
        #address-cells = <1>;
        #size-cells = <0>;
        #sound-dai-cells = <1>;

        dai@0 {
            reg = <PRIMARY_MI2S_RX>;
            clocks = <&q6prmcc LPASS_CLK_ID_MCLK_1 LPASS_CLK_ATTRIBUTE_COUPLE_NO>;
            clock-names = "mclk";
        };
    };
```
