## Documentation/devicetree/bindings/sound/qcom,wsa885x-i2c.yaml
```yaml
# SPDX-License-Identifier: (GPL-2.0-only OR BSD-2-Clause)
%YAML 1.2
---
$id: http://devicetree.org/schemas/sound/qcom,wsa885x-i2c.yaml#
$schema: http://devicetree.org/meta-schemas/core.yaml#

title: Qualcomm WSA885x I2C smart speaker amplifier

maintainers:
  - Srinivas Kandagatla <srinivas.kandagatla@oss.qualcomm.com>
  - Prasad Kumpatla <prasad.kumpatla@oss.qualcomm.com>

description: |
  WSA885x is a Qualcomm Aqstic smart speaker amplifier with an I2C control
  interface and a digital audio interface exposed through ASoC DAI callbacks.

allOf:
  - $ref: dai-common.yaml#

properties:
  compatible:
    const: qcom,wsa885x-i2c

  reg:
    maxItems: 1

  '#sound-dai-cells':
    const: 0

  powerdown-gpios:
    description: GPIO controlling the SD_N powerdown pin.
    maxItems: 1

  interrupt-gpios:
    description: GPIO used for the codec interrupt output.
    maxItems: 1

  vdd-1p8-supply: true

  vdd-io-supply: true

  qcom,battery-config:
    $ref: /schemas/types.yaml#/definitions/uint32
    description: Speaker battery configuration, 1 for 1S and 2 for 2S.
    default: 1
    enum: [1, 2]

  qcom,wsa885x-init-table:
    $ref: /schemas/types.yaml#/definitions/uint32-array
    minItems: 2
    maxItems: 256
    description: |
      Sequence of register/value pairs applied during codec hardware
      initialization. Entries are encoded as alternating register address and
      register value cells. The number of entries must be even (register/value
      pairs); maxItems is 256 (128 pairs).

required:
  - compatible
  - reg
  - '#sound-dai-cells'
  - powerdown-gpios
  - interrupt-gpios
  - vdd-1p8-supply
  - vdd-io-supply

additionalProperties: false

examples:
  - |
    #include <dt-bindings/gpio/gpio.h>

    i2c {
        #address-cells = <1>;
        #size-cells = <0>;

        speaker@c {
            compatible = "qcom,wsa885x-i2c";
            reg = <0x0c>;
            #sound-dai-cells = <0>;
            powerdown-gpios = <&tlmm 11 GPIO_ACTIVE_LOW>;
            interrupt-gpios = <&tlmm 77 GPIO_ACTIVE_LOW>;
            vdd-1p8-supply = <&vreg_l2g_1p8>;
            vdd-io-supply = <&vreg_l1g_1p2>;
            qcom,battery-config = <1>;
            qcom,wsa885x-init-table = <0x8606 0x24 0x8626 0x24>;
        };
    };
...
```

## Documentation/devicetree/bindings/thermal/qcom,qmi-cooling.yaml
```yaml
# SPDX-License-Identifier: (GPL-2.0 OR BSD-2-Clause)
# Copyright 2023 (c), Linaro Limited

%YAML 1.2
---
$id: http://devicetree.org/schemas/thermal/qcom,qmi-cooling.yaml#
$schema: http://devicetree.org/meta-schemas/core.yaml#

title: Qualcomm QMI based thermal mitigation (TMD) cooling devices.

maintainers:
  - Caleb Connolly <caleb.connolly@linaro.org>
  - Gaurav Kohli <gaurav.kohli@oss.qualcomm.com>

description:
  Qualcomm QMI-based TMD cooling devices are used to mitigate thermal conditions
  across multiple remote subsystems. These devices operate based on junction temperature
  sensors (TSENS) associated with thermal zones for each subsystem.

  Each subnode corresponds to a control interface for a single instance of the TMD
  service running on a remote subsystem.

definitions:
  tmd:
    type: object
    description: |
      A single Thermal Mitigation Device exposed by a remote subsystem.
    properties:
      label:
        maxItems: 1
      "#cooling-cells":
        $ref: /schemas/thermal/thermal-cooling-devices.yaml#/properties/#cooling-cells
      phandle: true

    required:
      - label
      - "#cooling-cells"

    additionalProperties: false

properties:
  compatible:
    enum:
      - qcom,qmi-cooling-modem
      - qcom,qmi-cooling-cdsp

  vdd:
    $ref: "#/definitions/tmd"
    description:
      Modem processor temperature TMD
    properties:
      label:
        const: modem

required:
  - compatible

allOf:
  - if:
      properties:
        compatible:
          contains:
            const: qcom,qmi-cooling-cdsp
    then:
      properties:
        cdsp_sw:
          $ref: "#/definitions/tmd"
          description:
            CDSP software TMD
          properties:
            label:
              const: cdsp_sw

unevaluatedProperties: false

examples:
  - |
    remoteproc-cdsp {
        cooling {
            compatible = "qcom,qmi-cooling-cdsp";

            cdsp_sw0: cdsp_sw {
              label = "cdsp_sw";
              #cooling-cells = <2>;
            };
        };
    };

    remoteproc-cdsp1 {
        cooling {
            compatible = "qcom,qmi-cooling-cdsp1";

            cdsp_sw1: cdsp_sw {
              label = "cdsp_sw";
              #cooling-cells = <2>;
            };
        };
    };
...
```

## drivers/acpi/arm64/Kconfig
```kconfig
# SPDX-License-Identifier: GPL-2.0-only
#
# ACPI Configuration for ARM64
#

config ACPI_IORT
	bool

config ACPI_GTDT
	bool

config ACPI_AGDI
	bool "Arm Generic Diagnostic Dump and Reset Device Interface"
	depends on ARM_SDE_INTERFACE
	help
	  Arm Generic Diagnostic Dump and Reset Device Interface (AGDI) is
	  a standard that enables issuing a non-maskable diagnostic dump and
	  reset command.

	  If set, the kernel parses AGDI table and listens for the command.

config ACPI_AEST
       bool "ARM Error Source Table Support"
       depends on ARM64_RAS_EXTN

       help
         The Arm Error Source Table (AEST) provides details on ACPI
         extensions that enable kernel-first handling of errors in a
         system that supports the Armv8 RAS extensions.

         If set, the kernel will report and log hardware errors.

config ACPI_APMT
	bool
```

## drivers/hwtracing/qcom/Kconfig
```kconfig
# SPDX-License-Identifier: GPL-2.0-only
#
# QCOM specific hwtracing drivers
#
menu "Qualcomm specific hwtracing drivers"

config QCOM_TGU
	tristate "QCOM Trigger Generation Unit driver"
	depends on ARCH_QCOM || COMPILE_TEST
	depends on ARM_AMBA
	help
	  This driver provides support for Trigger Generation Unit that is
	  used to detect patterns or sequences on a given set of signals.
	  TGU is used to monitor a particular bus within a given region to
	  detect illegal transaction sequences or slave responses. It is also
	  used to monitor a data stream to detect protocol violations and to
	  provide a trigger point for centering data around a specific event
	  within the trace data buffer.

endmenu
```

## drivers/ras/aest/Kconfig
```kconfig
# SPDX-License-Identifier: GPL-2.0
#
# ARM Error Source Table Support
#
# Copyright (c) 2025, Alibaba Group.
#

config AEST
	tristate "ARM AEST Driver"
	depends on ACPI_AEST || OF_AEST
	depends on RAS
	help
	  The Arm Error Source Table (AEST) provides details on ACPI
	  extensions that enable kernel-first handling of errors in a
	  system that supports the Armv8 RAS extensions.

	  If set, the kernel will report and log hardware errors.

config OF_AEST
        bool "ARM Error Source Table DT Support"
        depends on ARM64_RAS_EXTN && OF
        help
          Enable support for discovering ARM RAS error sources using the
          Device Tree based Arm Error Source Table (AEST) specification.
          This allows the kernel to enumerate and manage hardware error
          reporting blocks described in firmware for ARMv8 and later
          systems. Select this option if your platform describes AEST
          nodes in Device Tree and relies on RAS error handling.
```
