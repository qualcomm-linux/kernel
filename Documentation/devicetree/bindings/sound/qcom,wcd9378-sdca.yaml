## Documentation/devicetree/bindings/soundwire/qcom,soundwire.yaml
```yaml
# SPDX-License-Identifier: (GPL-2.0-only OR BSD-2-Clause)
%YAML 1.2
---
$id: http://devicetree.org/schemas/soundwire/qcom,soundwire.yaml#
$schema: http://devicetree.org/meta-schemas/core.yaml#

title: Qualcomm SoundWire Controller

maintainers:
  - Srinivas Kandagatla <srinivas.kandagatla@linaro.org>
  - Srinivasa Rao Mandadapu <quic_srivasam@quicinc.com>

description: |
  The Qualcomm SoundWire controller along with its board specific bus
  parameters.

  On v3.1.0 and later, two instances may pair as a lane-provider/consumer
  pair sharing one SWR_CLK, to expose a bus with more than two DATA lanes.
  The consumer references the provider via qcom,secondary-lanes; the provider
  is marked by #qcom,swrm-lane-cells.

properties:
  compatible:
    oneOf:
      - enum:
          - qcom,soundwire-v1.3.0
          - qcom,soundwire-v1.5.0
          - qcom,soundwire-v1.5.1
          - qcom,soundwire-v1.6.0
          - qcom,soundwire-v1.7.0
          - qcom,soundwire-v2.0.0
          - qcom,soundwire-v3.1.0
      - items:
          - enum:
              - qcom,soundwire-v2.1.0
              - qcom,soundwire-v2.2.0
          - const: qcom,soundwire-v2.0.0

  reg:
    maxItems: 1

  interrupts:
    minItems: 1
    items:
      - description: specify the SoundWire controller core.
      - description: specify the Soundwire controller wake IRQ.

  interrupt-names:
    minItems: 1
    items:
      - const: core
      - const: wakeup

  clocks:
    items:
      - description: iface clock

  clock-names:
    items:
      - const: iface

  resets:
    items:
      - description: SWR_AUDIO_CGCR RESET

  reset-names:
    items:
      - const: swr_audio_cgcr

  '#sound-dai-cells':
    const: 1

  '#address-cells':
    const: 2

  '#size-cells':
    const: 0

  wakeup-source: true

  qcom,din-ports:
    $ref: /schemas/types.yaml#/definitions/uint32
    description: count of data in ports
    deprecated: true

  qcom,dout-ports:
    $ref: /schemas/types.yaml#/definitions/uint32
    description: count of data out ports
    deprecated: true

  qcom,ports-word-length:
    $ref: /schemas/types.yaml#/definitions/uint8-array
    description:
      Size of payload channel sample.
      Value of 0xff indicates that this option is not implemented
      or applicable for the respective data port.
      More info in MIPI Alliance SoundWire 1.0 Specifications.
    minItems: 3
    maxItems: 17

  qcom,ports-sinterval-low:
    $ref: /schemas/types.yaml#/definitions/uint8-array
    description:
      Sample interval (only lowest byte) of each data port.
      Out ports followed by In ports. Used for Sample Interval calculation.
      Value of 0xff indicates that this option is not implemented
      or applicable for the respective data port.
      More info in MIPI Alliance SoundWire 1.0 Specifications.
    minItems: 3
    maxItems: 17

  qcom,ports-sinterval:
    $ref: /schemas/types.yaml#/definitions/uint16-array
    description:
      Sample interval of each data port.
      Out ports followed by In ports. Used for Sample Interval calculation.
      Value of 0xffff indicates that this option is not implemented
      or applicable for the respective data port.
      More info in MIPI Alliance SoundWire 1.0 Specifications.
    minItems: 3
    maxItems: 17

  qcom,ports-offset1:
    $ref: /schemas/types.yaml#/definitions/uint8-array
    description:
      Payload transport window offset1 of each data port.
      Out ports followed by In ports.
      Value of 0xff indicates that this option is not implemented
      or applicable for the respective data port.
      More info in MIPI Alliance SoundWire 1.0 Specifications.
    minItems: 3
    maxItems: 17

  qcom,ports-offset2:
    $ref: /schemas/types.yaml#/definitions/uint8-array
    description:
      Payload transport window offset2 of each data port.
      Out ports followed by In ports.
      Value of 0xff indicates that this option is not implemented
      or applicable for the respective data port.
      More info in MIPI Alliance SoundWire 1.0 Specifications.
    minItems: 3
    maxItems: 17

  qcom,ports-lane-control:
    $ref: /schemas/types.yaml#/definitions/uint8-array
    description:
      Identify which data lane the data port uses.
      Out ports followed by In ports.
      Value of 0xff indicates that this option is not implemented
      or applicable for the respective data port.
      More info in MIPI Alliance SoundWire 1.0 Specifications.
    minItems: 3
    maxItems: 17

  qcom,ports-block-pack-mode:
    $ref: /schemas/types.yaml#/definitions/uint8-array
    description:
      Indicate the block packing mode.
      0 to indicate Blocks are per Channel
      1 to indicate Blocks are per Port.
      Out ports followed by In ports.
      Value of 0xff indicates that this option is not implemented
      or applicable for the respective data port.
      More info in MIPI Alliance SoundWire 1.0 Specifications.
    minItems: 3
    maxItems: 17
    items:
      oneOf:
        - minimum: 0
          maximum: 1
        - const: 0xff

  qcom,ports-hstart:
    $ref: /schemas/types.yaml#/definitions/uint8-array
    description:
      Identifying lowerst numbered column in SoundWire Frame,
      i.e. left edge of the Transport sub-frame for each port.
      Out ports followed by In ports.
      Value of 0xff indicates that this option is not implemented
      or applicable for the respective data port.
      More info in MIPI Alliance SoundWire 1.0 Specifications.
    minItems: 3
    maxItems: 17
    items:
      oneOf:
        - minimum: 0
          maximum: 15
        - const: 0xff

  qcom,ports-hstop:
    $ref: /schemas/types.yaml#/definitions/uint8-array
    description:
      Identifying highest numbered column in SoundWire Frame,
      i.e. the right edge of the Transport
      sub-frame for each port. Out ports followed by In ports.
      Value of 0xff indicates that this option is not implemented
      or applicable for the respective data port.
      More info in MIPI Alliance SoundWire 1.0 Specifications.
    minItems: 3
    maxItems: 17
    items:
      oneOf:
        - minimum: 0
          maximum: 15
        - const: 0xff

  qcom,ports-block-group-count:
    $ref: /schemas/types.yaml#/definitions/uint8-array
    description:
      In range 1 to 4 to indicate how many sample intervals are combined
      into a payload. Out ports followed by In ports.
      Value of 0xff indicates that this option is not implemented
      or applicable for the respective data port.
      More info in MIPI Alliance SoundWire 1.0 Specifications.
    minItems: 3
    maxItems: 17
    items:
      oneOf:
        - minimum: 0
          maximum: 4
        - const: 0xff

  qcom,ports-ch-mask:
    $ref: /schemas/types.yaml#/definitions/uint8-array
    description:
      Per-port intrinsic SoundWire channel mask.  Used when programming
      the master DPn PORT_CTRL channel-enable field so a port's slot
      layout (e.g. stereo PDM) is transmitted independently of the PCM
      stream's channel count.  0xff means the option is not applicable
      for that port.
    minItems: 3
    maxItems: 17

  '#qcom,swrm-lane-cells':
    description:
      Marks this node as a lane provider.  The single cell in a referring
      phandle is the provider-local DATA lane index.
    const: 1

  qcom,secondary-lanes:
    description:
      Extra DATA lanes borrowed from other Qualcomm SoundWire instances
      (lane providers).  Each entry is a <provider, lane> pair.  The N-th
      entry becomes bus lane (num-lanes + N); slave port mappings must
      follow this order.
    $ref: /schemas/types.yaml#/definitions/phandle-array
    items:
      items:
        - description: phandle of a Qualcomm SoundWire lane provider
        - description: provider-local DATA lane index
    minItems: 1
    maxItems: 6

  num-lanes:
    description:
      Number of DATA lanes this instance exposes locally.  Optional,
      defaults to 2.  On a bus master, bus lanes 0..num-lanes-1 come
      from this instance; higher-numbered lanes come from
      qcom,secondary-lanes entries in order.
    $ref: /schemas/types.yaml#/definitions/uint32
    minimum: 1
    maximum: 8

  label:
    maxItems: 1

required:
  - compatible
  - reg
  - interrupts
  - clocks
  - clock-names

allOf:
  - $ref: soundwire-controller.yaml#
  - if:
      required:
        - '#qcom,swrm-lane-cells'
    then:
      properties:
        qcom,secondary-lanes: false
        '#sound-dai-cells': false
        qcom,ports-word-length: false
        qcom,ports-sinterval-low: false
        qcom,ports-sinterval: false
        qcom,ports-offset1: false
        qcom,ports-offset2: false
        qcom,ports-lane-control: false
        qcom,ports-block-pack-mode: false
        qcom,ports-hstart: false
        qcom,ports-hstop: false
        qcom,ports-block-group-count: false
        qcom,ports-ch-mask: false
    else:
      required:
        - '#sound-dai-cells'
        - qcom,ports-offset1
        - qcom,ports-offset2
      oneOf:
        - required:
            - qcom,ports-sinterval-low
        - required:
            - qcom,ports-sinterval
  - if:
      anyOf:
        - required:
            - '#qcom,swrm-lane-cells'
        - required:
            - qcom,secondary-lanes
    then:
      properties:
        compatible:
          contains:
            const: qcom,soundwire-v3.1.0

unevaluatedProperties: false

examples:
  - |
    #include <dt-bindings/interrupt-controller/arm-gic.h>
    #include <dt-bindings/interrupt-controller/irq.h>
    #include <dt-bindings/clock/qcom,lpassaudiocc-sc7280.h>

    soundwire@3210000 {
        compatible = "qcom,soundwire-v1.6.0";
        reg = <0x03210000 0x2000>;

        interrupts = <GIC_SPI 155 IRQ_TYPE_LEVEL_HIGH>,
                     <&pdc 130 IRQ_TYPE_LEVEL_HIGH>;

        interrupt-names = "core", "wakeup";

        clocks = <&lpass_rx_macro>;
        clock-names = "iface";

        resets = <&lpass_audiocc LPASS_AUDIO_SWR_RX_CGCR>;
        reset-names = "swr_audio_cgcr";

        qcom,ports-word-length =        /bits/ 8 <0x01 0x07 0x04 0xff 0xff>;
        qcom,ports-sinterval-low =      /bits/ 8 <0x03 0x3f 0x1f 0x03 0x03>;
        qcom,ports-offset1 =            /bits/ 8 <0x00 0x00 0x0b 0x01 0x01>;
        qcom,ports-offset2 =            /bits/ 8 <0x00 0x00 0x0b 0x00 0x00>;
        qcom,ports-lane-control =       /bits/ 8 <0x01 0x00 0x00 0x00 0x00>;
        qcom,ports-block-pack-mode =    /bits/ 8 <0xff 0x00 0x01 0xff 0xff>;
        qcom,ports-hstart =             /bits/ 8 <0xff 0x03 0xff 0xff 0xff>;
        qcom,ports-hstop =              /bits/ 8 <0xff 0x06 0xff 0xff 0xff>;
        qcom,ports-block-group-count =  /bits/ 8 <0xff 0xff 0xff 0xff 0x00>;

        #sound-dai-cells = <1>;
        #address-cells = <2>;
        #size-cells = <0>;

        codec@0,4 {
            compatible = "sdw20217010d00";
            reg = <0 4>;
            qcom,rx-port-mapping = <1 2 3 4 5>;
        };
    };

  - |
    #include <dt-bindings/interrupt-controller/arm-gic.h>

    /* Provider IP: contributes two DATA lanes to another master's bus */
    swr_lane_provider: soundwire@6ad0000 {
        compatible = "qcom,soundwire-v3.1.0";
        reg = <0x06ad0000 0x10000>;
        interrupts = <GIC_SPI 100 IRQ_TYPE_LEVEL_HIGH>;
        clocks = <&lpass_provider_clk>;
        clock-names = "iface";
        resets = <&lpass_audiocc 4>;
        reset-names = "swr_audio_cgcr";
        #qcom,swrm-lane-cells = <1>;
        #address-cells = <2>;
        #size-cells = <0>;
    };

    /* Bus master consuming both lanes of the provider above */
    soundwire@6ac0000 {
        compatible = "qcom,soundwire-v3.1.0";
        reg = <0x06ac0000 0x10000>;
        interrupts = <GIC_SPI 99 IRQ_TYPE_LEVEL_HIGH>;
        clocks = <&lpass_master_clk>;
        clock-names = "iface";
        resets = <&lpass_audiocc 3>;
        reset-names = "swr_audio_cgcr";
        qcom,secondary-lanes = <&swr_lane_provider 0>,
                               <&swr_lane_provider 1>;

        qcom,ports-word-length =        /bits/ 8 <0x01 0x07 0x04>;
        qcom,ports-sinterval-low =      /bits/ 8 <0x03 0x3f 0x1f>;
        qcom,ports-offset1 =            /bits/ 8 <0x00 0x00 0x0b>;
        qcom,ports-offset2 =            /bits/ 8 <0x00 0x00 0x0b>;
        qcom,ports-lane-control =       /bits/ 8 <0x00 0x02 0x03>;

        #sound-dai-cells = <1>;
        #address-cells = <2>;
        #size-cells = <0>;

        codec@0,4 {
            compatible = "sdw20217010d00";
            reg = <0 4>;
            qcom,rx-port-mapping = <1 2 3>;
        };
    };
```

## Documentation/devicetree/bindings/usb/cypress,cypd6129.yaml
```yaml
# SPDX-License-Identifier: (GPL-2.0 OR BSD-2-Clause)
%YAML 1.2
---
$id: http://devicetree.org/schemas/usb/cypress,cypd6129.yaml#
$schema: http://devicetree.org/meta-schemas/core.yaml#

title: Cypress cypd6129/cypd6229 Type-C Controller

maintainers:
  - Akash Kumar <akash.kumar@oss.qualcomm.com>

description:
  The Cypress cypd6129 and cypd6229 are dual Type-C PD controllers that are
  controlled via an I2C interface.

properties:
  compatible:
    oneOf:
      - const: cypress,cypd6129
      - items:
          - const: cypress,cypd6229
          - const: cypress,cypd6129

  '#address-cells':
    const: 1

  '#size-cells':
    const: 0

  reg:
    maxItems: 1

  interrupts:
    maxItems: 1

  pinctrl-0: true
  pinctrl-1: true

  pinctrl-names:
    minItems: 1
    items:
      - const: default
      - const: sleep

patternProperties:
  '^connector@[01]$':
    $ref: /schemas/connector/usb-connector.yaml#
    required:
      - reg

required:
  - compatible
  - reg
  - interrupts

anyOf:
  - required:
      - connector@0
  - required:
      - connector@1

additionalProperties: false

examples:
  - |
    #include <dt-bindings/interrupt-controller/irq.h>
    i2c {
      #address-cells = <1>;
      #size-cells = <0>;

      typec@40 {
        compatible = "cypress,cypd6129";
        reg = <0x40>;
        interrupts-extended = <&tlmm 136 IRQ_TYPE_LEVEL_LOW>;
        pinctrl-0 = <&usb0_intr_state>;
        pinctrl-names = "default";
        #address-cells = <1>;
        #size-cells = <0>;

        connector@0 {
          compatible = "usb-c-connector";
          reg = <0>;
          label = "USB-C";
          data-role = "dual";
          power-role = "dual";
          wakeup-source;
          ports {
            #address-cells = <1>;
            #size-cells = <0>;
            port@0 {
              reg = <0>;
              endpoint {
                remote-endpoint = <&usb_role_switch0>;
              };
            };
          };
        };
      };
    };
```
