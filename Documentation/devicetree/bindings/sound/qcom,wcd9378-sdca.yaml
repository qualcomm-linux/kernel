## Documentation/devicetree/bindings/usb/onnn,fusb15201.yaml
```yaml
# SPDX-License-Identifier: GPL-2.0-only OR BSD-2-Clause
%YAML 1.2
---
$id: http://devicetree.org/schemas/usb/onnn,fusb15201.yaml#
$schema: http://devicetree.org/meta-schemas/core.yaml#

title: onsemi FUSB15201 dual-port Type-C and Power Delivery controller

maintainers:
  - Shawn Guo <shengchao.guo@oss.qualcomm.com>

description:
  The FUSB15201 is an autonomous dual-port USB Type-C and Power Delivery
  controller. It runs the Type-C state machine and the Power Delivery policy
  engine on an integrated microcontroller, so the host is not involved in
  Power Delivery messaging. Over I2C it reports the attach state, CC
  orientation, data and power roles, faults and the VBUS voltage of each of
  its two ports, and accepts commands to initiate data and power role swaps.

  The two ports are described as connector child nodes, addressed 0 for port A
  and 1 for port B. A board that wires up only one of the two ports describes
  only the corresponding connector.

properties:
  compatible:
    const: onnn,fusb15201

  reg:
    maxItems: 1

  interrupts:
    maxItems: 1
    description:
      Interrupt line shared by both ports, driven by the I2C_INT pin. The pin
      is active low and stays asserted until every pending interrupt has been
      cleared, so it has to be described as level triggered.

  '#address-cells':
    const: 1

  '#size-cells':
    const: 0

patternProperties:
  '^connector@[01]$':
    type: object
    $ref: /schemas/connector/usb-connector.yaml#
    unevaluatedProperties: false

    properties:
      compatible:
        const: usb-c-connector

      reg:
        maximum: 1
        description:
          0 for port A, 1 for port B.

    required:
      - reg

required:
  - compatible
  - reg
  - interrupts
  - '#address-cells'
  - '#size-cells'

anyOf:
  - required: [connector@0]
  - required: [connector@1]

additionalProperties: false

examples:
  - |
    #include <dt-bindings/interrupt-controller/irq.h>

    i2c {
        #address-cells = <1>;
        #size-cells = <0>;

        typec@50 {
            compatible = "onnn,fusb15201";
            reg = <0x50>;
            interrupts-extended = <&pmic_gpios 8 IRQ_TYPE_LEVEL_LOW>;

            #address-cells = <1>;
            #size-cells = <0>;

            connector@0 {
                compatible = "usb-c-connector";
                reg = <0>;
                label = "USB-C0";
                power-role = "dual";
                data-role = "dual";
                try-power-role = "sink";

                ports {
                    #address-cells = <1>;
                    #size-cells = <0>;

                    port@0 {
                        reg = <0>;

                        endpoint {
                            remote-endpoint = <&usb_0_dwc3_hs>;
                        };
                    };

                    port@1 {
                        reg = <1>;

                        endpoint {
                            remote-endpoint = <&usb_0_qmpphy_ss>;
                        };
                    };
                };
            };

            connector@1 {
                compatible = "usb-c-connector";
                reg = <1>;
                label = "USB-C1";
                power-role = "dual";
                data-role = "dual";
                try-power-role = "sink";

                ports {
                    #address-cells = <1>;
                    #size-cells = <0>;

                    port@0 {
                        reg = <0>;

                        endpoint {
                            remote-endpoint = <&usb_1_dwc3_hs>;
                        };
                    };

                    port@1 {
                        reg = <1>;

                        endpoint {
                            remote-endpoint = <&usb_1_qmpphy_ss>;
                        };
                    };
                };
            };
        };
    };
...
```

## Documentation/devicetree/bindings/virtio/qcom,dcp-virtio.yaml
```yaml
# SPDX-License-Identifier: GPL-2.0-only OR BSD-2-Clause
%YAML 1.2
---
$id: http://devicetree.org/schemas/virtio/qcom,dcp-virtio.yaml#
$schema: http://devicetree.org/meta-schemas/core.yaml#

title: Qualcomm DCP VirtIO transport

maintainers:
  - Jayant Shekhar <jayant.shekhar@oss.qualcomm.com>

description: |
  Qualcomm DCP VirtIO transport. The IPCC power-notify channel and
  associated interrupts are required before the transport can access its
  MMIO registers. This is a Qualcomm-specific transport and must not use the
  generic virtio-mmio driver. The DCP VirtIO function is described as a child
  node and is assigned to the registered VirtIO device by this transport.

properties:
  compatible:
    const: qcom,dcp-virtio

  reg:
    maxItems: 1

  interrupts-extended:
    minItems: 2
    maxItems: 2
    description: The VirtIO-MMIO and DCP power-notify interrupts, in that order.

  iommus:
    maxItems: 1

  iommu-ranges:
    $ref: /schemas/types.yaml#/definitions/uint32-array
    description: |
      The firmware-visible IOVA range, specified as a four-cell tuple
      containing a 64-bit IOVA base followed by a 64-bit range size.
    items:
      - description: IOVA base, high cell
        $ref: /schemas/types.yaml#/definitions/uint32
      - description: IOVA base, low cell
        $ref: /schemas/types.yaml#/definitions/uint32
      - description: IOVA range size, high cell
        $ref: /schemas/types.yaml#/definitions/uint32
      - description: IOVA range size, low cell
        $ref: /schemas/types.yaml#/definitions/uint32

  dma-coherent: true

  mboxes:
    maxItems: 1

  mbox-names:
    const: dcp-power-tx

  dcp-subsystem:
    $ref: ../display/msm/qcom,dcp.yaml#

required:
  - compatible
  - reg
  - interrupts-extended
  - iommus
  - iommu-ranges
  - dma-coherent
  - mboxes
  - mbox-names
  - dcp-subsystem

additionalProperties: false

examples:
  - |
    #include <dt-bindings/gpio/gpio.h>
    #include <dt-bindings/interrupt-controller/arm-gic.h>
    #include <dt-bindings/interrupt-controller/irq.h>
    #include <dt-bindings/mailbox/qcom-ipcc.h>

    virtio@9be8000 {
        compatible = "qcom,dcp-virtio";
        reg = <0x09be8000 0x1000>;
        interrupts-extended = <&intc GIC_ESPI 956 IRQ_TYPE_LEVEL_HIGH>,
                              <&ipcc 13 5 IRQ_TYPE_EDGE_RISING>;
        iommus = <&apps_smmu 0x15a3 0x0>;
        iommu-ranges = <0x0 0x84000000 0x0 0x04000000>;
        dma-coherent;
        mboxes = <&ipcc 13 5>;
        mbox-names = "dcp-power-tx";

        dcp-subsystem {
            compatible = "virtio,device34";
            iommus = <&apps_smmu 0x400 0x2>;

            #address-cells = <1>;
            #size-cells = <0>;

            ports {
                #address-cells = <1>;
                #size-cells = <0>;

                port@0 {
                    reg = <0>;
                    dcp_intf0_out: endpoint {
                        remote-endpoint = <&panel_dcp_in>;
                    };
                };
            };

            dsi@0 {
                reg = <0>;
                #address-cells = <1>;
                #size-cells = <0>;

                panel@0 {
                    compatible = "novatek,nt37801";
                    reg = <0>;

                    vddio-supply = <&vreg_l12b_1p8>;
                    vci-supply = <&vreg_l13b_3p0>;
                    vdd-supply = <&display_panel_vdd>;
                    reset-gpios = <&tlmm 210 GPIO_ACTIVE_LOW>;

                    port {
                        panel_dcp_in: endpoint {
                            remote-endpoint = <&dcp_intf0_out>;
                        };
                    };
                };
            };
        };
    };
```

## drivers/interconnect/Kconfig
```kconfig
# SPDX-License-Identifier: GPL-2.0-only
menuconfig INTERCONNECT
	bool "On-Chip Interconnect management support"
	help
	  Support for management of the on-chip interconnects.

	  This framework is designed to provide a generic interface for
	  managing the interconnects in a SoC.

	  If unsure, say no.

if INTERCONNECT

source "drivers/interconnect/imx/Kconfig"
source "drivers/interconnect/mediatek/Kconfig"
source "drivers/interconnect/qcom/Kconfig"
source "drivers/interconnect/samsung/Kconfig"

config INTERCONNECT_CLK
	tristate
	depends on COMMON_CLK
	help
	  Support for wrapping clocks into the interconnect nodes.

config INTERCONNECT_BW_LIMIT
	bool "Interconnect bandwidth limiter sysfs interface"
	default y
	help
	  Expose sysfs nodes per interconnect path that allow userspace to
	  place upper bandwidth limits on client voting.

	  This interface is disabled by default. Say Y to allow userspace
	  to opt in to controlling interconnect bandwidth limits.

endif
```

## drivers/power/reset/pscrr/Kconfig
```kconfig
# SPDX-License-Identifier: GPL-2.0-only
menuconfig PSCRR
	bool "Power State Change Reasons Recording (PSCRR) Framework"
	depends on POWER_RESET
	help
	  Enables the Power State Change Reasons Recording (PSCRR) framework.

	  PSCRR records why the system last shut down or rebooted into
	  non-volatile storage, so the reason survives the reset and can be
	  read by the bootloader or early user space on the next boot. Reasons
	  come from software (thermal or regulator hardware-protection events,
	  a watchdog pretimeout, a kernel panic, a controlled reboot) or from
	  hardware reset-cause registers (PMIC, SoC reset controller, watchdog).

	  It helps whenever the real cause would otherwise be lost or ambiguous
	  on the next boot, for example:

	  - the reset is abrupt and block storage (eMMC/NAND) may not survive
	    it; on systems that can detect the event in time - such as an
	    imminent power loss with a short backup-capacitor window - the
	    reason can still be persisted first;

	  - the hardware does not preserve the cause and the boot looks like a
	    plain power-on reset, e.g. a watchdog pretimeout that escalates
	    into a panic reboot would otherwise be indistinguishable from a
	    POR.

	  The framework is extensible and exposes software-defined and
	  hardware-reported reasons through one interface. Sudden power cuts,
	  CPU freezes or other uncontrolled resets may still go unrecorded
	  unless hardware provides the reset cause.

	  If unsure, say N.
```

## drivers/ras/arm64/Kconfig
```kconfig
# SPDX-License-Identifier: GPL-2.0
#
# ARM RAS driver
#
# Copyright (c) 2025, Alibaba Group.
#

config ARM64_RAS_DT
	bool "ARM64 RAS Device Tree support"
	depends on ARM64_RAS_EXTN && OF
	help
	  Enable Device Tree support for the ARM64 RAS driver.

	  When selected, RAS error sources described in the Device Tree
	  (arm,ras-processor, arm,ras-smmu, arm,ras-gic etc) are registered
	  as platform devices at boot, allowing the driver to be used on
	  platforms without ACPI firmware.

config ARM64_RAS_DRIVER
	tristate "ARM64 RAS Driver"
	depends on ARM64 && (ACPI_AEST || ARM64_RAS_DT) && RAS
	help
	  This is the RAS driver for the arm64 architecture. It uses the
	  ARMv8 RAS extension register interface to discover, configure,
	  and handle hardware errors from processor caches, SMMUs, and GICs.

	  On ACPI systems the error source topology is provided by the AEST
	  ACPI table (requires ACPI_AEST).  On Device Tree systems it is
	  provided by "arm,ras-*" nodes in the DT root (requires ARM64_RAS_DT).

	  If set, the kernel will report and process hardware errors.
```
