## Documentation/devicetree/bindings/pci/qcom,pcie-x1e80100.yaml
```yaml
# SPDX-License-Identifier: (GPL-2.0-only OR BSD-2-Clause)
%YAML 1.2
---
$id: http://devicetree.org/schemas/pci/qcom,pcie-x1e80100.yaml#
$schema: http://devicetree.org/meta-schemas/core.yaml#

title: Qualcomm X1E80100 PCI Express Root Complex

maintainers:
  - Bjorn Andersson <andersson@kernel.org>
  - Manivannan Sadhasivam <mani@kernel.org>

description:
  Qualcomm X1E80100 SoC (and compatible) PCIe root complex controller is based on
  the Synopsys DesignWare PCIe IP.

properties:
  compatible:
    oneOf:
      - const: qcom,pcie-x1e80100
      - items:
          - enum:
              - qcom,glymur-pcie
          - const: qcom,pcie-x1e80100

  reg:
    minItems: 6
    maxItems: 6

  reg-names:
    items:
      - const: parf # Qualcomm specific registers
      - const: dbi # DesignWare PCIe registers
      - const: elbi # External local bus interface registers
      - const: atu # ATU address space
      - const: config # PCIe configuration space
      - const: mhi # MHI registers

  clocks:
    minItems: 6
    maxItems: 7

  clock-names:
    minItems: 6
    items:
      - const: aux # Auxiliary clock
      - const: cfg # Configuration clock
      - const: bus_master # Master AXI clock
      - const: bus_slave # Slave AXI clock
      - const: slave_q2a # Slave Q2A clock
      - const: noc_aggr # Aggre NoC PCIe AXI clock
      - const: cnoc_sf_axi # Config NoC PCIe1 AXI clock

  interrupts:
    minItems: 8
    maxItems: 9

  interrupt-names:
    minItems: 8
    items:
      - const: msi0
      - const: msi1
      - const: msi2
      - const: msi3
      - const: msi4
      - const: msi5
      - const: msi6
      - const: msi7
      - const: global

  resets:
    minItems: 1
    maxItems: 2

  reset-names:
    minItems: 1
    items:
      - const: pci # PCIe core reset
      - const: link_down # PCIe link down reset

  qcom,pcie-recalibration-thermal-zones:
    $ref: /schemas/types.yaml#/definitions/phandle-array
    minItems: 1
    maxItems: 16
    items:
      items:
        - description:
            Phandle to a thermal zone corresponding to the sensor used to
            monitor the PHY temperature drift.
        - description:
            Temperature drift this zone is allowed to accumulate before the
            PHY needs a fresh calibration, in millidegree Celsius.
          minimum: 1000
          maximum: 100000
    description:
      Thermal zones whose sensors track the PCIe PHY temperature, along with
      the temperature drift each zone is allowed to accumulate before the PHY
      needs a fresh calibration. Applies to SoCs that rely on periodic PCIe
      PHY recalibration to maintain stable link operation.

required:
  - power-domains
  - resets
  - reset-names

allOf:
  - $ref: qcom,pcie-common.yaml#
  - if:
      properties:
        compatible:
          contains:
            const: qcom,glymur-pcie
    then:
      properties:
        qcom,pcie-recalibration-thermal-zones: true
    else:
      properties:
        qcom,pcie-recalibration-thermal-zones: false

unevaluatedProperties: false

examples:
  - |
    #include <dt-bindings/clock/qcom,glymur-gcc.h>
    #include <dt-bindings/interrupt-controller/arm-gic.h>

    thermal-zones {
        thermal_aoss_6: aoss-6-thermal {
            thermal-sensors = <&tsens6 0>;
        };
    };

    pcie@1b40000 {
        compatible = "qcom,glymur-pcie", "qcom,pcie-x1e80100";
        reg = <0x01b40000 0x3000>,
              <0x7a000000 0xf20>,
              <0x7a000f40 0xa8>,
              <0x7a001000 0x4000>,
              <0x7a100000 0x100000>,
              <0x01b43000 0x1000>;
        reg-names = "parf", "dbi", "elbi", "atu", "config", "mhi";
        ranges = <0x01000000 0x0 0x00000000 0x7a200000 0x0 0x100000>,
                 <0x02000000 0x0 0x7a300000 0x7a300000 0x0 0x3d00000>;

        bus-range = <0x00 0xff>;
        device_type = "pci";
        linux,pci-domain = <5>;
        num-lanes = <4>;

        #address-cells = <3>;
        #size-cells = <2>;

        clocks = <&gcc GCC_PCIE_5_AUX_CLK>,
                 <&gcc GCC_PCIE_5_CFG_AHB_CLK>,
                 <&gcc GCC_PCIE_5_MSTR_AXI_CLK>,
                 <&gcc GCC_PCIE_5_SLV_AXI_CLK>,
                 <&gcc GCC_PCIE_5_SLV_Q2A_AXI_CLK>,
                 <&gcc GCC_AGGRE_NOC_PCIE_5_EAST_SF_AXI_CLK>;
        clock-names = "aux",
                      "cfg",
                      "bus_master",
                      "bus_slave",
                      "slave_q2a",
                      "noc_aggr";

        dma-coherent;

        interrupts = <GIC_SPI 518 IRQ_TYPE_LEVEL_HIGH>,
                     <GIC_SPI 519 IRQ_TYPE_LEVEL_HIGH>,
                     <GIC_SPI 520 IRQ_TYPE_LEVEL_HIGH>,
                     <GIC_SPI 521 IRQ_TYPE_LEVEL_HIGH>,
                     <GIC_SPI 522 IRQ_TYPE_LEVEL_HIGH>,
                     <GIC_SPI 523 IRQ_TYPE_LEVEL_HIGH>,
                     <GIC_SPI 524 IRQ_TYPE_LEVEL_HIGH>,
                     <GIC_SPI 525 IRQ_TYPE_LEVEL_HIGH>,
                     <GIC_SPI 945 IRQ_TYPE_LEVEL_HIGH>;
        interrupt-names = "msi0", "msi1", "msi2", "msi3",
                          "msi4", "msi5", "msi6", "msi7", "global";
        #interrupt-cells = <1>;
        interrupt-map-mask = <0 0 0 0x7>;
        interrupt-map = <0 0 0 1 &intc 0 0 GIC_SPI 526 IRQ_TYPE_LEVEL_HIGH>,
                        <0 0 0 2 &intc 0 0 GIC_SPI 428 IRQ_TYPE_LEVEL_HIGH>,
                        <0 0 0 3 &intc 0 0 GIC_SPI 429 IRQ_TYPE_LEVEL_HIGH>,
                        <0 0 0 4 &intc 0 0 GIC_SPI 435 IRQ_TYPE_LEVEL_HIGH>;

        iommu-map = <0x0 &pcie_smmu 0x50000 0x10000>;

        power-domains = <&gcc GCC_PCIE_5_GDSC>;

        resets = <&gcc GCC_PCIE_5_BCR>,
                 <&gcc GCC_PCIE_5_LINK_DOWN_BCR>;
        reset-names = "pci", "link_down";

        qcom,pcie-recalibration-thermal-zones = <&thermal_aoss_6 25000>;
    };
```

## Documentation/devicetree/bindings/power/supply/qcom,pm4125-charger.yaml
```yaml
# SPDX-License-Identifier: GPL-2.0 OR BSD-2-Clause
%YAML 1.2
---
$id: http://devicetree.org/schemas/power/supply/qcom,pm4125-charger.yaml#
$schema: http://devicetree.org/meta-schemas/core.yaml#

title: Qualcomm PM4125 SMBLite Switch-Mode Battery Charger

maintainers:
  - Raj Aryan <raj.aryan@oss.qualcomm.com>
  - Rakesh Kota <rakesh.kota@oss.qualcomm.com>

description: |
  The Qualcomm SMBLite is a switch-mode battery charger IP found on
  the entry-level Qualcomm PM4125 PMIC. It exposes five separate
  SPMI peripheral bases for CHGR, DCDC, USB, MISC and BATIF blocks and
  supports USB input current limiting, JEITA temperature protection,
  battery overvoltage detection and a hardware watchdog.

properties:
  compatible:
    const: qcom,pm4125-charger

  reg:
    maxItems: 1

  interrupts:
    maxItems: 4

  interrupt-names:
    items:
      - const: usb-plugin
      - const: bat-ov
      - const: wdog-bark
      - const: usbin-icl-change

  io-channels:
    maxItems: 1
    description:
      USB input voltage channel (ADC5_USB_IN_V_16).

  io-channel-names:
    items:
      - const: usbin_v

  monitored-battery: true

  qcom,jeita-soft-thresholds:
    $ref: /schemas/types.yaml#/definitions/uint32-array
    items:
      - description: COOL threshold as a raw ADC comparator value.
        maximum: 0xffff
      - description: WARM threshold as a raw ADC comparator value.
        maximum: 0xffff
    description: |
      JEITA soft temperature thresholds (COOL, WARM) as raw 16-bit ADC
      comparator values written to the BATIF ADC comparator registers.
      Example: <0x5314 0x25e3> for COOL=15°C, WARM=45°C.

  qcom,jeita-hard-thresholds:
    $ref: /schemas/types.yaml#/definitions/uint32-array
    items:
      - description: COLD threshold as a raw ADC comparator value.
        maximum: 0xffff
      - description: HOT threshold as a raw ADC comparator value.
        maximum: 0xffff
    description: |
      JEITA hard temperature thresholds (COLD, HOT) as raw 16-bit ADC
      comparator values written to the BATIF ADC comparator registers.
      Example: <0x58cd 0x20b8> for COLD=0°C, HOT=60°C.

required:
  - compatible
  - reg
  - interrupts
  - interrupt-names
  - io-channels
  - io-channel-names

dependencies:
  qcom,jeita-soft-thresholds:
    - qcom,jeita-hard-thresholds
  qcom,jeita-hard-thresholds:
    - qcom,jeita-soft-thresholds

allOf:
  - $ref: power-supply.yaml#

additionalProperties: false

examples:
  - |
    #include <dt-bindings/interrupt-controller/irq.h>
    #include <dt-bindings/iio/qcom,spmi-vadc.h>

    pmic {
        #address-cells = <1>;
        #size-cells = <0>;

        charger@1000 {
            compatible = "qcom,pm4125-charger";
            reg = <0x1000>;

            interrupts = <0x0 0x13 0x0 IRQ_TYPE_EDGE_BOTH>,
                         <0x0 0x12 0x3 IRQ_TYPE_EDGE_BOTH>,
                         <0x0 0x16 0x1 IRQ_TYPE_EDGE_RISING>,
                         <0x0 0x13 0x6 IRQ_TYPE_EDGE_RISING>;
            interrupt-names = "usb-plugin",
                              "bat-ov",
                              "wdog-bark",
                              "usbin-icl-change";

            io-channels = <&pm4125_vadc ADC5_USB_IN_V_16>;
            io-channel-names = "usbin_v";

            qcom,jeita-soft-thresholds = <0x5314 0x25e3>; /* COOL, WARM */
            qcom,jeita-hard-thresholds = <0x58cd 0x20b8>; /* COLD, HOT  */
        };
    };
```

## Documentation/devicetree/bindings/ptp/qcom,nord-tscss.yaml
```yaml
# SPDX-License-Identifier: GPL-2.0-only OR BSD-2-Clause
%YAML 1.2
---
$id: http://devicetree.org/schemas/ptp/qcom,nord-tscss.yaml#
$schema: http://devicetree.org/meta-schemas/core.yaml#

title: Timestamp Counter Subsystem (TSCSS) on Qualcomm Nord and Shikra

maintainers:
  - Imran Shaik <imran.shaik@oss.qualcomm.com>
  - Taniya Das <taniya.das@oss.qualcomm.com>

description: |
  Qualcomm TSCSS is a time synchronization subsystem composed of two main
  blocks - the Timestamp Counter (TSC) and the Event Timestamp Unit (ETU).

  The TSC block is a timestamp generator that maintains a running counter used
  for system timekeeping, and is functional with just the AHB and counter
  clocks.
  The ETU block captures TSC timestamps for external hardware events. Each
  ETU slice binds a slice number to an external event selector, and a
  single summary interrupt is raised for any ETU slice event.

  Nord additionally has a timer register region used to generate a
  periodic pulse in sync with the TSC counter.

properties:
  compatible:
    oneOf:
      - const: qcom,nord-tscss
      - items:
          - const: qcom,shikra-tscss
          - const: qcom,nord-tscss

  reg:
    minItems: 1
    maxItems: 3

  reg-names:
    minItems: 1
    items:
      - const: tsc
      - const: etu
      - const: timer

  clocks:
    items:
      - description: TSC AHB configuration clock.
      - description: TSC global counter clock.
      - description: TSC ETU clock.

  clock-names:
    items:
      - const: ahb
      - const: cntr
      - const: etu

  interrupts:
    items:
      - description:
          Summary interrupt raised based on an external event for any
          of the ETU slices.

  interrupt-names:
    items:
      - const: etu_summary

  pinctrl-names:
    minItems: 1
    maxItems: 32
    items:
      pattern: "^slice[0-9]+$"

  qcom,etu-slice:
    description:
      ETU slice number for each entry in pinctrl-<n>, pinctrl-names and
      qcom,etu-event-sel.
    minItems: 1
    maxItems: 32
    $ref: /schemas/types.yaml#/definitions/uint32-array

  qcom,etu-event-sel:
    description:
      External event selection value for each ETU slice listed in
      qcom,etu-slice.
    minItems: 1
    maxItems: 32
    $ref: /schemas/types.yaml#/definitions/uint32-array

required:
  - compatible
  - reg
  - reg-names
  - clocks
  - clock-names

allOf:
  - if:
      properties:
        reg-names:
          contains:
            const: etu
    then:
      required:
        - interrupts
        - interrupt-names
        - pinctrl-names
        - qcom,etu-slice
        - qcom,etu-event-sel

  - if:
      properties:
        compatible:
          contains:
            const: qcom,shikra-tscss
    then:
      properties:
        reg-names:
          minItems: 1
          items:
            - const: tsc
            - const: etu
        pinctrl-names:
          maxItems: 8
        qcom,etu-slice:
          maxItems: 8
        qcom,etu-event-sel:
          maxItems: 8

additionalProperties: false

examples:
  - |
    soc {
      #address-cells = <2>;
      #size-cells = <2>;

      ptp@1c80000 {
        compatible = "qcom,nord-tscss";
        reg = <0x0 0x01c80000 0x0 0x2000>;
        reg-names = "tsc";

        clocks = <&gcc_tscss_ahb_clk>,
                 <&gcc_tscss_cntr_clk>,
                 <&gcc_tscss_etu_clk>;
        clock-names = "ahb", "cntr", "etu";

        assigned-clocks = <&gcc_tscss_cntr_clk>;
        assigned-clock-rates = <250000000>;
      };
    };

  - |
    #include <dt-bindings/interrupt-controller/arm-gic.h>

    soc {
      #address-cells = <2>;
      #size-cells = <2>;

      ptp@1c80000 {
        compatible = "qcom,nord-tscss";
        reg = <0x0 0x01c80000 0x0 0x2000>,
              <0x0 0x01ca0000 0x0 0x20000>,
              <0x0 0x01c87000 0x0 0x1000>;
        reg-names = "tsc", "etu", "timer";

        clocks = <&gcc_tscss_ahb_clk>,
                 <&gcc_tscss_cntr_clk>,
                 <&gcc_tscss_etu_clk>;
        clock-names = "ahb", "cntr", "etu";

        assigned-clocks = <&gcc_tscss_cntr_clk>;
        assigned-clock-rates = <250000000>;

        interrupts = <GIC_SPI 169 IRQ_TYPE_LEVEL_HIGH>;
        interrupt-names = "etu_summary";

        pinctrl-0 = <&cci_timer0>;
        pinctrl-1 = <&cci_timer1>;
        pinctrl-names = "slice1", "slice2";

        qcom,etu-slice = <1 2>;
        qcom,etu-event-sel = <1 2>;
      };
    };
...
```
