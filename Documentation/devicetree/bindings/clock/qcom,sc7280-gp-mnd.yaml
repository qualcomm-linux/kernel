## Documentation/devicetree/bindings/ptp/qcom,qdu1000-tscss.yaml
```yaml
# SPDX-License-Identifier: GPL-2.0-only OR BSD-2-Clause
%YAML 1.2
---
$id: http://devicetree.org/schemas/ptp/qcom,qdu1000-tscss.yaml#
$schema: http://devicetree.org/meta-schemas/core.yaml#

title: Timestamp Counter Subsystem (TSCSS) on Qualcomm QDU1000 SoC

maintainers:
  - Imran Shaik <imran.shaik@oss.qualcomm.com>
  - Taniya Das <taniya.das@oss.qualcomm.com>

description: |
  Qualcomm TSCSS is a time synchronization subsystem composed of two main
  blocks - the Timestamp Counter (TSC) and the Event Timestamp Unit (ETU).

  The TSC block is a timestamp generator that maintains a running counter used
  for system timekeeping, and is functional with just the AHB and counter
  clocks.
  The ETU block captures TSC timestamps for external hardware events. Each
  ETU slice binds a slice number to an external event selector, and
  generates its own interrupt when that event is triggered.

properties:
  compatible:
    const: qcom,qdu1000-tscss

  reg:
    minItems: 1
    maxItems: 2

  reg-names:
    minItems: 1
    items:
      - const: tsc
      - const: etu

  clocks:
    items:
      - description: TSC AHB configuration clock.
      - description: TSC global counter clock.
      - description: TSC ETU clock.

  clock-names:
    items:
      - const: ahb
      - const: cntr
      - const: etu

  interrupts:
    minItems: 1
    maxItems: 16
    description:
      Per slice interrupt raised based on an external event mapped to
      that ETU slice.

  interrupt-names:
    minItems: 1
    maxItems: 16
    items:
      pattern: "^slice[0-9]+$"

  pinctrl-names:
    minItems: 1
    maxItems: 16
    items:
      pattern: "^slice[0-9]+$"

  qcom,etu-slice:
    description:
      ETU slice number for each entry in interrupts, interrupt-names,
      pinctrl-<n>, pinctrl-names and qcom,etu-event-sel.
    minItems: 1
    maxItems: 16
    $ref: /schemas/types.yaml#/definitions/uint32-array

  qcom,etu-event-sel:
    description:
      External event selection value for each ETU slice listed in
      qcom,etu-slice.
    minItems: 1
    maxItems: 16
    $ref: /schemas/types.yaml#/definitions/uint32-array

required:
  - compatible
  - reg
  - reg-names
  - clocks
  - clock-names

allOf:
  - if:
      properties:
        reg-names:
          contains:
            const: etu
    then:
      properties:
        reg:
          minItems: 2
          maxItems: 2
      required:
        - interrupts
        - interrupt-names
        - pinctrl-names
        - qcom,etu-slice
        - qcom,etu-event-sel

additionalProperties: false

examples:
  - |
    #include <dt-bindings/clock/qcom,qdu1000-gcc.h>

    soc {
      #address-cells = <2>;
      #size-cells = <2>;

      ptp@1da0000 {
        compatible = "qcom,qdu1000-tscss";
        reg = <0x0 0x01da0000 0x0 0x2000>;
        reg-names = "tsc";

        clocks = <&gcc GCC_TSC_CFG_AHB_CLK>,
                 <&gcc GCC_TSC_CNTR_CLK>,
                 <&gcc GCC_TSC_ETU_CLK>;
        clock-names = "ahb", "cntr", "etu";
        assigned-clocks = <&gcc GCC_TSC_CNTR_CLK>;
        assigned-clock-rates = <500000000>;
      };
    };

  - |
    #include <dt-bindings/clock/qcom,qdu1000-gcc.h>
    #include <dt-bindings/interrupt-controller/arm-gic.h>

    soc {
      #address-cells = <2>;
      #size-cells = <2>;

      ptp@1da0000 {
        compatible = "qcom,qdu1000-tscss";
        reg = <0x0 0x01da0000 0x0 0x2000>,
              <0x0 0x01db0000 0x0 0x10000>;
        reg-names = "tsc", "etu";

        clocks = <&gcc GCC_TSC_CFG_AHB_CLK>,
                 <&gcc GCC_TSC_CNTR_CLK>,
                 <&gcc GCC_TSC_ETU_CLK>;
        clock-names = "ahb", "cntr", "etu";

        assigned-clocks = <&gcc GCC_TSC_CNTR_CLK>;
        assigned-clock-rates = <500000000>;

        interrupts = <GIC_SPI 329 IRQ_TYPE_EDGE_RISING>,
                     <GIC_SPI 333 IRQ_TYPE_EDGE_RISING>,
                     <GIC_SPI 334 IRQ_TYPE_EDGE_RISING>;
        interrupt-names = "slice1", "slice5", "slice6";

        pinctrl-0 = <&tod_pps>;
        pinctrl-1 = <&gps_pps>;
        pinctrl-2 = <&hardsync_pps>;
        pinctrl-names = "slice1", "slice5", "slice6";

        qcom,etu-slice = <1 5 6>;
        qcom,etu-event-sel = <1 3 2>;
      };
    };
...
```

## Documentation/devicetree/bindings/ptp/qcom,sa8775p-tscss.yaml
```yaml
# SPDX-License-Identifier: GPL-2.0-only OR BSD-2-Clause
%YAML 1.2
---
$id: http://devicetree.org/schemas/ptp/qcom,sa8775p-tscss.yaml#
$schema: http://devicetree.org/meta-schemas/core.yaml#

title: Timestamp Counter Subsystem (TSCSS) on Qualcomm SA8775P and QCS8300

maintainers:
  - Imran Shaik <imran.shaik@oss.qualcomm.com>
  - Taniya Das <taniya.das@oss.qualcomm.com>

description: |
  Qualcomm TSCSS is a time synchronization subsystem composed of two main
  blocks - the Timestamp Counter (TSC) and the Event Timestamp Unit (ETU).

  The TSC block is a timestamp generator that maintains a running counter used
  for system timekeeping, and is functional with just the AHB and counter
  clocks.
  The ETU block captures TSC timestamps for external hardware events. Each
  ETU slice binds a slice number to an external event selector, and a
  single summary interrupt is raised for any ETU slice event.

properties:
  compatible:
    oneOf:
      - const: qcom,sa8775p-tscss
      - items:
          - const: qcom,qcs8300-tscss
          - const: qcom,sa8775p-tscss

  reg:
    minItems: 1
    maxItems: 2

  reg-names:
    minItems: 1
    items:
      - const: tsc
      - const: etu

  clocks:
    items:
      - description: TSC AHB configuration clock.
      - description: TSC global counter clock.
      - description: TSC ETU clock.

  clock-names:
    items:
      - const: ahb
      - const: cntr
      - const: etu

  interrupts:
    items:
      - description:
          Summary interrupt raised based on an external event for any
          of the ETU slices.

  interrupt-names:
    items:
      - const: etu_summary

  pinctrl-names:
    minItems: 1
    maxItems: 16
    items:
      pattern: "^slice[0-9]+$"

  qcom,etu-slice:
    description:
      ETU slice number for each entry in pinctrl-<n>, pinctrl-names and
      qcom,etu-event-sel.
    minItems: 1
    maxItems: 16
    $ref: /schemas/types.yaml#/definitions/uint32-array

  qcom,etu-event-sel:
    description:
      External event selection value for each ETU slice listed in
      qcom,etu-slice.
    minItems: 1
    maxItems: 16
    $ref: /schemas/types.yaml#/definitions/uint32-array

required:
  - compatible
  - reg
  - reg-names
  - clocks
  - clock-names

allOf:
  - if:
      properties:
        reg-names:
          contains:
            const: etu
    then:
      properties:
        reg:
          minItems: 2
          maxItems: 2
      required:
        - interrupts
        - interrupt-names
        - pinctrl-names
        - qcom,etu-slice
        - qcom,etu-event-sel

additionalProperties: false

examples:
  - |
    #include <dt-bindings/clock/qcom,sa8775p-gcc.h>

    soc {
      #address-cells = <2>;
      #size-cells = <2>;

      ptp@1c80000 {
        compatible = "qcom,sa8775p-tscss";
        reg = <0x0 0x01c80000 0x0 0x2000>;
        reg-names = "tsc";

        clocks = <&gcc GCC_TSCSS_AHB_CLK>,
                 <&gcc GCC_TSCSS_GLOBAL_CNTR_CLK>,
                 <&gcc GCC_TSCSS_ETU_CLK>;
        clock-names = "ahb", "cntr", "etu";

        assigned-clocks = <&gcc GCC_TSCSS_GLOBAL_CNTR_CLK>;
        assigned-clock-rates = <15625000>;
      };
    };

  - |
    #include <dt-bindings/clock/qcom,sa8775p-gcc.h>
    #include <dt-bindings/interrupt-controller/arm-gic.h>

    soc {
      #address-cells = <2>;
      #size-cells = <2>;

      ptp@1c80000 {
        compatible = "qcom,sa8775p-tscss";
        reg = <0x0 0x01c80000 0x0 0x2000>,
              <0x0 0x01c90000 0x0 0x10000>;
        reg-names = "tsc", "etu";

        clocks = <&gcc GCC_TSCSS_AHB_CLK>,
                 <&gcc GCC_TSCSS_GLOBAL_CNTR_CLK>,
                 <&gcc GCC_TSCSS_ETU_CLK>;
        clock-names = "ahb", "cntr", "etu";

        assigned-clocks = <&gcc GCC_TSCSS_GLOBAL_CNTR_CLK>;
        assigned-clock-rates = <15625000>;

        interrupts = <GIC_SPI 766 IRQ_TYPE_LEVEL_HIGH>;
        interrupt-names = "etu_summary";

        pinctrl-0 = <&cci_timer0>;
        pinctrl-1 = <&cci_timer1>;
        pinctrl-names = "slice1", "slice2";

        qcom,etu-slice = <1 2>;
        qcom,etu-event-sel = <1 2>;
      };
    };
...
```

## Documentation/devicetree/bindings/pwm/qcom,shikra-pwm.yaml
```yaml
# SPDX-License-Identifier: (GPL-2.0-only OR BSD-2-Clause)
%YAML 1.2
---
$id: http://devicetree.org/schemas/pwm/qcom,shikra-pwm.yaml#
$schema: http://devicetree.org/meta-schemas/core.yaml#

title: Qualcomm Shikra PWM controller

maintainers:
  - Taniya Das <taniya.das@oss.qualcomm.com>

description: |
  The Qualcomm PWM (Pulse Width Modulation) block on Shikra contains
  up to 10 independent PWM frame channels. Each frame is a child node of
  the PWM controller node and owns its own register range. All frames
  share a single PWM core clock owned by the parent node. Child frame reg
  properties use the parent SoC address space through an empty identity
  ranges mapping.

  The PWM source input clock, pwm_core, is given by:

    F_PWM_CLK = 19.2 MHz / N

  where N is an integer from 1 through 512. The output frequency range
  for a given PWM source clock is:

    f_out(max) = F_PWM_CLK / 2
    f_out(min) = F_PWM_CLK / 65536

allOf:
  - $ref: pwm.yaml#

properties:
  compatible:
    const: qcom,shikra-pwm

  reg:
    maxItems: 1

  clocks:
    items:
      - description: AHB bus clock for the PWM block.
      - description: Gate clock shared by every frame (pwm_core).

  clock-names:
    items:
      - const: ahb
      - const: core

  "#pwm-cells":
    const: 3

  "#address-cells":
    const: 2

  "#size-cells":
    const: 2

  ranges: true

patternProperties:
  "^pwm@[0-9a-f]+$":
    type: object
    description: Per-frame PWM channel sub-node.

    properties:
      reg:
        maxItems: 1
        description: This frame's own absolute register range.

      qcom,frame-index:
        $ref: /schemas/types.yaml#/definitions/uint32
        description:
          Hardware frame index within the PWM block. It is the PWM index
          used in the first cell of a consumer PWM specifier and selects
          the corresponding enable bit in PWM_TOPCTL0.
        maximum: 9

    required:
      - reg
      - qcom,frame-index

    additionalProperties: false

required:
  - compatible
  - reg
  - clocks
  - clock-names
  - "#pwm-cells"
  - "#address-cells"
  - "#size-cells"
  - ranges

unevaluatedProperties: false

examples:
  - |
    #include <dt-bindings/clock/qcom,shikra-gcc.h>

    / {
        #address-cells = <2>;
        #size-cells = <2>;

        pwm: pwm@4700000 {
            compatible = "qcom,shikra-pwm";
            reg = <0x0 0x04700000 0x0 0x10>;
            clocks = <&gcc GCC_PDM_AHB_CLK>, <&gcc GCC_PWM0_XO512_CLK>;
            clock-names = "ahb", "core";
            assigned-clocks = <&gcc GCC_PWM0_XO512_CLK>;
            assigned-clock-rates = <9600000>;
            #pwm-cells = <3>;
            #address-cells = <2>;
            #size-cells = <2>;
            ranges;

            pwm@4701000 {
                reg = <0x0 0x04701000 0x0 0x1c>;
                qcom,frame-index = <0>;
            };

            pwm@4702000 {
                reg = <0x0 0x04702000 0x0 0x1c>;
                qcom,frame-index = <1>;
            };
        };
    };
```
