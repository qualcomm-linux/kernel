## Documentation/devicetree/bindings/clock/qcom,sc7280-gp-mnd.yaml
```yaml
# SPDX-License-Identifier: (GPL-2.0-only OR BSD-2-Clause)
%YAML 1.2
---
$id: http://devicetree.org/schemas/clock/qcom,sc7280-gp-mnd.yaml#
$schema: http://devicetree.org/meta-schemas/core.yaml#

title: Qualcomm Peripheral Web's PDM GP_MN Clock Divider

maintainers:
  - Taniya Das <taniya.das@oss.qualcomm.com>

description: |
  The Peripheral Web's PDM GP_MN clock divider receives an input clock
  (TCXO4) with frequency Fin and generates an output clock with
  frequency Fout = Fin * (M / N) and a duty cycle controlled by D
  and routed over a gpio pin.

  The divider is configured using three registers:

  - GP_MN_CLK_MDIV: holds the M value.
  - GP_MN_CLK_NDIV: holds the ones complement of (N - M).
  - GP_MN_CLK_DUTY: holds the D value.

  For every N input clock cycles the GP_MN produces M output clock
  cycles. D is the number of native clock cycles in which the GP_MN
  output is low, counted over 2^13 native clock cycles.

  Hardware constraints:

    M <= 511
    N <= 8191
    N > 2 * M
    M < D < (N - M)
    M and N must be coprime (no common divisor)

properties:
  compatible:
    oneOf:
      - const: qcom,sc7280-gp-mnd
      - items:
          - enum:
              - qcom,qcs615-gp-mnd
              - qcom,qcs8300-gp-mnd
              - qcom,sa8775p-gp-mnd
              - qcom,shikra-gp-mnd
              - qcom,sm8750-gp-mnd
          - const: qcom,sc7280-gp-mnd

  reg:
    maxItems: 1

  clocks:
    items:
      - description: |
          PDM XO4 source clock. It is derived from the 19.2 MHz TCXO by an
          integer divider of 1 to 16 programmed on the parent clock (for
          example via assigned-clock-rates), giving supported input rates
          from 19200000 Hz (divide by 1) down to 1200000 Hz (divide by 16).
      - description: PDM AHB bus clock for register access

  clock-names:
    items:
      - const: pdm
      - const: ahb

  '#clock-cells':
    const: 0

required:
  - compatible
  - reg
  - clocks
  - clock-names
  - '#clock-cells'

additionalProperties: false

examples:
  - |
    #include <dt-bindings/clock/qcom,gcc-sc7280.h>
    clock-controller@88d3000 {
        compatible = "qcom,sc7280-gp-mnd";
        reg = <0x88d3000 0x1000>;
        clocks = <&gcc GCC_PDM_XO4_CLK>,
                 <&gcc GCC_PDM_AHB_CLK>;
        clock-names = "pdm", "ahb";
        pinctrl-0 = <&gp_mn_pin_active>;
        pinctrl-names = "default";
        assigned-clocks = <&gcc GCC_PDM_XO4_CLK>;
        assigned-clock-rates = <4800000>;
        #clock-cells = <0>;
    };
```

## Documentation/devicetree/bindings/media/qcom,sm8750-camss.yaml
```yaml
# SPDX-License-Identifier: (GPL-2.0 OR BSD-2-Clause)
%YAML 1.2
---
$id: http://devicetree.org/schemas/media/qcom,sm8750-camss.yaml#
$schema: http://devicetree.org/meta-schemas/core.yaml#

title: Qualcomm SM8750 Camera Subsystem (CAMSS)

maintainers:
  - Hangxiang Ma <hangxiang.ma@oss.qualcomm.com>

description:
  The CAMSS IP is a CSI decoder and ISP present on Qualcomm platforms.

properties:
  compatible:
    const: qcom,sm8750-camss

  reg:
    maxItems: 14

  reg-names:
    items:
      - const: top
      - const: csid0
      - const: csid1
      - const: csid2
      - const: csid_lite0
      - const: csid_lite1
      - const: tpg0
      - const: tpg1
      - const: tpg2
      - const: vfe0
      - const: vfe1
      - const: vfe2
      - const: vfe_lite0
      - const: vfe_lite1

  clocks:
    maxItems: 21

  clock-names:
    items:
      - const: camnoc_rt_axi
      - const: cpas_ahb
      - const: cpas_fast_ahb
      - const: cpas_vfe0
      - const: cpas_vfe1
      - const: cpas_vfe2
      - const: cpas_vfe_lite
      - const: csid
      - const: csiphy_rx
      - const: gcc_axi_hf
      - const: vfe0
      - const: vfe0_fast_ahb
      - const: vfe1
      - const: vfe1_fast_ahb
      - const: vfe2
      - const: vfe2_fast_ahb
      - const: vfe_lite
      - const: vfe_lite_ahb
      - const: vfe_lite_cphy_rx
      - const: vfe_lite_csid
      - const: qdss_debug_xo

  interrupts:
    maxItems: 10

  interrupt-names:
    items:
      - const: csid0
      - const: csid1
      - const: csid2
      - const: csid_lite0
      - const: csid_lite1
      - const: vfe0
      - const: vfe1
      - const: vfe2
      - const: vfe_lite0
      - const: vfe_lite1

  interconnects:
    maxItems: 2

  interconnect-names:
    items:
      - const: ahb
      - const: hf_mnoc

  iommus:
    items:
      - description: S1 HLOS IFE and IFE_LITE non-protected stream

  power-domains:
    items:
      - description: IFE0 GDSC - Global Distributed Switch Controller for IFE0.
      - description: IFE1 GDSC - Global Distributed Switch Controller for IFE1.
      - description: IFE2 GDSC - Global Distributed Switch Controller for IFE2.
      - description: Titan GDSC - Global Distributed Switch Controller for the entire camss.

  power-domain-names:
    items:
      - const: ife0
      - const: ife1
      - const: ife2
      - const: top

  ports:
    $ref: /schemas/graph.yaml#/properties/ports

    description:
      CSI input ports.

    patternProperties:
      "^port@[0-5]$":
        $ref: /schemas/graph.yaml#/$defs/port-base
        unevaluatedProperties: false
        description:
          Input ports for receiving CSI data on CSIPHY 0-5.

        properties:
          endpoint:
            $ref: video-interfaces.yaml#
            unevaluatedProperties: false

            properties:
              data-lanes:
                minItems: 1
                maxItems: 4

              bus-type:
                enum:
                  - 1 # MEDIA_BUS_TYPE_CSI2_CPHY
                  - 4 # MEDIA_BUS_TYPE_CSI2_DPHY

            required:
              - data-lanes

required:
  - compatible
  - reg
  - reg-names
  - clocks
  - clock-names
  - interrupts
  - interrupt-names
  - interconnects
  - interconnect-names
  - iommus
  - power-domains
  - power-domain-names
  - ports

additionalProperties: false

examples:
  - |
    #include <dt-bindings/clock/qcom,sm8750-gcc.h>
    #include <dt-bindings/clock/qcom,sm8750-camcc.h>
    #include <dt-bindings/interconnect/qcom,icc.h>
    #include <dt-bindings/interconnect/qcom,sm8750-rpmh.h>
    #include <dt-bindings/interrupt-controller/arm-gic.h>
    #include <dt-bindings/power/qcom,rpmhpd.h>

    soc {
        #address-cells = <2>;
        #size-cells = <2>;

        isp@ac04000 {
            compatible = "qcom,sm8750-camss";

            reg = <0x0 0x0ac04000 0x0 0x1000>,
                  <0x0 0x0ad27000 0x0 0x2b00>,
                  <0x0 0x0ad2a000 0x0 0x2b00>,
                  <0x0 0x0ad2d000 0x0 0x2b00>,
                  <0x0 0x0ad6d000 0x0 0xa00>,
                  <0x0 0x0ad72000 0x0 0xa00>,
                  <0x0 0x0ad8b000 0x0 0x400>,
                  <0x0 0x0ad8c000 0x0 0x400>,
                  <0x0 0x0ad8d000 0x0 0x400>,
                  <0x0 0x0ac86000 0x0 0x10000>,
                  <0x0 0x0ac96000 0x0 0x10000>,
                  <0x0 0x0aca6000 0x0 0x10000>,
                  <0x0 0x0ad6e000 0x0 0x3000>,
                  <0x0 0x0ad73000 0x0 0x3000>;
            reg-names = "top",
                        "csid0",
                        "csid1",
                        "csid2",
                        "csid_lite0",
                        "csid_lite1",
                        "tpg0",
                        "tpg1",
                        "tpg2",
                        "vfe0",
                        "vfe1",
                        "vfe2",
                        "vfe_lite0",
                        "vfe_lite1";

            clocks = <&camcc CAM_CC_CAMNOC_RT_AXI_CLK>,
                     <&camcc CAM_CC_CAM_TOP_AHB_CLK>,
                     <&camcc CAM_CC_CAM_TOP_FAST_AHB_CLK>,
                     <&camcc CAM_CC_CAMNOC_RT_TFE_0_MAIN_CLK>,
                     <&camcc CAM_CC_CAMNOC_RT_TFE_1_MAIN_CLK>,
                     <&camcc CAM_CC_CAMNOC_RT_TFE_2_MAIN_CLK>,
                     <&camcc CAM_CC_CAMNOC_RT_IFE_LITE_CLK>,
                     <&camcc CAM_CC_CSID_CLK>,
                     <&camcc CAM_CC_CSID_CSIPHY_RX_CLK>,
                     <&gcc GCC_CAMERA_HF_AXI_CLK>,
                     <&camcc CAM_CC_TFE_0_MAIN_CLK>,
                     <&camcc CAM_CC_TFE_0_MAIN_FAST_AHB_CLK>,
                     <&camcc CAM_CC_TFE_1_MAIN_CLK>,
                     <&camcc CAM_CC_TFE_1_MAIN_FAST_AHB_CLK>,
                     <&camcc CAM_CC_TFE_2_MAIN_CLK>,
                     <&camcc CAM_CC_TFE_2_MAIN_FAST_AHB_CLK>,
                     <&camcc CAM_CC_IFE_LITE_CLK>,
                     <&camcc CAM_CC_IFE_LITE_AHB_CLK>,
                     <&camcc CAM_CC_IFE_LITE_CPHY_RX_CLK>,
                     <&camcc CAM_CC_IFE_LITE_CSID_CLK>,
                     <&camcc CAM_CC_QDSS_DEBUG_XO_CLK>;
            clock-names = "camnoc_rt_axi",
                          "cpas_ahb",
                          "cpas_fast_ahb",
                          "cpas_vfe0",
                          "cpas_vfe1",
                          "cpas_vfe2",
                          "cpas_vfe_lite",
                          "csid",
                          "csiphy_rx",
                          "gcc_axi_hf",
                          "vfe0",
                          "vfe0_fast_ahb",
                          "vfe1",
                          "vfe1_fast_ahb",
                          "vfe2",
                          "vfe2_fast_ahb",
                          "vfe_lite",
                          "vfe_lite_ahb",
                          "vfe_lite_cphy_rx",
                          "vfe_lite_csid",
                          "qdss_debug_xo";

            interrupts = <GIC_SPI 601 IRQ_TYPE_EDGE_RISING>,
                         <GIC_SPI 603 IRQ_TYPE_EDGE_RISING>,
                         <GIC_SPI 431 IRQ_TYPE_EDGE_RISING>,
                         <GIC_SPI 605 IRQ_TYPE_EDGE_RISING>,
                         <GIC_SPI 376 IRQ_TYPE_EDGE_RISING>,
                         <GIC_SPI 433 IRQ_TYPE_EDGE_RISING>,
                         <GIC_SPI 436 IRQ_TYPE_EDGE_RISING>,
                         <GIC_SPI 457 IRQ_TYPE_EDGE_RISING>,
                         <GIC_SPI 606 IRQ_TYPE_EDGE_RISING>,
                         <GIC_SPI 377 IRQ_TYPE_EDGE_RISING>;
            interrupt-names = "csid0",
                              "csid1",
                              "csid2",
                              "csid_lite0",
                              "csid_lite1",
                              "vfe0",
                              "vfe1",
                              "vfe2",
                              "vfe_lite0",
                              "vfe_lite1";

            interconnects = <&gem_noc MASTER_APPSS_PROC QCOM_ICC_TAG_ACTIVE_ONLY
                             &config_noc SLAVE_CAMERA_CFG QCOM_ICC_TAG_ACTIVE_ONLY>,
                            <&mmss_noc MASTER_CAMNOC_HF QCOM_ICC_TAG_ALWAYS
                             &mc_virt SLAVE_EBI1 QCOM_ICC_TAG_ALWAYS>;
            interconnect-names = "ahb",
                                 "hf_mnoc";

            iommus = <&apps_smmu 0x1c00 0x00>;

            power-domains = <&camcc CAM_CC_TFE_0_GDSC>,
                            <&camcc CAM_CC_TFE_1_GDSC>,
                            <&camcc CAM_CC_TFE_2_GDSC>,
                            <&camcc CAM_CC_TITAN_TOP_GDSC>;
            power-domain-names = "ife0",
                                 "ife1",
                                 "ife2",
                                 "top";

            ports {
                #address-cells = <1>;
                #size-cells = <0>;

                port@0 {
                    reg = <0>;

                    camss_csiphy0_ep: endpoint {
                        data-lanes = <0 1 2 3>;
                        remote-endpoint = <&csiphy0_out>;
                    };
                };
            };
        };
    };
```
