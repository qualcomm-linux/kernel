// SPDX-License-Identifier: BSD-3-Clause
/*
 * Copyright (c) Qualcomm Technologies, Inc. and/or its subsidiaries.
 *
 * Monaco staging overlay - add staging-specific device tree modifications here.
 */

/dts-v1/;
/plugin/;
#include <dt-bindings/interrupt-controller/arm-gic.h>
#include <dt-bindings/interrupt-controller/irq.h>
#include <dt-bindings/mailbox/qcom-ipcc.h>

&soc {
	rtss_mailbox: rtss-ipcc-mailbox {
		compatible = "qcom,qcs8300-rtss-mailbox", "qcom,rtss-mailbox";
		qcom,syscon-tcsr-req  = <&tcsr 0x3e02c>;
		qcom,syscon-tcsr-resp = <&tcsr 0x3d018>;
		qcom,syscon-ipc = <&apsshm_shared_intu 0xc>;
		mboxes = <&ipcc1 IPCC_CLIENT_RTSS0 0x2>,
			<&ipcc1 IPCC_CLIENT_RTSS1 0x3>,
			<&ipcc1 IPCC_CLIENT_RTSS0 0x4>,
			<&ipcc1 IPCC_CLIENT_RTSS0 0x5>,
			<&ipcc1 IPCC_CLIENT_RTSS0 0x6>,
			<&ipcc1 IPCC_CLIENT_RTSS0 0x7>,
			<&ipcc1 IPCC_CLIENT_RTSS2 0x8>,
			<&ipcc1 IPCC_CLIENT_RTSS1 0x9>,
			<&ipcc1 IPCC_CLIENT_RTSS2 0xa>,
			<&ipcc1 IPCC_CLIENT_RTSS1 0xb>,
			<&ipcc1 IPCC_CLIENT_RTSS0 0xc>,
			<&ipcc1 IPCC_CLIENT_RTSS0 0xd>,
			<&ipcc1 IPCC_CLIENT_RTSS1 0xe>,
			<&ipcc1 IPCC_CLIENT_RTSS2 0xf>,
			<&ipcc1 IPCC_CLIENT_RTSS3 0x10>;
		interrupts-extended = <&ipcc1 IPCC_CLIENT_RTSS0 0x2 IRQ_TYPE_EDGE_RISING>,
			<&ipcc1 IPCC_CLIENT_RTSS1 0x3 IRQ_TYPE_EDGE_RISING>,
			<&ipcc1 IPCC_CLIENT_RTSS0 0x4 IRQ_TYPE_EDGE_RISING>,
			<&ipcc1 IPCC_CLIENT_RTSS0 0x5 IRQ_TYPE_EDGE_RISING>,
			<&ipcc1 IPCC_CLIENT_RTSS0 0x6 IRQ_TYPE_EDGE_RISING>,
			<&ipcc1 IPCC_CLIENT_RTSS0 0x7 IRQ_TYPE_EDGE_RISING>,
			<&ipcc1 IPCC_CLIENT_RTSS2 0x8 IRQ_TYPE_EDGE_RISING>,
			<&ipcc1 IPCC_CLIENT_RTSS1 0x9 IRQ_TYPE_EDGE_RISING>,
			<&ipcc1 IPCC_CLIENT_RTSS2 0xa IRQ_TYPE_EDGE_RISING>,
			<&ipcc1 IPCC_CLIENT_RTSS1 0xb IRQ_TYPE_EDGE_RISING>,
			<&ipcc1 IPCC_CLIENT_RTSS0 0xc IRQ_TYPE_EDGE_RISING>,
			<&ipcc1 IPCC_CLIENT_RTSS0 0xd IRQ_TYPE_EDGE_RISING>,
			<&ipcc1 IPCC_CLIENT_RTSS1 0xe IRQ_TYPE_EDGE_RISING>,
			<&ipcc1 IPCC_CLIENT_RTSS2 0xf IRQ_TYPE_EDGE_RISING>,
			<&ipcc1 IPCC_CLIENT_RTSS3 0x10 IRQ_TYPE_EDGE_RISING>;
		memory-region = <&sail_mailbox_mem>,
				        <&sail_ota_mem>;
	};

	tgu@4b0e000 {
		compatible = "qcom,tgu", "arm,primecell";
		reg = <0x0 0x4b0e000 0x0 0x1000>;

		clocks = <&aoss_qmp>;
		clock-names = "apb_pclk";
	};

	tgu@4b0f000 {
		compatible = "qcom,tgu", "arm,primecell";
		reg = <0x0 0x4b0f000 0x0 0x1000>;

		clocks = <&aoss_qmp>;
		clock-names = "apb_pclk";
	};
};
