// SPDX-License-Identifier: BSD-3-Clause
/*
 * Copyright (c) Qualcomm Technologies, Inc. and/or its subsidiaries.
 */

/dts-v1/;
/plugin/;

/ {
	vreg_s2s: regulator-vreg-s2s {
		compatible = "regulator-fixed";
		regulator-name = "regulator-s2s";

		regulator-min-microvolt = <1800000>;
		regulator-max-microvolt = <1800000>;
	};
};

&sdhc_1 {
	vmmc-supply = <&vreg_l8a>;
	vqmmc-supply = <&vreg_s2s>;

	supports-cqe;

	pinctrl-0 = <&sdc1_state_on>;
	pinctrl-1 = <&sdc1_state_off>;

	pinctrl-names = "default", "sleep";

	non-removable;

	bus-width = <8>;
	no-sd;
	no-sdio;

	status = "okay";
};
