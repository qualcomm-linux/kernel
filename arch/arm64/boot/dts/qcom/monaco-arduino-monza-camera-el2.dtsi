// SPDX-License-Identifier: BSD-3-Clause
/*
 * Copyright (c) Qualcomm Technologies, Inc. and/or its subsidiaries.
 */

&cam_cpas {
        enable-secure-qos-update = <0>;
};

&cam_icp_firmware {
	camera-firmware {
		iommus = <&apps_smmu 0x08C1 0x0400>;
	};
};
