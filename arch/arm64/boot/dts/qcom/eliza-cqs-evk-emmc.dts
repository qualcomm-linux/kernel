// SPDX-License-Identifier: BSD-3-Clause
/*
 * Copyright (c) Qualcomm Technologies, Inc. and/or its subsidiaries.
 */

/dts-v1/;

#include "eliza-cqs-som-emmc.dtsi"
#include "eliza-evk.dtsi"

/ {
	model = "Qualcomm Technologies, Inc. Eliza CQS EVK (eMMC)";
	compatible = "qcom,eliza-cqs-evk-emmc",
		     "qcom,eliza-cqs-evk",
		     "qcom,eliza-cqs-som-emmc",
		     "qcom,eliza-cqs-som",
		     "qcom,eliza";
};
