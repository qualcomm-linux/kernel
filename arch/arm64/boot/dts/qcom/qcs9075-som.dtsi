// SPDX-License-Identifier: BSD-3-Clause
/*
 * Copyright (c) 2025, Qualcomm Innovation Center, Inc. All rights reserved.
 */

/dts-v1/;

#include "sa8775p.dtsi"
#include "iq9-reserved-memory.dtsi"
#include "sa8775p-pmics.dtsi"
