// SPDX-License-Identifier: BSD-3-Clause
/*
 * Copyright (c) Qualcomm Technologies, Inc. and/or its subsidiaries.
 *
 * Shikra specific modifications required to boot in EL2.
 */

/dts-v1/;
/plugin/;

&gpu_zap_shader {
	status = "disabled";
};

&remoteproc_cdsp {
	iommus = <&apps_smmu 0x0200 0x0>;
};

&remoteproc_lpaicp {
	iommus = <&apps_smmu 0x0360 0x0005>,
		 <&apps_smmu 0x0366 0x0000>,
		 <&apps_smmu 0x00e7 0x0000>;
};
