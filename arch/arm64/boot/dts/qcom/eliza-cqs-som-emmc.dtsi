// SPDX-License-Identifier: BSD-3-Clause
/*
 * Copyright (c) Qualcomm Technologies, Inc. and/or its subsidiaries.
 */

#include "eliza-cqs-som.dtsi"

&sdhc_1 {
	vmmc-supply = <&vreg_l12b>;
	vqmmc-supply = <&vreg_l1d>;
	pinctrl-0 = <&sdc1_default>;
	pinctrl-1 = <&sdc1_sleep>;
	pinctrl-names = "default", "sleep";
	mmc-hs400-1_8v;
	mmc-hs200-1_8v;
	non-removable;
	supports-cqe;
	no-sdio;
	no-sd;

	status = "okay";
};

&vreg_l1d {
	regulator-min-microvolt = <1800000>;
	regulator-max-microvolt = <1800000>;
};
