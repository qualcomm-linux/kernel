// SPDX-License-Identifier: BSD-3-Clause
/*
 * Copyright (c) Qualcomm Technologies, Inc. and/or its subsidiaries.
 */

/dts-v1/;

#include "eliza-cqs-som-ufs.dtsi"
#include "eliza-evk.dtsi"

/ {
	model = "Qualcomm Technologies, Inc. Eliza CQS EVK";
	compatible = "qcom,eliza-cqs-evk-ufs",
		     "qcom,eliza-cqs-evk",
		     "qcom,eliza-cqs-som-ufs",
		     "qcom,eliza-cqs-som",
		     "qcom,eliza";
};
