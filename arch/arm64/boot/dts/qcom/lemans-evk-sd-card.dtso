// SPDX-License-Identifier: BSD-3-Clause
/*
 * Copyright (c) Qualcomm Technologies, Inc. and/or its subsidiaries.
 */

/dts-v1/;
/plugin/;

#include <dt-bindings/gpio/gpio.h>

&sdhc {
	vmmc-supply = <&vmmc_sdc>;
	vqmmc-supply = <&vreg_sdc>;

	pinctrl-0 = <&sdc_default>, <&sd_cd>;
	pinctrl-1 = <&sdc_sleep>, <&sd_cd>;
	pinctrl-names = "default", "sleep";

	bus-width = <4>;
	cd-gpios = <&tlmm 36 GPIO_ACTIVE_LOW>;
	no-mmc;
	no-sdio;

	status = "okay";
};
