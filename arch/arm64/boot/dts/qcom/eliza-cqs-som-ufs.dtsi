// SPDX-License-Identifier: BSD-3-Clause
/*
 * Copyright (c) Qualcomm Technologies, Inc. and/or its subsidiaries.
 */

#include "eliza-cqs-som.dtsi"

&ufs_mem_hc {
	reset-gpios = <&tlmm 185 GPIO_ACTIVE_LOW>;

	vcc-supply = <&vreg_l12b>;
	vcc-max-microamp = <1300000>;
	vccq-supply = <&vreg_l1d>;
	vccq-max-microamp = <1200000>;

	status = "okay";
};

&ufs_mem_phy {
	vdda-phy-supply = <&vreg_l6b>;
	vdda-pll-supply = <&vreg_l4b>;

	status = "okay";
};

&vreg_l1d {
	regulator-min-microvolt = <1140000>;
	regulator-max-microvolt = <1260000>;
};
