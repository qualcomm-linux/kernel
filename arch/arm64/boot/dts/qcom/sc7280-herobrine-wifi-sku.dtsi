// SPDX-License-Identifier: BSD-3-Clause
/*
 * Google Herobrine dts fragment for WIFI SKUs
 *
 * Copyright (c) 2022 Qualcomm Innovation Center, Inc. All rights reserved.
 */

/* WIFI SKUs save 256M by not having modem/mba/rmtfs memory regions defined. */

&mdmss0_thermal {
	/delete-node/ cooling-maps;
};

&mdmss1_thermal {
	/delete-node/ cooling-maps;
};

&mdmss2_thermal {
	/delete-node/ cooling-maps;
};

&mdmss3_thermal {
	/delete-node/ cooling-maps;
};

/delete-node/ &mpss_mem;
/delete-node/ &remoteproc_mpss;
/delete-node/ &rmtfs_mem;
