// SPDX-License-Identifier: GPL-2.0-only
/*
 * Copyright (c) Qualcomm Technologies, Inc. and/or its subsidiaries.
 */

#define PMH0110_F_E0	0x5
#define PMH0110_H_E0	0x7
#define PMH0104_I_E0	0x8
#define PMH0104_J_E0	0x9

#define PMH0110_F_E1	0x5
#define PMH0104_L_E1	0xb

#include "pmk8850.dtsi"	/* SPMI0: SID-0*/
#include "pmh0101.dtsi"	/* SPMI0: SID-1*/
#include "pmcx0102.dtsi"	/* SPMI0: SID-2/3/4/6	SPMI1: SID-2/3/4 */
#include "pmh0110.dtsi"	/* SPMI0: SID-5/7	SPMI1: SID-5	*/
#include "pmh0104.dtsi"	/* SPMI0: SID-8/9	SPMI1: SID-11	*/
