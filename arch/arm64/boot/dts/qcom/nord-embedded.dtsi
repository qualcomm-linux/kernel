// SPDX-License-Identifier: BSD-3-Clause
/*
 * Copyright (c) Qualcomm Technologies, Inc. and/or its subsidiaries.
 */

#include <dt-bindings/clock/qcom,glymur-videocc.h>
#include <dt-bindings/clock/qcom,nord-camcc.h>
#include <dt-bindings/clock/qcom,nord-dispcc.h>
#include <dt-bindings/clock/qcom,nord-gcc.h>
#include <dt-bindings/clock/qcom,nord-gpucc.h>
#include <dt-bindings/clock/qcom,nord-negcc.h>
#include <dt-bindings/clock/qcom,nord-nwgcc.h>
#include <dt-bindings/clock/qcom,nord-segcc.h>
#include <dt-bindings/clock/qcom,nord-tcsrcc.h>
#include <dt-bindings/clock/qcom,rpmh.h>
#include <dt-bindings/interconnect/qcom,icc.h>
#include <dt-bindings/interconnect/qcom,nord-rpmh.h>
#include <dt-bindings/phy/phy-qcom-qmp.h>
#include <dt-bindings/power/qcom,rpmhpd.h>
#include <dt-bindings/soc/qcom,rpmh-rsc.h>

#include "nord.dtsi"

/ {
	clk_virt: interconnect-clk-virt {
		compatible = "qcom,nord-clk-virt";
		#interconnect-cells = <2>;
		qcom,bcm-voters = <&apps_bcm_voter>;
	};

	mc_virt: interconnect-mc-virt {
		compatible = "qcom,nord-mc-virt";
		#interconnect-cells = <2>;
		qcom,bcm-voters = <&apps_bcm_voter>;
	};
};

&crypto {
	interconnects = <&aggre1_noc_tile MASTER_CRYPTO_CORE0 QCOM_ICC_TAG_ALWAYS
			 &mc_virt SLAVE_EBI1 QCOM_ICC_TAG_ALWAYS>;
	interconnect-names = "memory";

	status = "okay";
};

&i2c0 {
	clocks = <&segcc SE_GCC_QUPV3_WRAP0_S0_CLK>;
	clock-names = "se";
	interconnects = <&clk_virt MASTER_QUP_CORE_0 QCOM_ICC_TAG_ALWAYS
			 &clk_virt SLAVE_QUP_CORE_0 QCOM_ICC_TAG_ALWAYS>,
			<&hscnoc MASTER_APPSS_PROC QCOM_ICC_TAG_ALWAYS
			 &config_noc SLAVE_QUP_0 QCOM_ICC_TAG_ALWAYS>,
			<&aggre2_noc_tile MASTER_QUP_0 QCOM_ICC_TAG_ALWAYS
			 &mc_virt SLAVE_EBI1 QCOM_ICC_TAG_ALWAYS>;
	interconnect-names = "qup-core",
			     "qup-config",
			     "qup-memory";
	pinctrl-0 = <&qup_i2c0_default>;
	pinctrl-names = "default";
};

&i2c1 {
	clocks = <&segcc SE_GCC_QUPV3_WRAP0_S1_CLK>;
	clock-names = "se";
	interconnects = <&clk_virt MASTER_QUP_CORE_0 QCOM_ICC_TAG_ALWAYS
			 &clk_virt SLAVE_QUP_CORE_0 QCOM_ICC_TAG_ALWAYS>,
			<&hscnoc MASTER_APPSS_PROC QCOM_ICC_TAG_ALWAYS
			 &config_noc SLAVE_QUP_0 QCOM_ICC_TAG_ALWAYS>,
			<&aggre2_noc_tile MASTER_QUP_0 QCOM_ICC_TAG_ALWAYS
			 &mc_virt SLAVE_EBI1 QCOM_ICC_TAG_ALWAYS>;
	interconnect-names = "qup-core",
			     "qup-config",
			     "qup-memory";
	pinctrl-0 = <&qup_i2c1_default>;
	pinctrl-names = "default";
};

&i2c2 {
	clocks = <&segcc SE_GCC_QUPV3_WRAP0_S2_CLK>;
	clock-names = "se";
	interconnects = <&clk_virt MASTER_QUP_CORE_0 QCOM_ICC_TAG_ALWAYS
			 &clk_virt SLAVE_QUP_CORE_0 QCOM_ICC_TAG_ALWAYS>,
			<&hscnoc MASTER_APPSS_PROC QCOM_ICC_TAG_ALWAYS
			 &config_noc SLAVE_QUP_0 QCOM_ICC_TAG_ALWAYS>,
			<&aggre2_noc_tile MASTER_QUP_0 QCOM_ICC_TAG_ALWAYS
			 &mc_virt SLAVE_EBI1 QCOM_ICC_TAG_ALWAYS>;
	interconnect-names = "qup-core",
			     "qup-config",
			     "qup-memory";
	pinctrl-0 = <&qup_i2c2_default>;
	pinctrl-names = "default";
};

&i2c3 {
	clocks = <&segcc SE_GCC_QUPV3_WRAP0_S3_CLK>;
	clock-names = "se";
	interconnects = <&clk_virt MASTER_QUP_CORE_0 QCOM_ICC_TAG_ALWAYS
			 &clk_virt SLAVE_QUP_CORE_0 QCOM_ICC_TAG_ALWAYS>,
			<&hscnoc MASTER_APPSS_PROC QCOM_ICC_TAG_ALWAYS
			 &config_noc SLAVE_QUP_0 QCOM_ICC_TAG_ALWAYS>,
			<&aggre2_noc_tile MASTER_QUP_0 QCOM_ICC_TAG_ALWAYS
			 &mc_virt SLAVE_EBI1 QCOM_ICC_TAG_ALWAYS>;
	interconnect-names = "qup-core",
			     "qup-config",
			     "qup-memory";
	pinctrl-0 = <&qup_i2c3_default>;
	pinctrl-names = "default";
};

&i2c4 {
	clocks = <&segcc SE_GCC_QUPV3_WRAP0_S4_CLK>;
	clock-names = "se";
	interconnects = <&clk_virt MASTER_QUP_CORE_0 QCOM_ICC_TAG_ALWAYS
			 &clk_virt SLAVE_QUP_CORE_0 QCOM_ICC_TAG_ALWAYS>,
			<&hscnoc MASTER_APPSS_PROC QCOM_ICC_TAG_ALWAYS
			 &config_noc SLAVE_QUP_0 QCOM_ICC_TAG_ALWAYS>,
			<&aggre2_noc_tile MASTER_QUP_0 QCOM_ICC_TAG_ALWAYS
			 &mc_virt SLAVE_EBI1 QCOM_ICC_TAG_ALWAYS>;
	interconnect-names = "qup-core",
			     "qup-config",
			     "qup-memory";
	pinctrl-0 = <&qup_i2c4_default>;
	pinctrl-names = "default";
};

&i2c5 {
	clocks = <&segcc SE_GCC_QUPV3_WRAP0_S5_CLK>;
	clock-names = "se";
	interconnects = <&clk_virt MASTER_QUP_CORE_0 QCOM_ICC_TAG_ALWAYS
			 &clk_virt SLAVE_QUP_CORE_0 QCOM_ICC_TAG_ALWAYS>,
			<&hscnoc MASTER_APPSS_PROC QCOM_ICC_TAG_ALWAYS
			 &config_noc SLAVE_QUP_0 QCOM_ICC_TAG_ALWAYS>,
			<&aggre2_noc_tile MASTER_QUP_0 QCOM_ICC_TAG_ALWAYS
			 &mc_virt SLAVE_EBI1 QCOM_ICC_TAG_ALWAYS>;
	interconnect-names = "qup-core",
			     "qup-config",
			     "qup-memory";
	pinctrl-0 = <&qup_i2c5_default>;
	pinctrl-names = "default";
};

&i2c7 {
	clocks = <&segcc SE_GCC_QUPV3_WRAP1_S0_CLK>;
	clock-names = "se";
	interconnects = <&clk_virt MASTER_QUP_CORE_1 QCOM_ICC_TAG_ALWAYS
			 &clk_virt SLAVE_QUP_CORE_1 QCOM_ICC_TAG_ALWAYS>,
			<&hscnoc MASTER_APPSS_PROC QCOM_ICC_TAG_ALWAYS
			 &config_noc SLAVE_QUP_1 QCOM_ICC_TAG_ALWAYS>,
			<&aggre2_noc_tile MASTER_QUP_1 QCOM_ICC_TAG_ALWAYS
			 &mc_virt SLAVE_EBI1 QCOM_ICC_TAG_ALWAYS>;
	interconnect-names = "qup-core",
			     "qup-config",
			     "qup-memory";
	pinctrl-0 = <&qup_i2c7_default>;
	pinctrl-names = "default";
};

&i2c8 {
	clocks = <&segcc SE_GCC_QUPV3_WRAP1_S1_CLK>;
	clock-names = "se";
	interconnects = <&clk_virt MASTER_QUP_CORE_1 QCOM_ICC_TAG_ALWAYS
			 &clk_virt SLAVE_QUP_CORE_1 QCOM_ICC_TAG_ALWAYS>,
			<&hscnoc MASTER_APPSS_PROC QCOM_ICC_TAG_ALWAYS
			 &config_noc SLAVE_QUP_1 QCOM_ICC_TAG_ALWAYS>,
			<&aggre2_noc_tile MASTER_QUP_1 QCOM_ICC_TAG_ALWAYS
			 &mc_virt SLAVE_EBI1 QCOM_ICC_TAG_ALWAYS>;
	interconnect-names = "qup-core",
			     "qup-config",
			     "qup-memory";
	pinctrl-0 = <&qup_i2c8_default>;
	pinctrl-names = "default";
};

&i2c9 {
	clocks = <&segcc SE_GCC_QUPV3_WRAP1_S2_CLK>;
	clock-names = "se";
	interconnects = <&clk_virt MASTER_QUP_CORE_1 QCOM_ICC_TAG_ALWAYS
			 &clk_virt SLAVE_QUP_CORE_1 QCOM_ICC_TAG_ALWAYS>,
			<&hscnoc MASTER_APPSS_PROC QCOM_ICC_TAG_ALWAYS
			 &config_noc SLAVE_QUP_1 QCOM_ICC_TAG_ALWAYS>,
			<&aggre2_noc_tile MASTER_QUP_1 QCOM_ICC_TAG_ALWAYS
			 &mc_virt SLAVE_EBI1 QCOM_ICC_TAG_ALWAYS>;
	interconnect-names = "qup-core",
			     "qup-config",
			     "qup-memory";
	pinctrl-0 = <&qup_i2c9_default>;
	pinctrl-names = "default";
};

&i2c10 {
	clocks = <&segcc SE_GCC_QUPV3_WRAP1_S3_CLK>;
	clock-names = "se";
	interconnects = <&clk_virt MASTER_QUP_CORE_1 QCOM_ICC_TAG_ALWAYS
			 &clk_virt SLAVE_QUP_CORE_1 QCOM_ICC_TAG_ALWAYS>,
			<&hscnoc MASTER_APPSS_PROC QCOM_ICC_TAG_ALWAYS
			 &config_noc SLAVE_QUP_1 QCOM_ICC_TAG_ALWAYS>,
			<&aggre2_noc_tile MASTER_QUP_1 QCOM_ICC_TAG_ALWAYS
			 &mc_virt SLAVE_EBI1 QCOM_ICC_TAG_ALWAYS>;
	interconnect-names = "qup-core",
			     "qup-config",
			     "qup-memory";
	pinctrl-0 = <&qup_i2c10_default>;
	pinctrl-names = "default";
};

&i2c11 {
	clocks = <&segcc SE_GCC_QUPV3_WRAP1_S4_CLK>;
	clock-names = "se";
	interconnects = <&clk_virt MASTER_QUP_CORE_1 QCOM_ICC_TAG_ALWAYS
			 &clk_virt SLAVE_QUP_CORE_1 QCOM_ICC_TAG_ALWAYS>,
			<&hscnoc MASTER_APPSS_PROC QCOM_ICC_TAG_ALWAYS
			 &config_noc SLAVE_QUP_1 QCOM_ICC_TAG_ALWAYS>,
			<&aggre2_noc_tile MASTER_QUP_1 QCOM_ICC_TAG_ALWAYS
			 &mc_virt SLAVE_EBI1 QCOM_ICC_TAG_ALWAYS>;
	interconnect-names = "qup-core",
			     "qup-config",
			     "qup-memory";
	pinctrl-0 = <&qup_i2c11_default>;
	pinctrl-names = "default";
};

&i2c12 {
	clocks = <&segcc SE_GCC_QUPV3_WRAP1_S5_CLK>;
	clock-names = "se";
	interconnects = <&clk_virt MASTER_QUP_CORE_1 QCOM_ICC_TAG_ALWAYS
			 &clk_virt SLAVE_QUP_CORE_1 QCOM_ICC_TAG_ALWAYS>,
			<&hscnoc MASTER_APPSS_PROC QCOM_ICC_TAG_ALWAYS
			 &config_noc SLAVE_QUP_1 QCOM_ICC_TAG_ALWAYS>,
			<&aggre2_noc_tile MASTER_QUP_1 QCOM_ICC_TAG_ALWAYS
			 &mc_virt SLAVE_EBI1 QCOM_ICC_TAG_ALWAYS>;
	interconnect-names = "qup-core",
			     "qup-config",
			     "qup-memory";
	pinctrl-0 = <&qup_i2c12_default>;
	pinctrl-names = "default";
};

&i2c13 {
	clocks = <&segcc SE_GCC_QUPV3_WRAP1_S6_CLK>;
	clock-names = "se";
	interconnects = <&clk_virt MASTER_QUP_CORE_1 QCOM_ICC_TAG_ALWAYS
			 &clk_virt SLAVE_QUP_CORE_1 QCOM_ICC_TAG_ALWAYS>,
			<&hscnoc MASTER_APPSS_PROC QCOM_ICC_TAG_ALWAYS
			 &config_noc SLAVE_QUP_1 QCOM_ICC_TAG_ALWAYS>,
			<&aggre2_noc_tile MASTER_QUP_1 QCOM_ICC_TAG_ALWAYS
			 &mc_virt SLAVE_EBI1 QCOM_ICC_TAG_ALWAYS>;
	interconnect-names = "qup-core",
			     "qup-config",
			     "qup-memory";
	pinctrl-0 = <&qup_i2c13_default>;
	pinctrl-names = "default";
};

&i2c14 {
	clocks = <&negcc NE_GCC_QUPV3_WRAP2_S0_CLK>;
	clock-names = "se";
	interconnects = <&clk_virt MASTER_QUP_CORE_2 QCOM_ICC_TAG_ALWAYS
			 &clk_virt SLAVE_QUP_CORE_2 QCOM_ICC_TAG_ALWAYS>,
			<&hscnoc MASTER_APPSS_PROC QCOM_ICC_TAG_ALWAYS
			 &config_noc SLAVE_QUP_2 QCOM_ICC_TAG_ALWAYS>,
			<&aggre1_noc_tile MASTER_QUP_2 QCOM_ICC_TAG_ALWAYS
			 &mc_virt SLAVE_EBI1 QCOM_ICC_TAG_ALWAYS>;
	interconnect-names = "qup-core",
			     "qup-config",
			     "qup-memory";
	pinctrl-0 = <&qup_i2c14_default>;
	pinctrl-names = "default";
};

&i2c16 {
	clocks = <&negcc NE_GCC_QUPV3_WRAP2_S2_CLK>;
	clock-names = "se";
	interconnects = <&clk_virt MASTER_QUP_CORE_2 QCOM_ICC_TAG_ALWAYS
			 &clk_virt SLAVE_QUP_CORE_2 QCOM_ICC_TAG_ALWAYS>,
			<&hscnoc MASTER_APPSS_PROC QCOM_ICC_TAG_ALWAYS
			 &config_noc SLAVE_QUP_2 QCOM_ICC_TAG_ALWAYS>,
			<&aggre1_noc_tile MASTER_QUP_2 QCOM_ICC_TAG_ALWAYS
			 &mc_virt SLAVE_EBI1 QCOM_ICC_TAG_ALWAYS>;
	interconnect-names = "qup-core",
			     "qup-config",
			     "qup-memory";
	pinctrl-0 = <&qup_i2c16_default>;
	pinctrl-names = "default";
};

&i2c17 {
	clocks = <&negcc NE_GCC_QUPV3_WRAP2_S3_CLK>;
	clock-names = "se";
	interconnects = <&clk_virt MASTER_QUP_CORE_2 QCOM_ICC_TAG_ALWAYS
			 &clk_virt SLAVE_QUP_CORE_2 QCOM_ICC_TAG_ALWAYS>,
			<&hscnoc MASTER_APPSS_PROC QCOM_ICC_TAG_ALWAYS
			 &config_noc SLAVE_QUP_2 QCOM_ICC_TAG_ALWAYS>,
			<&aggre1_noc_tile MASTER_QUP_2 QCOM_ICC_TAG_ALWAYS
			 &mc_virt SLAVE_EBI1 QCOM_ICC_TAG_ALWAYS>;
	interconnect-names = "qup-core",
			     "qup-config",
			     "qup-memory";
	pinctrl-0 = <&qup_i2c17_default>;
	pinctrl-names = "default";
};

&i2c18 {
	clocks = <&negcc NE_GCC_QUPV3_WRAP2_S4_CLK>;
	clock-names = "se";
	interconnects = <&clk_virt MASTER_QUP_CORE_2 QCOM_ICC_TAG_ALWAYS
			 &clk_virt SLAVE_QUP_CORE_2 QCOM_ICC_TAG_ALWAYS>,
			<&hscnoc MASTER_APPSS_PROC QCOM_ICC_TAG_ALWAYS
			 &config_noc SLAVE_QUP_2 QCOM_ICC_TAG_ALWAYS>,
			<&aggre1_noc_tile MASTER_QUP_2 QCOM_ICC_TAG_ALWAYS
			 &mc_virt SLAVE_EBI1 QCOM_ICC_TAG_ALWAYS>;
	interconnect-names = "qup-core",
			     "qup-config",
			     "qup-memory";
	pinctrl-0 = <&qup_i2c18_default>;
	pinctrl-names = "default";
};

&i2c19 {
	clocks = <&negcc NE_GCC_QUPV3_WRAP2_S5_CLK>;
	clock-names = "se";
	interconnects = <&clk_virt MASTER_QUP_CORE_2 QCOM_ICC_TAG_ALWAYS
			 &clk_virt SLAVE_QUP_CORE_2 QCOM_ICC_TAG_ALWAYS>,
			<&hscnoc MASTER_APPSS_PROC QCOM_ICC_TAG_ALWAYS
			 &config_noc SLAVE_QUP_2 QCOM_ICC_TAG_ALWAYS>,
			<&aggre1_noc_tile MASTER_QUP_2 QCOM_ICC_TAG_ALWAYS
			 &mc_virt SLAVE_EBI1 QCOM_ICC_TAG_ALWAYS>;
	interconnect-names = "qup-core",
			     "qup-config",
			     "qup-memory";
	pinctrl-0 = <&qup_i2c19_default>;
	pinctrl-names = "default";
};

&i2c20 {
	clocks = <&negcc NE_GCC_QUPV3_WRAP2_S6_CLK>;
	clock-names = "se";
	interconnects = <&clk_virt MASTER_QUP_CORE_2 QCOM_ICC_TAG_ALWAYS
			 &clk_virt SLAVE_QUP_CORE_2 QCOM_ICC_TAG_ALWAYS>,
			<&hscnoc MASTER_APPSS_PROC QCOM_ICC_TAG_ALWAYS
			 &config_noc SLAVE_QUP_2 QCOM_ICC_TAG_ALWAYS>,
			<&aggre1_noc_tile MASTER_QUP_2 QCOM_ICC_TAG_ALWAYS
			 &mc_virt SLAVE_EBI1 QCOM_ICC_TAG_ALWAYS>;
	interconnect-names = "qup-core",
			     "qup-config",
			     "qup-memory";
	pinctrl-0 = <&qup_i2c20_default>;
	pinctrl-names = "default";
};

&pcie0 {
	clocks = <&gcc GCC_PCIE_A_AUX_CLK>,
		 <&gcc GCC_PCIE_A_CFG_AHB_CLK>,
		 <&gcc GCC_PCIE_A_MSTR_AXI_CLK>,
		 <&gcc GCC_PCIE_A_SLV_AXI_CLK>,
		 <&gcc GCC_PCIE_A_SLV_Q2A_AXI_CLK>;
	clock-names = "aux",
		      "cfg",
		      "bus_master",
		      "bus_slave",
		      "slave_q2a";

	assigned-clocks = <&gcc GCC_PCIE_A_AUX_CLK>;
	assigned-clock-rates = <19200000>;

	interconnects = <&pcie_data_inbound MASTER_PCIE_0 QCOM_ICC_TAG_ALWAYS
			 &mc_virt SLAVE_EBI1 QCOM_ICC_TAG_ALWAYS>,
			<&hscnoc MASTER_APPSS_PROC QCOM_ICC_TAG_ALWAYS
			 &config_noc SLAVE_PCIE_0 QCOM_ICC_TAG_ALWAYS>;
	interconnect-names = "pcie-mem",
			     "cpu-pcie";

	power-domains = <&gcc GCC_PCIE_A_GDSC>;

	resets = <&gcc GCC_PCIE_A_BCR>,
		 <&gcc GCC_PCIE_A_LINK_DOWN_BCR>;
	reset-names = "pci",
		      "link_down";

	pinctrl-0 = <&pcie0_default>;
	pinctrl-names = "default";

	operating-points-v2 = <&pcie0_opp_table>;

	pcie0_opp_table: opp-table {
		compatible = "operating-points-v2";

		/* GEN 1 x1 */
		opp-2500000-1 {
			opp-hz = /bits/ 64 <2500000>;
			required-opps = <&rpmhpd_opp_low_svs>;
			opp-peak-kBps = <250000 1>;
			opp-level = <1>;
		};

		/* GEN 1 x2 */
		opp-5000000-1 {
			opp-hz = /bits/ 64 <5000000>;
			required-opps = <&rpmhpd_opp_low_svs>;
			opp-peak-kBps = <500000 1>;
			opp-level = <1>;
		};

		/* GEN 1 x4 */
		opp-10000000-1 {
			opp-hz = /bits/ 64 <10000000>;
			required-opps = <&rpmhpd_opp_low_svs>;
			opp-peak-kBps = <1000000 1>;
			opp-level = <1>;
		};

		/* GEN 1 x8 */
		opp-20000000-1 {
			opp-hz = /bits/ 64 <20000000>;
			required-opps = <&rpmhpd_opp_low_svs>;
			opp-peak-kBps = <2000000 1>;
			opp-level = <1>;
		};

		/* GEN 1 x16 */
		opp-40000000-1 {
			opp-hz = /bits/ 64 <40000000>;
			required-opps = <&rpmhpd_opp_low_svs>;
			opp-peak-kBps = <4000000 1>;
			opp-level = <1>;
		};

		/* GEN 2 x1 */
		opp-5000000-2 {
			opp-hz = /bits/ 64 <5000000>;
			required-opps = <&rpmhpd_opp_low_svs>;
			opp-peak-kBps = <500000 1>;
			opp-level = <2>;
		};

		/* GEN 2 x2 */
		opp-10000000-2 {
			opp-hz = /bits/ 64 <10000000>;
			required-opps = <&rpmhpd_opp_low_svs>;
			opp-peak-kBps = <1000000 1>;
			opp-level = <2>;
		};

		/* GEN 2 x4 */
		opp-20000000-2 {
			opp-hz = /bits/ 64 <20000000>;
			required-opps = <&rpmhpd_opp_low_svs>;
			opp-peak-kBps = <2000000 1>;
			opp-level = <2>;
		};

		/* GEN 2 x8 */
		opp-40000000-2 {
			opp-hz = /bits/ 64 <40000000>;
			required-opps = <&rpmhpd_opp_low_svs>;
			opp-peak-kBps = <4000000 1>;
			opp-level = <2>;
		};

		/* GEN 2 x16 */
		opp-80000000-2 {
			opp-hz = /bits/ 64 <80000000>;
			required-opps = <&rpmhpd_opp_low_svs>;
			opp-peak-kBps = <8000000 1>;
			opp-level = <2>;
		};

		/* GEN 3 x1 */
		opp-8000000-3 {
			opp-hz = /bits/ 64 <8000000>;
			required-opps = <&rpmhpd_opp_low_svs>;
			opp-peak-kBps = <984500 1>;
			opp-level = <3>;
		};

		/* GEN 3 x2 */
		opp-16000000-3 {
			opp-hz = /bits/ 64 <16000000>;
			required-opps = <&rpmhpd_opp_low_svs>;
			opp-peak-kBps = <1969000 1>;
			opp-level = <3>;
		};

		/* GEN 3 x4 */
		opp-32000000-3 {
			opp-hz = /bits/ 64 <32000000>;
			required-opps = <&rpmhpd_opp_low_svs>;
			opp-peak-kBps = <3938000 1>;
			opp-level = <3>;
		};

		/* GEN 3 x8 */
		opp-64000000-3 {
			opp-hz = /bits/ 64 <64000000>;
			required-opps = <&rpmhpd_opp_low_svs>;
			opp-peak-kBps = <7876000 1>;
			opp-level = <3>;
		};

		/* GEN 3 x16 */
		opp-128000000-3 {
			opp-hz = /bits/ 64 <128000000>;
			required-opps = <&rpmhpd_opp_low_svs>;
			opp-peak-kBps = <15753000 1>;
			opp-level = <3>;
		};

		/* GEN 4 x1 */
		opp-16000000-4 {
			opp-hz = /bits/ 64 <16000000>;
			required-opps = <&rpmhpd_opp_svs>;
			opp-peak-kBps = <1969000 1>;
			opp-level = <4>;
		};

		/* GEN 4 x2 */
		opp-32000000-4 {
			opp-hz = /bits/ 64 <32000000>;
			required-opps = <&rpmhpd_opp_svs>;
			opp-peak-kBps = <3938000 1>;
			opp-level = <4>;
		};

		/* GEN 4 x4 */
		opp-64000000-4 {
			opp-hz = /bits/ 64 <64000000>;
			required-opps = <&rpmhpd_opp_svs>;
			opp-peak-kBps = <7876000 1>;
			opp-level = <4>;
		};

		/* GEN 4 x8 */
		opp-128000000-4 {
			opp-hz = /bits/ 64 <128000000>;
			required-opps = <&rpmhpd_opp_svs>;
			opp-peak-kBps = <15753000 1>;
			opp-level = <4>;
		};

		/* GEN 4 x16 */
		opp-256000000-4 {
			opp-hz = /bits/ 64 <256000000>;
			required-opps = <&rpmhpd_opp_svs>;
			opp-peak-kBps = <31506000 1>;
			opp-level = <4>;
		};

		/* GEN 5 x1 */
		opp-32000000-5 {
			opp-hz = /bits/ 64 <32000000>;
			required-opps = <&rpmhpd_opp_nom>;
			opp-peak-kBps = <3938000 1>;
			opp-level = <5>;
		};

		/* GEN 5 x2 */
		opp-64000000-5 {
			opp-hz = /bits/ 64 <64000000>;
			required-opps = <&rpmhpd_opp_nom>;
			opp-peak-kBps = <7876000 1>;
			opp-level = <5>;
		};

		/* GEN 5 x4 */
		opp-128000000-5 {
			opp-hz = /bits/ 64 <128000000>;
			required-opps = <&rpmhpd_opp_nom>;
			opp-peak-kBps = <15753000 1>;
			opp-level = <5>;
		};

		/* GEN 5 x8 */
		opp-256000000-5 {
			opp-hz = /bits/ 64 <256000000>;
			required-opps = <&rpmhpd_opp_nom>;
			opp-peak-kBps = <31506000 1>;
			opp-level = <5>;
		};

		/* GEN 5 x16 */
		opp-512000000-5 {
			opp-hz = /bits/ 64 <512000000>;
			required-opps = <&rpmhpd_opp_nom>;
			opp-peak-kBps = <63012000 1>;
			opp-level = <5>;
		};
	};
};

&pcie0_port0 {
	phys = <&pcie_phy 0>;
};

&pcie1 {
	clocks = <&gcc GCC_PCIE_B_AUX_CLK>,
		 <&gcc GCC_PCIE_B_CFG_AHB_CLK>,
		 <&gcc GCC_PCIE_B_MSTR_AXI_CLK>,
		 <&gcc GCC_PCIE_B_SLV_AXI_CLK>,
		 <&gcc GCC_PCIE_B_SLV_Q2A_AXI_CLK>;
	clock-names = "aux",
		      "cfg",
		      "bus_master",
		      "bus_slave",
		      "slave_q2a";

	assigned-clocks = <&gcc GCC_PCIE_B_AUX_CLK>;
	assigned-clock-rates = <19200000>;

	interconnects = <&pcie_data_inbound MASTER_PCIE_1 QCOM_ICC_TAG_ALWAYS
			 &mc_virt SLAVE_EBI1 QCOM_ICC_TAG_ALWAYS>,
			<&hscnoc MASTER_APPSS_PROC QCOM_ICC_TAG_ALWAYS
			 &config_noc SLAVE_PCIE_1 QCOM_ICC_TAG_ALWAYS>;
	interconnect-names = "pcie-mem",
			     "cpu-pcie";

	power-domains = <&gcc GCC_PCIE_B_GDSC>;

	resets = <&gcc GCC_PCIE_B_BCR>,
		 <&gcc GCC_PCIE_B_LINK_DOWN_BCR>;
	reset-names = "pci",
		      "link_down";

	pinctrl-0 = <&pcie1_default>;
	pinctrl-names = "default";

	operating-points-v2 = <&pcie1_opp_table>;

	pcie1_opp_table: opp-table {
		compatible = "operating-points-v2";

		/* GEN 1 x1 */
		opp-2500000-1 {
			opp-hz = /bits/ 64 <2500000>;
			required-opps = <&rpmhpd_opp_low_svs>;
			opp-peak-kBps = <250000 1>;
			opp-level = <1>;
		};

		/* GEN 1 x2 */
		opp-5000000-1 {
			opp-hz = /bits/ 64 <5000000>;
			required-opps = <&rpmhpd_opp_low_svs>;
			opp-peak-kBps = <500000 1>;
			opp-level = <1>;
		};

		/* GEN 1 x4 */
		opp-10000000-1 {
			opp-hz = /bits/ 64 <10000000>;
			required-opps = <&rpmhpd_opp_low_svs>;
			opp-peak-kBps = <1000000 1>;
			opp-level = <1>;
		};

		/* GEN 1 x8 */
		opp-20000000-1 {
			opp-hz = /bits/ 64 <20000000>;
			required-opps = <&rpmhpd_opp_low_svs>;
			opp-peak-kBps = <2000000 1>;
			opp-level = <1>;
		};

		/* GEN 2 x1 */
		opp-5000000-2 {
			opp-hz = /bits/ 64 <5000000>;
			required-opps = <&rpmhpd_opp_low_svs>;
			opp-peak-kBps = <500000 1>;
			opp-level = <2>;
		};

		/* GEN 2 x2 */
		opp-10000000-2 {
			opp-hz = /bits/ 64 <10000000>;
			required-opps = <&rpmhpd_opp_low_svs>;
			opp-peak-kBps = <1000000 1>;
			opp-level = <2>;
		};

		/* GEN 2 x4 */
		opp-20000000-2 {
			opp-hz = /bits/ 64 <20000000>;
			required-opps = <&rpmhpd_opp_low_svs>;
			opp-peak-kBps = <2000000 1>;
			opp-level = <2>;
		};

		/* GEN 2 x8 */
		opp-40000000-2 {
			opp-hz = /bits/ 64 <40000000>;
			required-opps = <&rpmhpd_opp_low_svs>;
			opp-peak-kBps = <4000000 1>;
			opp-level = <2>;
		};

		/* GEN 3 x1 */
		opp-8000000-3 {
			opp-hz = /bits/ 64 <8000000>;
			required-opps = <&rpmhpd_opp_low_svs>;
			opp-peak-kBps = <984500 1>;
			opp-level = <3>;
		};

		/* GEN 3 x2 */
		opp-16000000-3 {
			opp-hz = /bits/ 64 <16000000>;
			required-opps = <&rpmhpd_opp_low_svs>;
			opp-peak-kBps = <1969000 1>;
			opp-level = <3>;
		};

		/* GEN 3 x4 */
		opp-32000000-3 {
			opp-hz = /bits/ 64 <32000000>;
			required-opps = <&rpmhpd_opp_low_svs>;
			opp-peak-kBps = <3938000 1>;
			opp-level = <3>;
		};

		/* GEN 3 x8 */
		opp-64000000-3 {
			opp-hz = /bits/ 64 <64000000>;
			required-opps = <&rpmhpd_opp_low_svs>;
			opp-peak-kBps = <7876000 1>;
			opp-level = <3>;
		};

		/* GEN 4 x1 */
		opp-16000000-4 {
			opp-hz = /bits/ 64 <16000000>;
			required-opps = <&rpmhpd_opp_svs>;
			opp-peak-kBps = <1969000 1>;
			opp-level = <4>;
		};

		/* GEN 4 x2 */
		opp-32000000-4 {
			opp-hz = /bits/ 64 <32000000>;
			required-opps = <&rpmhpd_opp_svs>;
			opp-peak-kBps = <3938000 1>;
			opp-level = <4>;
		};

		/* GEN 4 x4 */
		opp-64000000-4 {
			opp-hz = /bits/ 64 <64000000>;
			required-opps = <&rpmhpd_opp_svs>;
			opp-peak-kBps = <7876000 1>;
			opp-level = <4>;
		};

		/* GEN 4 x8 */
		opp-128000000-4 {
			opp-hz = /bits/ 64 <128000000>;
			required-opps = <&rpmhpd_opp_svs>;
			opp-peak-kBps = <15753000 1>;
			opp-level = <4>;
		};

		/* GEN 5 x1 */
		opp-32000000-5 {
			opp-hz = /bits/ 64 <32000000>;
			required-opps = <&rpmhpd_opp_nom>;
			opp-peak-kBps = <3938000 1>;
			opp-level = <5>;
		};

		/* GEN 5 x2 */
		opp-64000000-5 {
			opp-hz = /bits/ 64 <64000000>;
			required-opps = <&rpmhpd_opp_nom>;
			opp-peak-kBps = <7876000 1>;
			opp-level = <5>;
		};

		/* GEN 5 x4 */
		opp-128000000-5 {
			opp-hz = /bits/ 64 <128000000>;
			required-opps = <&rpmhpd_opp_nom>;
			opp-peak-kBps = <15753000 1>;
			opp-level = <5>;
		};

		/* GEN 5 x8 */
		opp-256000000-5 {
			opp-hz = /bits/ 64 <256000000>;
			required-opps = <&rpmhpd_opp_nom>;
			opp-peak-kBps = <31506000 1>;
			opp-level = <5>;
		};
	};
};

&pcie1_port0 {
	phys = <&pcie_phy 1>;
};

&pcie2 {
	clocks = <&gcc GCC_PCIE_C_AUX_CLK>,
		 <&gcc GCC_PCIE_C_CFG_AHB_CLK>,
		 <&gcc GCC_PCIE_C_MSTR_AXI_CLK>,
		 <&gcc GCC_PCIE_C_SLV_AXI_CLK>,
		 <&gcc GCC_PCIE_C_SLV_Q2A_AXI_CLK>;
	clock-names = "aux",
		      "cfg",
		      "bus_master",
		      "bus_slave",
		      "slave_q2a";

	assigned-clocks = <&gcc GCC_PCIE_C_AUX_CLK>;
	assigned-clock-rates = <19200000>;

	interconnects = <&pcie_data_inbound MASTER_PCIE_2 QCOM_ICC_TAG_ALWAYS
			 &mc_virt SLAVE_EBI1 QCOM_ICC_TAG_ALWAYS>,
			<&hscnoc MASTER_APPSS_PROC QCOM_ICC_TAG_ALWAYS
			 &config_noc SLAVE_PCIE_2 QCOM_ICC_TAG_ALWAYS>;
	interconnect-names = "pcie-mem",
			     "cpu-pcie";

	power-domains = <&gcc GCC_PCIE_C_GDSC>;

	resets = <&gcc GCC_PCIE_C_BCR>,
		 <&gcc GCC_PCIE_C_LINK_DOWN_BCR>;
	reset-names = "pci",
		      "link_down";

	pinctrl-0 = <&pcie2_default>;
	pinctrl-names = "default";

	operating-points-v2 = <&pcie2_opp_table>;

	pcie2_opp_table: opp-table {
		compatible = "operating-points-v2";

		/* GEN 1 x1 */
		opp-2500000-1 {
			opp-hz = /bits/ 64 <2500000>;
			required-opps = <&rpmhpd_opp_low_svs>;
			opp-peak-kBps = <250000 1>;
			opp-level = <1>;
		};

		/* GEN 1 x2 */
		opp-5000000-1 {
			opp-hz = /bits/ 64 <5000000>;
			required-opps = <&rpmhpd_opp_low_svs>;
			opp-peak-kBps = <500000 1>;
			opp-level = <1>;
		};

		/* GEN 1 x4 */
		opp-10000000-1 {
			opp-hz = /bits/ 64 <10000000>;
			required-opps = <&rpmhpd_opp_low_svs>;
			opp-peak-kBps = <1000000 1>;
			opp-level = <1>;
		};

		/* GEN 2 x1 */
		opp-5000000-2 {
			opp-hz = /bits/ 64 <5000000>;
			required-opps = <&rpmhpd_opp_low_svs>;
			opp-peak-kBps = <500000 1>;
			opp-level = <2>;
		};

		/* GEN 2 x2 */
		opp-10000000-2 {
			opp-hz = /bits/ 64 <10000000>;
			required-opps = <&rpmhpd_opp_low_svs>;
			opp-peak-kBps = <1000000 1>;
			opp-level = <2>;
		};

		/* GEN 2 x4 */
		opp-20000000-2 {
			opp-hz = /bits/ 64 <20000000>;
			required-opps = <&rpmhpd_opp_low_svs>;
			opp-peak-kBps = <2000000 1>;
			opp-level = <2>;
		};

		/* GEN 3 x1 */
		opp-8000000-3 {
			opp-hz = /bits/ 64 <8000000>;
			required-opps = <&rpmhpd_opp_low_svs>;
			opp-peak-kBps = <984500 1>;
			opp-level = <3>;
		};

		/* GEN 3 x2 */
		opp-16000000-3 {
			opp-hz = /bits/ 64 <16000000>;
			required-opps = <&rpmhpd_opp_low_svs>;
			opp-peak-kBps = <1969000 1>;
			opp-level = <3>;
		};

		/* GEN 3 x4 */
		opp-32000000-3 {
			opp-hz = /bits/ 64 <32000000>;
			required-opps = <&rpmhpd_opp_low_svs>;
			opp-peak-kBps = <3938000 1>;
			opp-level = <3>;
		};

		/* GEN 4 x1 */
		opp-16000000-4 {
			opp-hz = /bits/ 64 <16000000>;
			required-opps = <&rpmhpd_opp_svs>;
			opp-peak-kBps = <1969000 1>;
			opp-level = <4>;
		};

		/* GEN 4 x2 */
		opp-32000000-4 {
			opp-hz = /bits/ 64 <32000000>;
			required-opps = <&rpmhpd_opp_svs>;
			opp-peak-kBps = <3938000 1>;
			opp-level = <4>;
		};

		/* GEN 4 x4 */
		opp-64000000-4 {
			opp-hz = /bits/ 64 <64000000>;
			required-opps = <&rpmhpd_opp_svs>;
			opp-peak-kBps = <7876000 1>;
			opp-level = <4>;
		};

		/* GEN 5 x1 */
		opp-32000000-5 {
			opp-hz = /bits/ 64 <32000000>;
			required-opps = <&rpmhpd_opp_nom>;
			opp-peak-kBps = <3938000 1>;
			opp-level = <5>;
		};

		/* GEN 5 x2 */
		opp-64000000-5 {
			opp-hz = /bits/ 64 <64000000>;
			required-opps = <&rpmhpd_opp_nom>;
			opp-peak-kBps = <7876000 1>;
			opp-level = <5>;
		};

		/* GEN 5 x4 */
		opp-128000000-5 {
			opp-hz = /bits/ 64 <128000000>;
			required-opps = <&rpmhpd_opp_nom>;
			opp-peak-kBps = <15753000 1>;
			opp-level = <5>;
		};
	};
};

&pcie2_port0 {
	phys = <&pcie_phy 2>;
};

&pcie3 {
	clocks = <&gcc GCC_PCIE_D_AUX_CLK>,
		 <&gcc GCC_PCIE_D_CFG_AHB_CLK>,
		 <&gcc GCC_PCIE_D_MSTR_AXI_CLK>,
		 <&gcc GCC_PCIE_D_SLV_AXI_CLK>,
		 <&gcc GCC_PCIE_D_SLV_Q2A_AXI_CLK>;
	clock-names = "aux",
		      "cfg",
		      "bus_master",
		      "bus_slave",
		      "slave_q2a";

	assigned-clocks = <&gcc GCC_PCIE_D_AUX_CLK>;
	assigned-clock-rates = <19200000>;

	interconnects = <&pcie_data_inbound MASTER_PCIE_3 QCOM_ICC_TAG_ALWAYS
			 &mc_virt SLAVE_EBI1 QCOM_ICC_TAG_ALWAYS>,
			<&hscnoc MASTER_APPSS_PROC QCOM_ICC_TAG_ALWAYS
			 &config_noc SLAVE_PCIE_3 QCOM_ICC_TAG_ALWAYS>;
	interconnect-names = "pcie-mem",
			     "cpu-pcie";

	power-domains = <&gcc GCC_PCIE_D_GDSC>;

	resets = <&gcc GCC_PCIE_D_BCR>,
		 <&gcc GCC_PCIE_D_LINK_DOWN_BCR>;
	reset-names = "pci",
		      "link_down";

	pinctrl-0 = <&pcie3_default>;
	pinctrl-names = "default";

	operating-points-v2 = <&pcie3_opp_table>;

	pcie3_opp_table: opp-table {
		compatible = "operating-points-v2";

		/* GEN 1 x1 */
		opp-2500000-1 {
			opp-hz = /bits/ 64 <2500000>;
			required-opps = <&rpmhpd_opp_low_svs>;
			opp-peak-kBps = <250000 1>;
			opp-level = <1>;
		};

		/* GEN 1 x2 */
		opp-5000000-1 {
			opp-hz = /bits/ 64 <5000000>;
			required-opps = <&rpmhpd_opp_low_svs>;
			opp-peak-kBps = <500000 1>;
			opp-level = <1>;
		};

		/* GEN 2 x1 */
		opp-5000000-2 {
			opp-hz = /bits/ 64 <5000000>;
			required-opps = <&rpmhpd_opp_low_svs>;
			opp-peak-kBps = <500000 1>;
			opp-level = <2>;
		};

		/* GEN 2 x2 */
		opp-10000000-2 {
			opp-hz = /bits/ 64 <10000000>;
			required-opps = <&rpmhpd_opp_low_svs>;
			opp-peak-kBps = <1000000 1>;
			opp-level = <2>;
		};

		/* GEN 3 x1 */
		opp-8000000-3 {
			opp-hz = /bits/ 64 <8000000>;
			required-opps = <&rpmhpd_opp_low_svs>;
			opp-peak-kBps = <984500 1>;
			opp-level = <3>;
		};

		/* GEN 3 x2 */
		opp-16000000-3 {
			opp-hz = /bits/ 64 <16000000>;
			required-opps = <&rpmhpd_opp_low_svs>;
			opp-peak-kBps = <1969000 1>;
			opp-level = <3>;
		};

		/* GEN 4 x1 */
		opp-16000000-4 {
			opp-hz = /bits/ 64 <16000000>;
			required-opps = <&rpmhpd_opp_svs>;
			opp-peak-kBps = <1969000 1>;
			opp-level = <4>;
		};

		/* GEN 4 x2 */
		opp-32000000-4 {
			opp-hz = /bits/ 64 <32000000>;
			required-opps = <&rpmhpd_opp_svs>;
			opp-peak-kBps = <3938000 1>;
			opp-level = <4>;
		};

		/* GEN 5 x1 */
		opp-32000000-5 {
			opp-hz = /bits/ 64 <32000000>;
			required-opps = <&rpmhpd_opp_nom>;
			opp-peak-kBps = <3938000 1>;
			opp-level = <5>;
		};

		/* GEN 5 x2 */
		opp-64000000-5 {
			opp-hz = /bits/ 64 <64000000>;
			required-opps = <&rpmhpd_opp_nom>;
			opp-peak-kBps = <7876000 1>;
			opp-level = <5>;
		};
	};
};

&pcie3_port0 {
	phys = <&pcie_phy 3>;
};

&qupv3_0 {
	clocks = <&segcc SE_GCC_QUPV3_WRAP0_M_AHB_CLK>,
		 <&segcc SE_GCC_QUPV3_WRAP0_S_AHB_CLK>;
	clock-names = "m-ahb",
		      "s-ahb";
};

&qupv3_1 {
	clocks = <&segcc SE_GCC_QUPV3_WRAP1_M_AHB_CLK>,
		 <&segcc SE_GCC_QUPV3_WRAP1_S_AHB_CLK>;
	clock-names = "m-ahb",
		      "s-ahb";
};

&qupv3_2 {
	clocks = <&negcc NE_GCC_QUPV3_WRAP2_M_AHB_CLK>,
		 <&negcc NE_GCC_QUPV3_WRAP2_S_AHB_CLK>;
	clock-names = "m-ahb",
		      "s-ahb";
};

&remoteproc_adsp {
	clocks = <&rpmhcc RPMH_CXO_CLK>;
	clock-names = "xo";
	interconnects = <&hpass_ag_noc MASTER_HPASS_PROC_0 QCOM_ICC_TAG_ALWAYS
			 &mc_virt SLAVE_EBI1 QCOM_ICC_TAG_ALWAYS>;
	power-domains = <&rpmhpd RPMHPD_CX>,
			<&rpmhpd RPMHPD_MX>;
	power-domain-names = "cx",
			     "mx";
};

&remoteproc_cdsp0 {
	clocks = <&rpmhcc RPMH_CXO_CLK>;
	clock-names = "xo";
	interconnects = <&nsp_data_noc_0 MASTER_NSP0_PROC QCOM_ICC_TAG_ALWAYS
			 &mc_virt SLAVE_EBI1 QCOM_ICC_TAG_ALWAYS>;
	power-domains = <&rpmhpd RPMHPD_CX>,
			<&rpmhpd RPMHPD_NMXC>,
			<&rpmhpd RPMHPD_NSP0>;
	power-domain-names = "cx",
			     "mx",
			     "nsp";
};

&remoteproc_cdsp1 {
	clocks = <&rpmhcc RPMH_CXO_CLK>;
	clock-names = "xo";
	interconnects = <&nsp_data_noc_1 MASTER_NSP1_PROC QCOM_ICC_TAG_ALWAYS
			 &mc_virt SLAVE_EBI1 QCOM_ICC_TAG_ALWAYS>;
	power-domains = <&rpmhpd RPMHPD_CX>,
			<&rpmhpd RPMHPD_NMXC>,
			<&rpmhpd RPMHPD_NSP1>;
	power-domain-names = "cx",
			     "mx",
			     "nsp";
};

&remoteproc_cdsp2 {
	clocks = <&rpmhcc RPMH_CXO_CLK>;
	clock-names = "xo";
	interconnects = <&nsp_data_noc_2 MASTER_NSP2_PROC QCOM_ICC_TAG_ALWAYS
			 &mc_virt SLAVE_EBI1 QCOM_ICC_TAG_ALWAYS>;
	power-domains = <&rpmhpd RPMHPD_CX>,
			<&rpmhpd RPMHPD_NMXC>,
			<&rpmhpd RPMHPD_NSP2>;
	power-domain-names = "cx",
			     "mx",
			     "nsp";
};

&remoteproc_cdsp3 {
	clocks = <&rpmhcc RPMH_CXO_CLK>;
	clock-names = "xo";
	interconnects = <&nsp_data_noc_3 MASTER_NSP3_PROC QCOM_ICC_TAG_ALWAYS
			 &mc_virt SLAVE_EBI1 QCOM_ICC_TAG_ALWAYS>;
	power-domains = <&rpmhpd RPMHPD_CX>,
			<&rpmhpd RPMHPD_NMXC>,
			<&rpmhpd RPMHPD_NSP3>;
	power-domain-names = "cx",
			     "mx",
			     "nsp";
};

&spi0 {
	clocks = <&segcc SE_GCC_QUPV3_WRAP0_S0_CLK>;
	clock-names = "se";
	interconnects = <&clk_virt MASTER_QUP_CORE_0 QCOM_ICC_TAG_ALWAYS
			 &clk_virt SLAVE_QUP_CORE_0 QCOM_ICC_TAG_ALWAYS>,
			<&hscnoc MASTER_APPSS_PROC QCOM_ICC_TAG_ALWAYS
			 &config_noc SLAVE_QUP_0 QCOM_ICC_TAG_ALWAYS>,
			<&aggre2_noc_tile MASTER_QUP_0 QCOM_ICC_TAG_ALWAYS
			 &mc_virt SLAVE_EBI1 QCOM_ICC_TAG_ALWAYS>;
	interconnect-names = "qup-core",
			     "qup-config",
			     "qup-memory";
	pinctrl-0 = <&qup_spi0_default>;
	pinctrl-names = "default";
};

&spi1 {
	clocks = <&segcc SE_GCC_QUPV3_WRAP0_S1_CLK>;
	clock-names = "se";
	interconnects = <&clk_virt MASTER_QUP_CORE_0 QCOM_ICC_TAG_ALWAYS
			 &clk_virt SLAVE_QUP_CORE_0 QCOM_ICC_TAG_ALWAYS>,
			<&hscnoc MASTER_APPSS_PROC QCOM_ICC_TAG_ALWAYS
			 &config_noc SLAVE_QUP_0 QCOM_ICC_TAG_ALWAYS>,
			<&aggre2_noc_tile MASTER_QUP_0 QCOM_ICC_TAG_ALWAYS
			 &mc_virt SLAVE_EBI1 QCOM_ICC_TAG_ALWAYS>;
	interconnect-names = "qup-core",
			     "qup-config",
			     "qup-memory";
	pinctrl-0 = <&qup_spi1_default>;
	pinctrl-names = "default";
};

&spi2 {
	clocks = <&segcc SE_GCC_QUPV3_WRAP0_S2_CLK>;
	clock-names = "se";
	interconnects = <&clk_virt MASTER_QUP_CORE_0 QCOM_ICC_TAG_ALWAYS
			 &clk_virt SLAVE_QUP_CORE_0 QCOM_ICC_TAG_ALWAYS>,
			<&hscnoc MASTER_APPSS_PROC QCOM_ICC_TAG_ALWAYS
			 &config_noc SLAVE_QUP_0 QCOM_ICC_TAG_ALWAYS>,
			<&aggre2_noc_tile MASTER_QUP_0 QCOM_ICC_TAG_ALWAYS
			 &mc_virt SLAVE_EBI1 QCOM_ICC_TAG_ALWAYS>;
	interconnect-names = "qup-core",
			     "qup-config",
			     "qup-memory";
	pinctrl-0 = <&qup_spi2_default>;
	pinctrl-names = "default";
};

&spi3 {
	clocks = <&segcc SE_GCC_QUPV3_WRAP0_S3_CLK>;
	clock-names = "se";
	interconnects = <&clk_virt MASTER_QUP_CORE_0 QCOM_ICC_TAG_ALWAYS
			 &clk_virt SLAVE_QUP_CORE_0 QCOM_ICC_TAG_ALWAYS>,
			<&hscnoc MASTER_APPSS_PROC QCOM_ICC_TAG_ALWAYS
			 &config_noc SLAVE_QUP_0 QCOM_ICC_TAG_ALWAYS>,
			<&aggre2_noc_tile MASTER_QUP_0 QCOM_ICC_TAG_ALWAYS
			 &mc_virt SLAVE_EBI1 QCOM_ICC_TAG_ALWAYS>;
	interconnect-names = "qup-core",
			     "qup-config",
			     "qup-memory";
	pinctrl-0 = <&qup_spi3_default>;
	pinctrl-names = "default";
};

&spi4 {
	clocks = <&segcc SE_GCC_QUPV3_WRAP0_S4_CLK>;
	clock-names = "se";
	interconnects = <&clk_virt MASTER_QUP_CORE_0 QCOM_ICC_TAG_ALWAYS
			 &clk_virt SLAVE_QUP_CORE_0 QCOM_ICC_TAG_ALWAYS>,
			<&hscnoc MASTER_APPSS_PROC QCOM_ICC_TAG_ALWAYS
			 &config_noc SLAVE_QUP_0 QCOM_ICC_TAG_ALWAYS>,
			<&aggre2_noc_tile MASTER_QUP_0 QCOM_ICC_TAG_ALWAYS
			 &mc_virt SLAVE_EBI1 QCOM_ICC_TAG_ALWAYS>;
	interconnect-names = "qup-core",
			     "qup-config",
			     "qup-memory";
	pinctrl-0 = <&qup_spi4_default>;
	pinctrl-names = "default";
};

&spi5 {
	clocks = <&segcc SE_GCC_QUPV3_WRAP0_S5_CLK>;
	clock-names = "se";
	interconnects = <&clk_virt MASTER_QUP_CORE_0 QCOM_ICC_TAG_ALWAYS
			 &clk_virt SLAVE_QUP_CORE_0 QCOM_ICC_TAG_ALWAYS>,
			<&hscnoc MASTER_APPSS_PROC QCOM_ICC_TAG_ALWAYS
			 &config_noc SLAVE_QUP_0 QCOM_ICC_TAG_ALWAYS>,
			<&aggre2_noc_tile MASTER_QUP_0 QCOM_ICC_TAG_ALWAYS
			 &mc_virt SLAVE_EBI1 QCOM_ICC_TAG_ALWAYS>;
	interconnect-names = "qup-core",
			     "qup-config",
			     "qup-memory";
	pinctrl-0 = <&qup_spi5_default>;
	pinctrl-names = "default";
};

&spi7 {
	clocks = <&segcc SE_GCC_QUPV3_WRAP1_S0_CLK>;
	clock-names = "se";
	interconnects = <&clk_virt MASTER_QUP_CORE_1 QCOM_ICC_TAG_ALWAYS
			 &clk_virt SLAVE_QUP_CORE_1 QCOM_ICC_TAG_ALWAYS>,
			<&hscnoc MASTER_APPSS_PROC QCOM_ICC_TAG_ALWAYS
			 &config_noc SLAVE_QUP_1 QCOM_ICC_TAG_ALWAYS>,
			<&aggre2_noc_tile MASTER_QUP_1 QCOM_ICC_TAG_ALWAYS
			 &mc_virt SLAVE_EBI1 QCOM_ICC_TAG_ALWAYS>;
	interconnect-names = "qup-core",
			     "qup-config",
			     "qup-memory";
	pinctrl-0 = <&qup_spi7_default>;
	pinctrl-names = "default";
};

&spi8 {
	clocks = <&segcc SE_GCC_QUPV3_WRAP1_S1_CLK>;
	clock-names = "se";
	interconnects = <&clk_virt MASTER_QUP_CORE_1 QCOM_ICC_TAG_ALWAYS
			 &clk_virt SLAVE_QUP_CORE_1 QCOM_ICC_TAG_ALWAYS>,
			<&hscnoc MASTER_APPSS_PROC QCOM_ICC_TAG_ALWAYS
			 &config_noc SLAVE_QUP_1 QCOM_ICC_TAG_ALWAYS>,
			<&aggre2_noc_tile MASTER_QUP_1 QCOM_ICC_TAG_ALWAYS
			 &mc_virt SLAVE_EBI1 QCOM_ICC_TAG_ALWAYS>;
	interconnect-names = "qup-core",
			     "qup-config",
			     "qup-memory";
	pinctrl-0 = <&qup_spi8_default>;
	pinctrl-names = "default";
};

&spi11 {
	clocks = <&segcc SE_GCC_QUPV3_WRAP1_S4_CLK>;
	clock-names = "se";
	interconnects = <&clk_virt MASTER_QUP_CORE_1 QCOM_ICC_TAG_ALWAYS
			 &clk_virt SLAVE_QUP_CORE_1 QCOM_ICC_TAG_ALWAYS>,
			<&hscnoc MASTER_APPSS_PROC QCOM_ICC_TAG_ALWAYS
			 &config_noc SLAVE_QUP_1 QCOM_ICC_TAG_ALWAYS>,
			<&aggre2_noc_tile MASTER_QUP_1 QCOM_ICC_TAG_ALWAYS
			 &mc_virt SLAVE_EBI1 QCOM_ICC_TAG_ALWAYS>;
	interconnect-names = "qup-core",
			     "qup-config",
			     "qup-memory";
	pinctrl-0 = <&qup_spi11_default>;
	pinctrl-names = "default";
};

&spi12 {
	clocks = <&segcc SE_GCC_QUPV3_WRAP1_S5_CLK>;
	clock-names = "se";
	interconnects = <&clk_virt MASTER_QUP_CORE_1 QCOM_ICC_TAG_ALWAYS
			 &clk_virt SLAVE_QUP_CORE_1 QCOM_ICC_TAG_ALWAYS>,
			<&hscnoc MASTER_APPSS_PROC QCOM_ICC_TAG_ALWAYS
			 &config_noc SLAVE_QUP_1 QCOM_ICC_TAG_ALWAYS>,
			<&aggre2_noc_tile MASTER_QUP_1 QCOM_ICC_TAG_ALWAYS
			 &mc_virt SLAVE_EBI1 QCOM_ICC_TAG_ALWAYS>;
	interconnect-names = "qup-core",
			     "qup-config",
			     "qup-memory";
	pinctrl-0 = <&qup_spi12_default>;
	pinctrl-names = "default";
};

&spi13 {
	clocks = <&segcc SE_GCC_QUPV3_WRAP1_S6_CLK>;
	clock-names = "se";
	interconnects = <&clk_virt MASTER_QUP_CORE_1 QCOM_ICC_TAG_ALWAYS
			 &clk_virt SLAVE_QUP_CORE_1 QCOM_ICC_TAG_ALWAYS>,
			<&hscnoc MASTER_APPSS_PROC QCOM_ICC_TAG_ALWAYS
			 &config_noc SLAVE_QUP_1 QCOM_ICC_TAG_ALWAYS>,
			<&aggre2_noc_tile MASTER_QUP_1 QCOM_ICC_TAG_ALWAYS
			 &mc_virt SLAVE_EBI1 QCOM_ICC_TAG_ALWAYS>;
	interconnect-names = "qup-core",
			     "qup-config",
			     "qup-memory";
	pinctrl-0 = <&qup_spi13_default>;
	pinctrl-names = "default";
};

&spi14 {
	clocks = <&negcc NE_GCC_QUPV3_WRAP2_S0_CLK>;
	clock-names = "se";
	interconnects = <&clk_virt MASTER_QUP_CORE_2 QCOM_ICC_TAG_ALWAYS
			 &clk_virt SLAVE_QUP_CORE_2 QCOM_ICC_TAG_ALWAYS>,
			<&hscnoc MASTER_APPSS_PROC QCOM_ICC_TAG_ALWAYS
			 &config_noc SLAVE_QUP_2 QCOM_ICC_TAG_ALWAYS>,
			<&aggre1_noc_tile MASTER_QUP_2 QCOM_ICC_TAG_ALWAYS
			 &mc_virt SLAVE_EBI1 QCOM_ICC_TAG_ALWAYS>;
	interconnect-names = "qup-core",
			     "qup-config",
			     "qup-memory";
	pinctrl-0 = <&qup_spi14_default>;
	pinctrl-names = "default";
};

&spi16 {
	clocks = <&negcc NE_GCC_QUPV3_WRAP2_S2_CLK>;
	clock-names = "se";
	interconnects = <&clk_virt MASTER_QUP_CORE_2 QCOM_ICC_TAG_ALWAYS
			 &clk_virt SLAVE_QUP_CORE_2 QCOM_ICC_TAG_ALWAYS>,
			<&hscnoc MASTER_APPSS_PROC QCOM_ICC_TAG_ALWAYS
			 &config_noc SLAVE_QUP_2 QCOM_ICC_TAG_ALWAYS>,
			<&aggre1_noc_tile MASTER_QUP_2 QCOM_ICC_TAG_ALWAYS
			 &mc_virt SLAVE_EBI1 QCOM_ICC_TAG_ALWAYS>;
	interconnect-names = "qup-core",
			     "qup-config",
			     "qup-memory";
	pinctrl-0 = <&qup_spi16_default>;
	pinctrl-names = "default";
};

&spi17 {
	clocks = <&negcc NE_GCC_QUPV3_WRAP2_S3_CLK>;
	clock-names = "se";
	interconnects = <&clk_virt MASTER_QUP_CORE_2 QCOM_ICC_TAG_ALWAYS
			 &clk_virt SLAVE_QUP_CORE_2 QCOM_ICC_TAG_ALWAYS>,
			<&hscnoc MASTER_APPSS_PROC QCOM_ICC_TAG_ALWAYS
			 &config_noc SLAVE_QUP_2 QCOM_ICC_TAG_ALWAYS>,
			<&aggre1_noc_tile MASTER_QUP_2 QCOM_ICC_TAG_ALWAYS
			 &mc_virt SLAVE_EBI1 QCOM_ICC_TAG_ALWAYS>;
	interconnect-names = "qup-core",
			     "qup-config",
			     "qup-memory";
	pinctrl-0 = <&qup_spi17_default>;
	pinctrl-names = "default";
};

&spi18 {
	clocks = <&negcc NE_GCC_QUPV3_WRAP2_S4_CLK>;
	clock-names = "se";
	interconnects = <&clk_virt MASTER_QUP_CORE_2 QCOM_ICC_TAG_ALWAYS
			 &clk_virt SLAVE_QUP_CORE_2 QCOM_ICC_TAG_ALWAYS>,
			<&hscnoc MASTER_APPSS_PROC QCOM_ICC_TAG_ALWAYS
			 &config_noc SLAVE_QUP_2 QCOM_ICC_TAG_ALWAYS>,
			<&aggre1_noc_tile MASTER_QUP_2 QCOM_ICC_TAG_ALWAYS
			 &mc_virt SLAVE_EBI1 QCOM_ICC_TAG_ALWAYS>;
	interconnect-names = "qup-core",
			     "qup-config",
			     "qup-memory";
	pinctrl-0 = <&qup_spi18_default>;
	pinctrl-names = "default";
};

&spi19 {
	clocks = <&negcc NE_GCC_QUPV3_WRAP2_S5_CLK>;
	clock-names = "se";
	interconnects = <&clk_virt MASTER_QUP_CORE_2 QCOM_ICC_TAG_ALWAYS
			 &clk_virt SLAVE_QUP_CORE_2 QCOM_ICC_TAG_ALWAYS>,
			<&hscnoc MASTER_APPSS_PROC QCOM_ICC_TAG_ALWAYS
			 &config_noc SLAVE_QUP_2 QCOM_ICC_TAG_ALWAYS>,
			<&aggre1_noc_tile MASTER_QUP_2 QCOM_ICC_TAG_ALWAYS
			 &mc_virt SLAVE_EBI1 QCOM_ICC_TAG_ALWAYS>;
	interconnect-names = "qup-core",
			     "qup-config",
			     "qup-memory";
	pinctrl-0 = <&qup_spi19_default>;
	pinctrl-names = "default";
};

&spi20 {
	clocks = <&negcc NE_GCC_QUPV3_WRAP2_S6_CLK>;
	clock-names = "se";
	interconnects = <&clk_virt MASTER_QUP_CORE_2 QCOM_ICC_TAG_ALWAYS
			 &clk_virt SLAVE_QUP_CORE_2 QCOM_ICC_TAG_ALWAYS>,
			<&hscnoc MASTER_APPSS_PROC QCOM_ICC_TAG_ALWAYS
			 &config_noc SLAVE_QUP_2 QCOM_ICC_TAG_ALWAYS>,
			<&aggre1_noc_tile MASTER_QUP_2 QCOM_ICC_TAG_ALWAYS
			 &mc_virt SLAVE_EBI1 QCOM_ICC_TAG_ALWAYS>;
	interconnect-names = "qup-core",
			     "qup-config",
			     "qup-memory";
	pinctrl-0 = <&qup_spi20_default>;
	pinctrl-names = "default";
};

&soc {
	gcc: clock-controller@100000 {
		compatible = "qcom,nord-gcc";
		reg = <0x0 0x00100000 0x0 0x1f4200>;
		clocks = <&bi_tcxo_div2>,
			 <&sleep_clk>,
			 <&pcie_phy 0>,
			 <&pcie_phy 1>,
			 <&pcie_phy 2>,
			 <&pcie_phy 3>;
		#clock-cells = <1>;
		#reset-cells = <1>;
		#power-domain-cells = <1>;
	};

	bwmon_cluster2: pmu@1014400 {
		compatible = "qcom,nord-cpu-bwmon", "qcom,sdm845-bwmon";
		reg = <0x0 0x01014400 0x0 0x600>;
		interrupts = <GIC_SPI 739 IRQ_TYPE_LEVEL_HIGH>;
		interconnects = <&hscnoc MASTER_APPSS_PROC QCOM_ICC_TAG_ACTIVE_ONLY
				 &mc_virt SLAVE_EBI1 QCOM_ICC_TAG_ACTIVE_ONLY>;

		operating-points-v2 = <&bwmon_cluster_opp_table>;
	};

	bwmon_cluster1: pmu@1015400 {
		compatible = "qcom,nord-cpu-bwmon", "qcom,sdm845-bwmon";
		reg = <0x0 0x01015400 0x0 0x600>;
		interrupts = <GIC_SPI 812 IRQ_TYPE_LEVEL_HIGH>;
		interconnects = <&hscnoc MASTER_APPSS_PROC QCOM_ICC_TAG_ACTIVE_ONLY
				 &mc_virt SLAVE_EBI1 QCOM_ICC_TAG_ACTIVE_ONLY>;

		operating-points-v2 = <&bwmon_cluster_opp_table>;
	};

	bwmon_cluster0: pmu@1016400 {
		compatible = "qcom,nord-cpu-bwmon", "qcom,sdm845-bwmon";
		reg = <0x0 0x01016400 0x0 0x600>;
		interrupts = <GIC_SPI 813 IRQ_TYPE_LEVEL_HIGH>;
		interconnects = <&hscnoc MASTER_APPSS_PROC QCOM_ICC_TAG_ACTIVE_ONLY
				 &mc_virt SLAVE_EBI1 QCOM_ICC_TAG_ACTIVE_ONLY>;

		operating-points-v2 = <&bwmon_cluster_opp_table>;

		bwmon_cluster_opp_table: opp-table {
			compatible = "operating-points-v2";

			opp-0 {
				opp-peak-kBps = <800000>;
			};

			opp-1 {
				opp-peak-kBps = <2188800>;
			};

			opp-2 {
				opp-peak-kBps = <5414400>;
			};

			opp-3 {
				opp-peak-kBps = <6220800>;
			};

			opp-4 {
				opp-peak-kBps = <6835200>;
			};

			opp-5 {
				opp-peak-kBps = <7603200>;
			};

			opp-6 {
				opp-peak-kBps = <8371200>;
			};

			opp-7 {
				opp-peak-kBps = <9657600>;
			};

			opp-8 {
				opp-peak-kBps = <10944000>;
			};

			opp-9 {
				opp-peak-kBps = <12748800>;
			};

			opp-10 {
				opp-peak-kBps = <14745600>;
			};
		};
	};

	cnoc_main: interconnect@1500000 {
		compatible = "qcom,nord-cnoc-main";
		reg = <0x0 0x01500000 0x0 0x1d200>;
		#interconnect-cells = <2>;
		qcom,bcm-voters = <&apps_bcm_voter>;
	};

	config_noc: interconnect@1600000 {
		compatible = "qcom,nord-cnoc-cfg";
		reg = <0x0 0x01600000 0x0 0xd200>;
		#interconnect-cells = <2>;
		qcom,bcm-voters = <&apps_bcm_voter>;
	};

	system_noc: interconnect@1680000 {
		compatible = "qcom,nord-system-noc";
		reg = <0x0 0x01680000 0x0 0x1c080>;
		#interconnect-cells = <2>;
		qcom,bcm-voters = <&apps_bcm_voter>;
	};

	aggre2_noc_tile: interconnect@16c0000 {
		compatible = "qcom,nord-aggre2-noc-tile";
		reg = <0x0 0x016c0000 0x0 0x1b400>;
		#interconnect-cells = <2>;
		qcom,bcm-voters = <&apps_bcm_voter>;
	};

	aggre1_noc: interconnect@16e0000 {
		compatible = "qcom,nord-aggre1-noc";
		reg = <0x0 0x016e0000 0x0 0x1c400>;
		#interconnect-cells = <2>;
		qcom,bcm-voters = <&apps_bcm_voter>;
	};

	aggre2_noc: interconnect@1700000 {
		compatible = "qcom,nord-aggre2-noc";
		reg = <0x0 0x01700000 0x0 0x1b400>;
		#interconnect-cells = <2>;
		qcom,bcm-voters = <&apps_bcm_voter>;
		clocks = <&rpmhcc RPMH_IPA_CLK>;
	};

	aggre1_noc_tile: interconnect@1720000 {
		compatible = "qcom,nord-aggre1-noc-tile";
		reg = <0x0 0x01720000 0x0 0x23400>;
		#interconnect-cells = <2>;
		qcom,bcm-voters = <&apps_bcm_voter>;
		clocks = <&negcc NE_GCC_AGGRE_NOC_USB2_AXI_CLK>,
			 <&negcc NE_GCC_AGGRE_NOC_USB3_PRIM_AXI_CLK>,
			 <&negcc NE_GCC_AGGRE_NOC_USB3_SEC_AXI_CLK>,
			 <&negcc NE_GCC_AGGRE_NOC_UFS_PHY_AXI_CLK>;
	};

	mmss_noc: interconnect@1780000 {
		compatible = "qcom,nord-mmss-noc";
		reg = <0x0 0x01780000 0x0 0x72800>;
		#interconnect-cells = <2>;
		qcom,bcm-voters = <&apps_bcm_voter>;
	};

	pcie_cfg: interconnect@1ba0000 {
		compatible = "qcom,nord-pcie-cfg";
		reg = <0x0 0x01ba0000 0x0 0x7200>;
		#interconnect-cells = <2>;
		qcom,bcm-voters = <&apps_bcm_voter>;
	};

	pcie_data_outbound: interconnect@1bc0000 {
		compatible = "qcom,nord-pcie-data-outbound";
		reg = <0x0 0x01bc0000 0x0 0x17000>;
		#interconnect-cells = <2>;
		qcom,bcm-voters = <&apps_bcm_voter>;
	};

	pcie_data_inbound: interconnect@1c00000 {
		compatible = "qcom,nord-pcie-data-inbound";
		reg = <0x0 0x01c00000 0x0 0x4b080>;
		#interconnect-cells = <2>;
		qcom,bcm-voters = <&apps_bcm_voter>;
	};

	ufs_mem_phy: phy@1d40000 {
		compatible = "qcom,nord-qmp-ufs-phy",
			     "qcom,sm8650-qmp-ufs-phy";
		reg = <0x0 0x01d40000 0x0 0x2000>;

		clocks = <&rpmhcc RPMH_CXO_CLK>,
			 <&negcc NE_GCC_UFS_PHY_PHY_AUX_CLK>,
			 <&tcsrcc TCSR_UFS_CLKREF_EN>;
		clock-names = "ref",
			      "ref_aux",
			      "qref";

		resets = <&ufs_mem_hc 0>;
		reset-names = "ufsphy";

		power-domains = <&negcc NE_GCC_UFS_MEM_PHY_GDSC>;
		#clock-cells = <1>;
		#phy-cells = <0>;

		status = "disabled";
	};

	ice: crypto@1d48000 {
		compatible = "qcom,nord-inline-crypto-engine",
			     "qcom,inline-crypto-engine";
		reg = <0x0 0x01d48000 0x0 0x18000>;
		clocks = <&negcc NE_GCC_UFS_PHY_ICE_CORE_CLK>,
			 <&negcc NE_GCC_UFS_PHY_AHB_CLK>;
		clock-names = "core",
			      "iface";
		power-domains = <&negcc NE_GCC_UFS_PHY_GDSC>;
	};

	hscnoc: interconnect@2000000 {
		compatible = "qcom,nord-hscnoc";
		reg = <0x0 0x02000000 0x0 0xb22000>;
		#interconnect-cells = <2>;
		qcom,bcm-voters = <&apps_bcm_voter>;
	};

	gpucc: clock-controller@3d90000 {
		compatible = "qcom,nord-gpucc";
		reg = <0x0 0x03d90000 0x0 0x9800>;
		clocks = <&rpmhcc RPMH_CXO_CLK>,
			 <&nwgcc NW_GCC_GPU_GPLL0_CLK_SRC>,
			 <&nwgcc NW_GCC_GPU_GPLL0_DIV_CLK_SRC>;
		#clock-cells = <1>;
		#reset-cells = <1>;
		#power-domain-cells = <1>;
	};

	hpass_ag_noc: interconnect@5fc0000 {
		compatible = "qcom,nord-hpass-ag-noc";
		reg = <0x0  0x05fc0000 0x0 0x37080>;
		#interconnect-cells = <2>;
		qcom,bcm-voters = <&apps_bcm_voter>;
	};

	usb_2_hsphy: phy@88e0000 {
		compatible = "qcom,nord-snps-eusb2-phy",
			     "qcom,sm8550-snps-eusb2-phy";
		reg = <0x0 0x088e0000 0x0 0x154>;
		#phy-cells = <0>;

		clocks = <&tcsrcc TCSR_USB2_2_CLKREF_EN>;
		clock-names = "ref";

		/*
		 * The SoC has three eUSB2 PHYs but only two QUSB2PHY block
		 * resets, which belong to instances 0 and 1 (usb_0 and usb_1).
		 * This PHY, instance 2, has none of its own: it is taken out of
		 * reset together with the rest of the USB20 tile by
		 * NE_GCC_USB20_PRIM_BCR, which the controller owns and pulses
		 * before touching any register. So no 'resets' here - both
		 * consumers would need that single reset exclusively.
		 */

		status = "disabled";
	};

	usb_0_qmpphy: phy@88e1000 {
		compatible = "qcom,nord-qmp-usb3-dp-phy";
		reg = <0x0 0x088e1000 0x0 0x3000>;

		clocks = <&negcc NE_GCC_USB3_PRIM_PHY_AUX_CLK>,
			 <&tcsrcc TCSR_USB3_0_CLKREF_EN>,
			 <&negcc NE_GCC_USB3_PRIM_PHY_COM_AUX_CLK>,
			 <&negcc NE_GCC_USB3_PRIM_PHY_PIPE_CLK>;
		clock-names = "aux",
			      "ref",
			      "com_aux",
			      "usb3_pipe";

		power-domains = <&negcc NE_GCC_USB3_PHY_GDSC>;

		resets = <&negcc NE_GCC_USB3_PHY_PRIM_BCR>,
			 <&negcc NE_GCC_USB3_DP_PHY_PRIM_BCR>;
		reset-names = "phy",
			      "common";

		#clock-cells = <1>;
		#phy-cells = <1>;

		status = "disabled";

		ports {
			#address-cells = <1>;
			#size-cells = <0>;

			port@0 {
				reg = <0>;

				#address-cells = <1>;
				#size-cells = <0>;

				usb_0_qmpphy_usb_ss_out: endpoint@1 {
					reg = <1>;
					data-lanes = <1 0>;
				};
			};

			port@1 {
				reg = <1>;

				usb_0_qmpphy_usb_ss_in: endpoint {
					remote-endpoint = <&usb_0_dwc3_ss>;
				};
			};
		};
	};

	usb_1_qmpphy: phy@88e4000 {
		compatible = "qcom,nord-qmp-usb3-dp-phy";
		reg = <0x0 0x088e4000 0x0 0x3000>;

		clocks = <&negcc NE_GCC_USB3_SEC_PHY_AUX_CLK>,
			 <&tcsrcc TCSR_USB3_1_CLKREF_EN>,
			 <&negcc NE_GCC_USB3_SEC_PHY_COM_AUX_CLK>,
			 <&negcc NE_GCC_USB3_SEC_PHY_PIPE_CLK>;
		clock-names = "aux",
			      "ref",
			      "com_aux",
			      "usb3_pipe";

		power-domains = <&negcc NE_GCC_USB3_SEC_PHY_GDSC>;

		resets = <&negcc NE_GCC_USB3_PHY_SEC_BCR>,
			 <&negcc NE_GCC_USB3_DP_PHY_SEC_BCR>;
		reset-names = "phy",
			      "common";

		#clock-cells = <1>;
		#phy-cells = <1>;

		status = "disabled";

		ports {
			#address-cells = <1>;
			#size-cells = <0>;

			port@0 {
				reg = <0>;

				#address-cells = <1>;
				#size-cells = <0>;

				/* Same as usb_0_qmpphy above. */
				usb_1_qmpphy_usb_ss_out: endpoint@1 {
					reg = <1>;
					data-lanes = <1 0>;
				};
			};

			port@1 {
				reg = <1>;

				usb_1_qmpphy_usb_ss_in: endpoint {
					remote-endpoint = <&usb_1_dwc3_ss>;
				};
			};
		};
	};

	usb_0_hsphy: phy@88ea000 {
		compatible = "qcom,nord-snps-eusb2-phy",
			     "qcom,sm8550-snps-eusb2-phy";
		reg = <0x0 0x088ea000 0x0 0x154>;
		#phy-cells = <0>;

		clocks = <&tcsrcc TCSR_USB2_0_CLKREF_EN>;
		clock-names = "ref";

		resets = <&negcc NE_GCC_QUSB2PHY_PRIM_BCR>;

		status = "disabled";
	};

	usb_1_hsphy: phy@88eb000 {
		compatible = "qcom,nord-snps-eusb2-phy",
			     "qcom,sm8550-snps-eusb2-phy";
		reg = <0x0 0x088eb000 0x0 0x154>;
		#phy-cells = <0>;

		clocks = <&tcsrcc TCSR_USB2_1_CLKREF_EN>;
		clock-names = "ref";

		resets = <&negcc NE_GCC_QUSB2PHY_SEC_BCR>;

		status = "disabled";
	};

	negcc: clock-controller@8900000 {
		compatible = "qcom,nord-negcc";
		reg = <0x0 0x08900000 0x0 0xf4200>;
		clocks = <&bi_tcxo_div2>,
			 <&sleep_clk>,
			 <0>,
			 <0>,
			 <0>,
			 <&usb_1_qmpphy QMP_USB43DP_USB3_PIPE_CLK>,
			 <&usb_0_qmpphy QMP_USB43DP_USB3_PIPE_CLK>;
		#clock-cells = <1>;
		#reset-cells = <1>;
		#power-domain-cells = <1>;
	};

	segcc: clock-controller@8a00000 {
		compatible = "qcom,nord-segcc";
		reg = <0x0 0x08a00000 0x0 0xf4200>;
		clocks = <&bi_tcxo_div2>,
			 <&sleep_clk>;
		#clock-cells = <1>;
		#reset-cells = <1>;
		#power-domain-cells = <1>;
	};

	nwgcc: clock-controller@8b00000 {
		compatible = "qcom,nord-nwgcc";
		reg = <0x0 0x08b00000 0x0 0xf4200>;
		clocks = <&bi_tcxo_div2>,
			 <&sleep_clk>;
		#clock-cells = <1>;
		#reset-cells = <1>;
		#power-domain-cells = <1>;
	};

	dispcc1: clock-controller@8d00000 {
		compatible = "qcom,nord-dispcc1";
		reg = <0x0 0x08d00000 0x0 0x20000>;
		clocks = <&bi_tcxo_div2>,
			 <&bi_tcxo_ao_div2>,
			 <&nwgcc NW_GCC_DISP_1_AHB_CLK>,
			 <&sleep_clk>,
			 <0>,
			 <0>,
			 <0>,
			 <0>,
			 <0>,
			 <0>,
			 <0>,
			 <0>,
			 <0>,
			 <0>,
			 <0>,
			 <0>;
		power-domains = <&rpmhpd RPMHPD_MMCX>;
		required-opps = <&rpmhpd_opp_min_svs>;
		#clock-cells = <1>;
		#reset-cells = <1>;
		#power-domain-cells = <1>;
	};

	gpu2cc: clock-controller@9890000 {
		compatible = "qcom,nord-gpu2cc";
		reg = <0x0 0x09890000 0x0 0xa000>;
		clocks = <&bi_tcxo_div2>,
			 <&negcc NE_GCC_GPU_2_GPLL0_CLK_SRC>,
			 <&negcc NE_GCC_GPU_2_GPLL0_DIV_CLK_SRC>;
		#clock-cells = <1>;
		#reset-cells = <1>;
		#power-domain-cells = <1>;
	};

	camcc: clock-controller@9ce0000 {
		compatible = "qcom,nord-camcc";
		reg = <0x0 0x09ce0000 0x0 0x20000>;
		power-domains = <&rpmhpd RPMHPD_MMCX>,
				<&rpmhpd RPMHPD_MXC>;
		required-opps = <&rpmhpd_opp_low_svs>,
				<&rpmhpd_opp_low_svs>;
		clocks = <&nwgcc NW_GCC_CAMERA_AHB_CLK>,
			 <&bi_tcxo_div2>,
			 <&bi_tcxo_ao_div2>,
			 <&sleep_clk>;
		#clock-cells = <1>;
		#reset-cells = <1>;
		#power-domain-cells = <1>;
	};

	videocc: clock-controller@aaf0000 {
		compatible = "qcom,nord-videocc";
		reg = <0x0 0x0aaf0000 0x0 0x10000>;
		clocks = <&bi_tcxo_div2>,
			 <&nwgcc NW_GCC_VIDEO_AHB_CLK>;
		power-domains = <&rpmhpd RPMHPD_MMCX>,
				<&rpmhpd RPMHPD_MXC>;
		required-opps = <&rpmhpd_opp_low_svs>,
				<&rpmhpd_opp_low_svs>;
		#clock-cells = <1>;
		#reset-cells = <1>;
		#power-domain-cells = <1>;
	};

	dispcc0: clock-controller@af00000 {
		compatible = "qcom,nord-dispcc0";
		reg = <0x0 0x0af00000 0x0 0x20000>;
		clocks = <&bi_tcxo_div2>,
			 <&bi_tcxo_ao_div2>,
			 <&nwgcc NW_GCC_DISP_0_AHB_CLK>,
			 <&sleep_clk>,
			 <0>,
			 <0>,
			 <0>,
			 <0>,
			 <0>,
			 <0>,
			 <0>,
			 <0>,
			 <0>,
			 <0>,
			 <0>,
			 <0>;
		power-domains = <&rpmhpd RPMHPD_MMCX>;
		required-opps = <&rpmhpd_opp_min_svs>;
		#clock-cells = <1>;
		#reset-cells = <1>;
		#power-domain-cells = <1>;
	};

	tcsrcc: clock-controller@f1d9000 {
		compatible = "qcom,nord-tcsrcc",
			     "syscon";
		reg = <0x0 0x0f1d9000 0x0 0xf00c>;
		clocks = <&rpmhcc RPMH_CXO_CLK>;
		#clock-cells = <1>;
		#reset-cells = <1>;
	};

	apps_rsc: rsc@18900000 {
		compatible = "qcom,rpmh-rsc";
		reg = <0x0 0x18900000 0x0 0x10000>,
		      <0x0 0x18910000 0x0 0x10000>,
		      <0x0 0x18920000 0x0 0x10000>;
		reg-names = "drv-0",
			    "drv-1",
			    "drv-2";
		interrupts = <GIC_SPI 27 IRQ_TYPE_LEVEL_HIGH>,
			     <GIC_SPI 28 IRQ_TYPE_LEVEL_HIGH>,
			     <GIC_SPI 29 IRQ_TYPE_LEVEL_HIGH>;
		qcom,tcs-offset = <0xd00>;
		qcom,drv-id = <2>;
		qcom,tcs-config = <ACTIVE_TCS 3>,
				  <SLEEP_TCS 2>,
				  <WAKE_TCS 2>,
				  <CONTROL_TCS 0>;
		label = "apps_rsc";
		power-domains = <&system_pd>;

		apps_bcm_voter: bcm-voter {
			compatible = "qcom,bcm-voter";
		};

		rpmhcc: clock-controller {
			compatible = "qcom,nord-rpmh-clk";
			clocks = <&xo_board>;
			clock-names = "xo";
			#clock-cells = <1>;
		};

		rpmhpd: power-controller {
			compatible = "qcom,nord-rpmhpd";
			#power-domain-cells = <1>;
			operating-points-v2 = <&rpmhpd_opp_table>;

			rpmhpd_opp_table: opp-table {
				compatible = "operating-points-v2";

				rpmhpd_opp_ret: opp-0 {
					opp-level = <RPMH_REGULATOR_LEVEL_RETENTION>;
				};

				rpmhpd_opp_min_svs: opp-1 {
					opp-level = <RPMH_REGULATOR_LEVEL_MIN_SVS>;
				};

				rpmhpd_opp_low_svs: opp-2 {
					opp-level = <RPMH_REGULATOR_LEVEL_LOW_SVS>;
				};

				rpmhpd_opp_svs: opp-3 {
					opp-level = <RPMH_REGULATOR_LEVEL_SVS>;
				};

				rpmhpd_opp_svs_l1: opp-4 {
					opp-level = <RPMH_REGULATOR_LEVEL_SVS_L1>;
				};

				rpmhpd_opp_nom: opp-5 {
					opp-level = <RPMH_REGULATOR_LEVEL_NOM>;
				};

				rpmhpd_opp_nom_l1: opp-6 {
					opp-level = <RPMH_REGULATOR_LEVEL_NOM_L1>;
				};

				rpmhpd_opp_nom_l2: opp-7 {
					opp-level = <RPMH_REGULATOR_LEVEL_NOM_L2>;
				};

				rpmhpd_opp_turbo: opp-8 {
					opp-level = <RPMH_REGULATOR_LEVEL_TURBO>;
				};

				rpmhpd_opp_turbo_l1: opp-9 {
					opp-level = <RPMH_REGULATOR_LEVEL_TURBO_L1>;
				};
			};
		};
	};

	nsp_data_noc_0: interconnect@1f200000 {
		compatible = "qcom,nord-nsp-data-noc-0";
		reg = <0x0 0x1f200000 0x0 0x2a200>;
		#interconnect-cells = <2>;
		qcom,bcm-voters = <&apps_bcm_voter>;
	};

	pcie_phy: phy@1b00000 {
		compatible = "qcom,nord-qmp-gen5x16-pcie-phy";

		reg = <0x0 0x01b00000 0x0 0x10000>,
		      <0x0 0x01b10000 0x0 0x10000>,
		      <0x0 0x01b20000 0x0 0x10000>,
		      <0x0 0x01b30000 0x0 0x10000>;
		reg-names = "port_a",
			    "port_b",
			    "port_c",
			    "port_d";

		clocks = <&gcc GCC_PCIE_A_PHY_AUX_CLK>,
			 <&gcc GCC_PCIE_A_CFG_AHB_CLK>,
			 <&gcc GCC_PCIE_A_PHY_RCHNG_CLK>,
			 <&gcc GCC_PCIE_A_PIPE_CLK>,
			 <&gcc GCC_PCIE_B_PHY_AUX_CLK>,
			 <&gcc GCC_PCIE_B_CFG_AHB_CLK>,
			 <&gcc GCC_PCIE_B_PHY_RCHNG_CLK>,
			 <&gcc GCC_PCIE_B_PIPE_CLK>,
			 <&gcc GCC_PCIE_C_PHY_AUX_CLK>,
			 <&gcc GCC_PCIE_C_CFG_AHB_CLK>,
			 <&gcc GCC_PCIE_C_PHY_RCHNG_CLK>,
			 <&gcc GCC_PCIE_C_PIPE_CLK>,
			 <&gcc GCC_PCIE_D_PHY_AUX_CLK>,
			 <&gcc GCC_PCIE_D_CFG_AHB_CLK>,
			 <&gcc GCC_PCIE_D_PHY_RCHNG_CLK>,
			 <&gcc GCC_PCIE_D_PIPE_CLK>,
			 <&tcsrcc TCSR_PCIE_CLKREF_EN>;
		clock-names = "aux_a",
			      "cfg_ahb_a",
			      "rchng_a",
			      "pipe_a",
			      "aux_b",
			      "cfg_ahb_b",
			      "rchng_b",
			      "pipe_b",
			      "aux_c",
			      "cfg_ahb_c",
			      "rchng_c",
			      "pipe_c",
			      "aux_d",
			      "cfg_ahb_d",
			      "rchng_d",
			      "pipe_d",
			      "ref";

		assigned-clocks = <&gcc GCC_PCIE_A_PHY_RCHNG_CLK>,
				  <&gcc GCC_PCIE_B_PHY_RCHNG_CLK>,
				  <&gcc GCC_PCIE_C_PHY_RCHNG_CLK>,
				  <&gcc GCC_PCIE_D_PHY_RCHNG_CLK>;
		assigned-clock-rates = <100000000>,
				       <100000000>,
				       <100000000>,
				       <100000000>;

		power-domains = <&gcc GCC_PCIE_A_PHY_GDSC>,
				<&gcc GCC_PCIE_B_PHY_GDSC>,
				<&gcc GCC_PCIE_C_PHY_GDSC>,
				<&gcc GCC_PCIE_D_PHY_GDSC>;
		power-domain-names = "port_a",
				     "port_b",
				     "port_c",
				     "port_d";

		resets = <&gcc GCC_PCIE_A_PHY_COM_BCR>,
			 <&gcc GCC_PCIE_A_NOCSR_COM_PHY_BCR>,
			 <&gcc GCC_PCIE_B_PHY_COM_BCR>,
			 <&gcc GCC_PCIE_B_NOCSR_COM_PHY_BCR>,
			 <&gcc GCC_PCIE_C_PHY_COM_BCR>,
			 <&gcc GCC_PCIE_C_NOCSR_COM_PHY_BCR>,
			 <&gcc GCC_PCIE_D_PHY_COM_BCR>,
			 <&gcc GCC_PCIE_D_NOCSR_COM_PHY_BCR>;
		reset-names = "port_a",
			      "port_a_nocsr",
			      "port_b",
			      "port_b_nocsr",
			      "port_c",
			      "port_c_nocsr",
			      "port_d",
			      "port_d_nocsr";

		qcom,link-mode = <&tcsr 0x71050>;

		#clock-cells = <1>;
		clock-output-names = "pcie_a_pipe_clk",
				     "pcie_b_pipe_clk",
				     "pcie_c_pipe_clk",
				     "pcie_d_pipe_clk";
		#phy-cells = <1>;

		status = "disabled";
	};

	nsp_data_noc_1: interconnect@1f600000 {
		compatible = "qcom,nord-nsp-data-noc-1";
		reg = <0x0 0x1f600000 0x0 0x2a200>;
		#interconnect-cells = <2>;
		qcom,bcm-voters = <&apps_bcm_voter>;
	};

	nsp_data_noc_2: interconnect@1fa00000 {
		compatible = "qcom,nord-nsp-data-noc-2";
		reg = <0x0 0x1fa00000 0x0 0x2a200>;
		#interconnect-cells = <2>;
		qcom,bcm-voters = <&apps_bcm_voter>;
	};

	nsp_data_noc_3: interconnect@1fe00000 {
		compatible = "qcom,nord-nsp-data-noc-3";
		reg = <0x0 0x1fe00000 0x0 0x2a200>;
		#interconnect-cells = <2>;
		qcom,bcm-voters = <&apps_bcm_voter>;
	};
};

&tlmm {
	aud_intfc8_mi2s_active: aud-intfc8-mi2s-active-state {
		data-pins {
			pins = "gpio75", "gpio76";
			function = "aud_intfc8_data";
			drive-strength = <8>;
			bias-disable;
		};

		sclk-pins {
			pins = "gpio73";
			function = "aud_intfc8_clk";
			drive-strength = <8>;
			bias-disable;
		};

		ws-pins {
			pins = "gpio74";
			function = "aud_intfc8_ws";
			drive-strength = <8>;
			bias-disable;
		};
	};

	aud_mclk0_mira_active: aud-mclk0-mira-active-state {
		pins = "gpio99";
		function = "aud_mclk0_mira";
		drive-strength = <8>;
		bias-disable;
	};

	aud_mclk1_mira_active: aud-mclk1-mira-active-state {
		pins = "gpio100";
		function = "aud_mclk1_mira";
		drive-strength = <8>;
		bias-disable;
	};

	pcie0_default: pcie0-default-state {
		wake-pins {
			pins = "gpio0";
			function = "gpio";
			drive-strength = <2>;
			bias-pull-up;
		};

		clkreq-pins {
			pins = "gpio1";
			function = "pcie0_clk_req_n";
			drive-strength = <2>;
			bias-pull-up;
		};

		perst-pins {
			pins = "gpio2";
			function = "gpio";
			drive-strength = <2>;
			bias-disable;
		};
	};

	pcie1_default: pcie1-default-state {
		wake-pins {
			pins = "gpio3";
			function = "gpio";
			drive-strength = <2>;
			bias-pull-up;
		};

		clkreq-pins {
			pins = "gpio4";
			function = "pcie1_clk_req_n";
			drive-strength = <2>;
			bias-pull-up;
		};

		perst-pins {
			pins = "gpio5";
			function = "gpio";
			drive-strength = <2>;
			bias-disable;
		};
	};

	pcie2_default: pcie2-default-state {
		wake-pins {
			pins = "gpio6";
			function = "gpio";
			drive-strength = <2>;
			bias-pull-up;
		};

		clkreq-pins {
			pins = "gpio7";
			function = "pcie2_clk_req_n";
			drive-strength = <2>;
			bias-pull-up;
		};

		perst-pins {
			pins = "gpio8";
			function = "gpio";
			drive-strength = <2>;
			bias-disable;
		};
	};

	pcie3_default: pcie3-default-state {
		wake-pins {
			pins = "gpio9";
			function = "gpio";
			drive-strength = <2>;
			bias-pull-up;
		};

		clkreq-pins {
			pins = "gpio10";
			function = "pcie3_clk_req_n";
			drive-strength = <2>;
			bias-pull-up;
		};

		perst-pins {
			pins = "gpio11";
			function = "gpio";
			drive-strength = <2>;
			bias-disable;
		};
	};

	qup_i2c0_default: qup-i2c0-default-state {
		pins = "gpio111", "gpio112";
		function = "qup0_se0";
		drive-strength = <2>;
		bias-pull-up;
	};

	qup_i2c1_default: qup-i2c1-default-state {
		pins = "gpio111", "gpio112";
		function = "qup0_se1";
		drive-strength = <2>;
		bias-pull-up;
	};

	qup_i2c2_default: qup-i2c2-default-state {
		pins = "gpio113", "gpio114";
		function = "qup0_se2";
		drive-strength = <2>;
		bias-pull-up;
	};

	qup_i2c3_default: qup-i2c3-default-state {
		pins = "gpio115", "gpio116";
		function = "qup0_se3";
		drive-strength = <2>;
		bias-pull-up;
	};

	qup_i2c4_default: qup-i2c4-default-state {
		pins = "gpio117", "gpio118";
		function = "qup0_se4";
		drive-strength = <2>;
		bias-pull-up;
	};

	qup_i2c5_default: qup-i2c5-default-state {
		pins = "gpio121", "gpio122";
		function = "qup0_se5";
		drive-strength = <2>;
		bias-pull-up;
	};

	qup_i2c7_default: qup-i2c7-default-state {
		pins = "gpio123", "gpio124";
		function = "qup1_se0";
		drive-strength = <2>;
		bias-pull-up;
	};

	qup_i2c8_default: qup-i2c8-default-state {
		pins = "gpio125", "gpio126";
		function = "qup1_se1";
		drive-strength = <2>;
		bias-pull-up;
	};

	qup_i2c9_default: qup-i2c9-default-state {
		pins = "gpio127", "gpio128";
		function = "qup1_se2_01";
		drive-strength = <2>;
		bias-pull-up;
	};

	qup_i2c10_default: qup-i2c10-default-state {
		pins = "gpio129", "gpio130";
		function = "qup1_se3_01";
		drive-strength = <2>;
		bias-pull-up;
	};

	qup_i2c11_default: qup-i2c11-default-state {
		pins = "gpio131", "gpio132";
		function = "qup1_se4";
		drive-strength = <2>;
		bias-pull-up;
	};

	qup_i2c12_default: qup-i2c12-default-state {
		pins = "gpio133", "gpio134";
		function = "qup1_se5";
		drive-strength = <2>;
		bias-pull-up;
	};

	qup_i2c13_default: qup-i2c13-default-state {
		pins = "gpio137", "gpio138";
		function = "qup1_se6";
		drive-strength = <2>;
		bias-pull-up;
	};

	qup_i2c14_default: qup-i2c14-default-state {
		pins = "gpio139", "gpio140";
		function = "qup2_se0";
		drive-strength = <2>;
		bias-pull-up;
	};

	qup_i2c16_default: qup-i2c16-default-state {
		pins = "gpio145", "gpio146";
		function = "qup2_se2";
		drive-strength = <2>;
		bias-pull-up;
	};

	qup_i2c17_default: qup-i2c17-default-state {
		pins = "gpio150", "gpio151";
		function = "qup2_se3";
		drive-strength = <2>;
		bias-pull-up;
	};

	qup_i2c18_default: qup-i2c18-default-state {
		pins = "gpio154", "gpio155";
		function = "qup2_se4";
		drive-strength = <2>;
		bias-pull-up;
	};

	qup_i2c19_default: qup-i2c19-default-state {
		pins = "gpio156", "gpio157";
		function = "qup2_se5";
		drive-strength = <2>;
		bias-pull-up;
	};

	qup_i2c20_default: qup-i2c20-default-state {
		pins = "gpio158", "gpio159";
		function = "qup2_se6";
		drive-strength = <2>;
		bias-pull-up;
	};

	qup_spi0_default: qup-spi0-default-state {
		data-pins {
			pins = "gpio109", "gpio111", "gpio112";
			function = "qup0_se0";
			drive-strength = <6>;
			bias-disable;
		};

		cs-pins {
			pins = "gpio110";
			function = "qup0_se0";
			drive-strength = <2>;
			bias-disable;
		};
	};

	qup_spi1_default: qup-spi1-default-state {
		data-pins {
			pins = "gpio109", "gpio111", "gpio112";
			function = "qup0_se1";
			drive-strength = <6>;
			bias-disable;
		};

		cs-pins {
			pins = "gpio110";
			function = "qup0_se1";
			drive-strength = <2>;
			bias-disable;
		};
	};

	qup_spi2_default: qup-spi2-default-state {
		data-pins {
			pins = "gpio113", "gpio114", "gpio115";
			function = "qup0_se2";
			drive-strength = <6>;
			bias-disable;
		};

		cs-pins {
			pins = "gpio116";
			function = "qup0_se2";
			drive-strength = <2>;
			bias-disable;
		};
	};

	qup_spi3_default: qup-spi3-default-state {
		data-pins {
			pins = "gpio113", "gpio115", "gpio116";
			function = "qup0_se3";
			drive-strength = <6>;
			bias-disable;
		};

		cs-pins {
			pins = "gpio114";
			function = "qup0_se3";
			drive-strength = <2>;
			bias-disable;
		};
	};

	qup_spi4_default: qup-spi4-default-state {
		data-pins {
			pins = "gpio117", "gpio118", "gpio119";
			function = "qup0_se4";
			drive-strength = <6>;
			bias-disable;
		};

		cs-pins {
			pins = "gpio120";
			function = "qup0_se4";
			drive-strength = <2>;
			bias-disable;
		};
	};

	qup_spi5_default: qup-spi5-default-state {
		data-pins {
			pins = "gpio109", "gpio121", "gpio122";
			function = "qup0_se5";
			drive-strength = <6>;
			bias-disable;
		};

		cs-pins {
			pins = "gpio110";
			function = "qup0_se5";
			drive-strength = <2>;
			bias-disable;
		};
	};

	qup_spi7_default: qup-spi7-default-state {
		data-pins {
			pins = "gpio123", "gpio124", "gpio125";
			function = "qup1_se0";
			drive-strength = <6>;
			bias-disable;
		};

		cs-pins {
			pins = "gpio126";
			function = "qup1_se0";
			drive-strength = <2>;
			bias-disable;
		};
	};

	qup_spi8_default: qup-spi8-default-state {
		data-pins {
			pins = "gpio123", "gpio125", "gpio126";
			function = "qup1_se1";
			drive-strength = <6>;
			bias-disable;
		};

		cs-pins {
			pins = "gpio124";
			function = "qup1_se1";
			drive-strength = <2>;
			bias-disable;
		};
	};

	qup_spi11_default: qup-spi11-default-state {
		data-pins {
			pins = "gpio131", "gpio132", "gpio137";
			function = "qup1_se4";
			drive-strength = <6>;
			bias-disable;
		};

		cs-pins {
			pins = "gpio138";
			function = "qup1_se4";
			drive-strength = <2>;
			bias-disable;
		};
	};

	qup_spi12_default: qup-spi12-default-state {
		data-pins {
			pins = "gpio133", "gpio134", "gpio135";
			function = "qup1_se5";
			drive-strength = <6>;
			bias-disable;
		};

		cs-pins {
			pins = "gpio136";
			function = "qup1_se5";
			drive-strength = <2>;
			bias-disable;
		};
	};

	qup_spi13_default: qup-spi13-default-state {
		data-pins {
			pins = "gpio131", "gpio137", "gpio138";
			function = "qup1_se6";
			drive-strength = <6>;
			bias-disable;
		};

		cs-pins {
			pins = "gpio132";
			function = "qup1_se6";
			drive-strength = <2>;
			bias-disable;
		};
	};

	qup_spi14_default: qup-spi14-default-state {
		data-pins {
			pins = "gpio139", "gpio140", "gpio141";
			function = "qup2_se0";
			drive-strength = <6>;
			bias-disable;
		};

		cs-pins {
			pins = "gpio142";
			function = "qup2_se0";
			drive-strength = <2>;
			bias-disable;
		};
	};

	qup_spi16_default: qup-spi16-default-state {
		data-pins {
			pins = "gpio145", "gpio146", "gpio147";
			function = "qup2_se2";
			drive-strength = <6>;
			bias-disable;
		};

		cs-pins {
			pins = "gpio148";
			function = "qup2_se2";
			drive-strength = <2>;
			bias-disable;
		};
	};

	qup_spi17_default: qup-spi17-default-state {
		data-pins {
			pins = "gpio150", "gpio151", "gpio152";
			function = "qup2_se3";
			drive-strength = <6>;
			bias-disable;
		};

		cs-pins {
			pins = "gpio153";
			function = "qup2_se3";
			drive-strength = <2>;
			bias-disable;
		};
	};

	qup_spi18_default: qup-spi18-default-state {
		data-pins {
			pins = "gpio143", "gpio154", "gpio155";
			function = "qup2_se4";
			drive-strength = <6>;
			bias-disable;
		};

		cs-pins {
			pins = "gpio144";
			function = "qup2_se4";
			drive-strength = <2>;
			bias-disable;
		};
	};

	qup_spi19_default: qup-spi19-default-state {
		data-pins {
			pins = "gpio156", "gpio157", "gpio158";
			function = "qup2_se5";
			drive-strength = <6>;
			bias-disable;
		};

		cs-pins {
			pins = "gpio159";
			function = "qup2_se5";
			drive-strength = <2>;
			bias-disable;
		};
	};

	qup_spi20_default: qup-spi20-default-state {
		data-pins {
			pins = "gpio156", "gpio158", "gpio159";
			function = "qup2_se6";
			drive-strength = <6>;
			bias-disable;
		};

		cs-pins {
			pins = "gpio157";
			function = "qup2_se6";
			drive-strength = <2>;
			bias-disable;
		};
	};

	qup_uart0_default: qup-uart0-default-state {
		pins = "gpio109", "gpio110";
		function = "qup0_se0";
		drive-strength = <2>;
		bias-disable;
	};

	qup_uart1_default: qup-uart1-default-state {
		pins = "gpio109", "gpio110";
		function = "qup0_se1";
		drive-strength = <2>;
		bias-disable;
	};

	qup_uart2_default: qup-uart2-default-state {
		pins = "gpio115", "gpio116";
		function = "qup0_se2";
		drive-strength = <2>;
		bias-disable;
	};

	qup_uart3_default: qup-uart3-default-state {
		pins = "gpio113", "gpio114";
		function = "qup0_se3";
		drive-strength = <2>;
		bias-disable;
	};

	qup_uart4_default: qup-uart4-default-state {
		pins = "gpio119", "gpio120";
		function = "qup0_se4";
		drive-strength = <2>;
		bias-disable;
	};

	qup_uart5_default: qup-uart5-default-state {
		pins = "gpio109", "gpio110";
		function = "qup0_se5";
		drive-strength = <2>;
		bias-disable;
	};

	qup_uart7_default: qup-uart7-default-state {
		pins = "gpio125", "gpio126";
		function = "qup1_se0";
		drive-strength = <2>;
		bias-disable;
	};

	qup_uart8_default: qup-uart8-default-state {
		pins = "gpio123", "gpio124";
		function = "qup1_se1";
		drive-strength = <2>;
		bias-disable;
	};

	qup_uart9_default: qup-uart9-default-state {
		pins = "gpio127", "gpio128";
		function = "qup1_se2_23";
		drive-strength = <2>;
		bias-disable;
	};

	qup_uart10_default: qup-uart10-default-state {
		pins = "gpio129", "gpio130";
		function = "qup1_se3_23";
		drive-strength = <2>;
		bias-disable;
	};

	qup_uart11_default: qup-uart11-default-state {
		pins = "gpio137", "gpio138";
		function = "qup1_se4";
		drive-strength = <2>;
		bias-disable;
	};

	qup_uart12_default: qup-uart12-default-state {
		pins = "gpio135", "gpio136";
		function = "qup1_se5";
		drive-strength = <2>;
		bias-disable;
	};

	qup_uart13_default: qup-uart13-default-state {
		pins = "gpio131", "gpio132";
		function = "qup1_se6";
		drive-strength = <2>;
		bias-disable;
	};

	qup_uart14_default: qup-uart14-default-state {
		pins = "gpio141", "gpio142";
		function = "qup2_se0";
		drive-strength = <2>;
		bias-disable;
	};

	qup_uart15_default: qup-uart15-default-state {
		pins = "gpio143", "gpio144";
		function = "qup2_se1";
		drive-strength = <2>;
		bias-disable;
	};

	qup_uart16_default: qup-uart16-default-state {
		pins = "gpio147", "gpio148";
		function = "qup2_se2";
		drive-strength = <2>;
		bias-disable;
	};

	qup_uart17_default: qup-uart17-default-state {
		pins = "gpio150", "gpio151", "gpio152", "gpio153";
		function = "qup2_se3";
		drive-strength = <2>;
		bias-disable;
	};

	qup_uart18_default: qup-uart18-default-state {
		pins = "gpio143", "gpio144";
		function = "qup2_se4";
		drive-strength = <2>;
		bias-disable;
	};

	qup_uart19_default: qup-uart19-default-state {
		pins = "gpio158", "gpio159";
		function = "qup2_se5";
		drive-strength = <2>;
		bias-disable;
	};

	qup_uart20_default: qup-uart20-default-state {
		pins = "gpio156", "gpio157";
		function = "qup2_se6";
		drive-strength = <2>;
		bias-disable;
	};
};

&uart0 {
	clocks = <&segcc SE_GCC_QUPV3_WRAP0_S0_CLK>;
	clock-names = "se";
	interconnects = <&clk_virt MASTER_QUP_CORE_0 QCOM_ICC_TAG_ALWAYS
			 &clk_virt SLAVE_QUP_CORE_0 QCOM_ICC_TAG_ALWAYS>,
			<&hscnoc MASTER_APPSS_PROC QCOM_ICC_TAG_ALWAYS
			 &config_noc SLAVE_QUP_0 QCOM_ICC_TAG_ALWAYS>;
	interconnect-names = "qup-core",
			     "qup-config";
	pinctrl-0 = <&qup_uart0_default>;
	pinctrl-names = "default";
};

&uart1 {
	clocks = <&segcc SE_GCC_QUPV3_WRAP0_S1_CLK>;
	clock-names = "se";
	interconnects = <&clk_virt MASTER_QUP_CORE_0 QCOM_ICC_TAG_ALWAYS
			 &clk_virt SLAVE_QUP_CORE_0 QCOM_ICC_TAG_ALWAYS>,
			<&hscnoc MASTER_APPSS_PROC QCOM_ICC_TAG_ALWAYS
			 &config_noc SLAVE_QUP_0 QCOM_ICC_TAG_ALWAYS>;
	interconnect-names = "qup-core",
			     "qup-config";
	pinctrl-0 = <&qup_uart1_default>;
	pinctrl-names = "default";
};

&uart2 {
	clocks = <&segcc SE_GCC_QUPV3_WRAP0_S2_CLK>;
	clock-names = "se";
	interconnects = <&clk_virt MASTER_QUP_CORE_0 QCOM_ICC_TAG_ALWAYS
			 &clk_virt SLAVE_QUP_CORE_0 QCOM_ICC_TAG_ALWAYS>,
			<&hscnoc MASTER_APPSS_PROC QCOM_ICC_TAG_ALWAYS
			 &config_noc SLAVE_QUP_0 QCOM_ICC_TAG_ALWAYS>;
	interconnect-names = "qup-core",
			     "qup-config";
	pinctrl-0 = <&qup_uart2_default>;
	pinctrl-names = "default";
};

&uart3 {
	clocks = <&segcc SE_GCC_QUPV3_WRAP0_S3_CLK>;
	clock-names = "se";
	interconnects = <&clk_virt MASTER_QUP_CORE_0 QCOM_ICC_TAG_ALWAYS
			 &clk_virt SLAVE_QUP_CORE_0 QCOM_ICC_TAG_ALWAYS>,
			<&hscnoc MASTER_APPSS_PROC QCOM_ICC_TAG_ALWAYS
			 &config_noc SLAVE_QUP_0 QCOM_ICC_TAG_ALWAYS>;
	interconnect-names = "qup-core",
			     "qup-config";
	pinctrl-0 = <&qup_uart3_default>;
	pinctrl-names = "default";
};

&uart4 {
	clocks = <&segcc SE_GCC_QUPV3_WRAP0_S4_CLK>;
	clock-names = "se";
	interconnects = <&clk_virt MASTER_QUP_CORE_0 QCOM_ICC_TAG_ALWAYS
			 &clk_virt SLAVE_QUP_CORE_0 QCOM_ICC_TAG_ALWAYS>,
			<&hscnoc MASTER_APPSS_PROC QCOM_ICC_TAG_ALWAYS
			 &config_noc SLAVE_QUP_0 QCOM_ICC_TAG_ALWAYS>;
	interconnect-names = "qup-core",
			     "qup-config";
	pinctrl-0 = <&qup_uart4_default>;
	pinctrl-names = "default";
};

&uart5 {
	clocks = <&segcc SE_GCC_QUPV3_WRAP0_S5_CLK>;
	clock-names = "se";
	interconnects = <&clk_virt MASTER_QUP_CORE_0 QCOM_ICC_TAG_ALWAYS
			 &clk_virt SLAVE_QUP_CORE_0 QCOM_ICC_TAG_ALWAYS>,
			<&hscnoc MASTER_APPSS_PROC QCOM_ICC_TAG_ALWAYS
			 &config_noc SLAVE_QUP_0 QCOM_ICC_TAG_ALWAYS>;
	interconnect-names = "qup-core",
			     "qup-config";
	pinctrl-0 = <&qup_uart5_default>;
	pinctrl-names = "default";
};

&uart7 {
	clocks = <&segcc SE_GCC_QUPV3_WRAP1_S0_CLK>;
	clock-names = "se";
	interconnects = <&clk_virt MASTER_QUP_CORE_1 QCOM_ICC_TAG_ALWAYS
			 &clk_virt SLAVE_QUP_CORE_1 QCOM_ICC_TAG_ALWAYS>,
			<&hscnoc MASTER_APPSS_PROC QCOM_ICC_TAG_ALWAYS
			 &config_noc SLAVE_QUP_1 QCOM_ICC_TAG_ALWAYS>;
	interconnect-names = "qup-core",
			     "qup-config";
	pinctrl-0 = <&qup_uart7_default>;
	pinctrl-names = "default";
};

&uart8 {
	clocks = <&segcc SE_GCC_QUPV3_WRAP1_S1_CLK>;
	clock-names = "se";
	interconnects = <&clk_virt MASTER_QUP_CORE_1 QCOM_ICC_TAG_ALWAYS
			 &clk_virt SLAVE_QUP_CORE_1 QCOM_ICC_TAG_ALWAYS>,
			<&hscnoc MASTER_APPSS_PROC QCOM_ICC_TAG_ALWAYS
			 &config_noc SLAVE_QUP_1 QCOM_ICC_TAG_ALWAYS>;
	interconnect-names = "qup-core",
			     "qup-config";
	pinctrl-0 = <&qup_uart8_default>;
	pinctrl-names = "default";
};

&uart9 {
	clocks = <&segcc SE_GCC_QUPV3_WRAP1_S2_CLK>;
	clock-names = "se";
	interconnects = <&clk_virt MASTER_QUP_CORE_1 QCOM_ICC_TAG_ALWAYS
			 &clk_virt SLAVE_QUP_CORE_1 QCOM_ICC_TAG_ALWAYS>,
			<&hscnoc MASTER_APPSS_PROC QCOM_ICC_TAG_ALWAYS
			 &config_noc SLAVE_QUP_1 QCOM_ICC_TAG_ALWAYS>;
	interconnect-names = "qup-core",
			     "qup-config";
	pinctrl-0 = <&qup_uart9_default>;
	pinctrl-names = "default";
};

&uart10 {
	clocks = <&segcc SE_GCC_QUPV3_WRAP1_S3_CLK>;
	clock-names = "se";
	interconnects = <&clk_virt MASTER_QUP_CORE_1 QCOM_ICC_TAG_ALWAYS
			 &clk_virt SLAVE_QUP_CORE_1 QCOM_ICC_TAG_ALWAYS>,
			<&hscnoc MASTER_APPSS_PROC QCOM_ICC_TAG_ALWAYS
			 &config_noc SLAVE_QUP_1 QCOM_ICC_TAG_ALWAYS>;
	interconnect-names = "qup-core",
			     "qup-config";
	pinctrl-0 = <&qup_uart10_default>;
	pinctrl-names = "default";
};

&uart11 {
	clocks = <&segcc SE_GCC_QUPV3_WRAP1_S4_CLK>;
	clock-names = "se";
	interconnects = <&clk_virt MASTER_QUP_CORE_1 QCOM_ICC_TAG_ALWAYS
			 &clk_virt SLAVE_QUP_CORE_1 QCOM_ICC_TAG_ALWAYS>,
			<&hscnoc MASTER_APPSS_PROC QCOM_ICC_TAG_ALWAYS
			 &config_noc SLAVE_QUP_1 QCOM_ICC_TAG_ALWAYS>;
	interconnect-names = "qup-core",
			     "qup-config";
	pinctrl-0 = <&qup_uart11_default>;
	pinctrl-names = "default";
};

&uart12 {
	clocks = <&segcc SE_GCC_QUPV3_WRAP1_S5_CLK>;
	clock-names = "se";
	interconnects = <&clk_virt MASTER_QUP_CORE_1 QCOM_ICC_TAG_ALWAYS
			 &clk_virt SLAVE_QUP_CORE_1 QCOM_ICC_TAG_ALWAYS>,
			<&hscnoc MASTER_APPSS_PROC QCOM_ICC_TAG_ALWAYS
			 &config_noc SLAVE_QUP_1 QCOM_ICC_TAG_ALWAYS>;
	interconnect-names = "qup-core",
			     "qup-config";
	pinctrl-0 = <&qup_uart12_default>;
	pinctrl-names = "default";
};

&uart13 {
	clocks = <&segcc SE_GCC_QUPV3_WRAP1_S6_CLK>;
	clock-names = "se";
	interconnects = <&clk_virt MASTER_QUP_CORE_1 QCOM_ICC_TAG_ALWAYS
			 &clk_virt SLAVE_QUP_CORE_1 QCOM_ICC_TAG_ALWAYS>,
			<&hscnoc MASTER_APPSS_PROC QCOM_ICC_TAG_ALWAYS
			 &config_noc SLAVE_QUP_1 QCOM_ICC_TAG_ALWAYS>;
	interconnect-names = "qup-core",
			     "qup-config";
	pinctrl-0 = <&qup_uart13_default>;
	pinctrl-names = "default";
};

&uart14 {
	clocks = <&negcc NE_GCC_QUPV3_WRAP2_S0_CLK>;
	clock-names = "se";
	interconnects = <&clk_virt MASTER_QUP_CORE_2 QCOM_ICC_TAG_ALWAYS
			 &clk_virt SLAVE_QUP_CORE_2 QCOM_ICC_TAG_ALWAYS>,
			<&hscnoc MASTER_APPSS_PROC QCOM_ICC_TAG_ALWAYS
			 &config_noc SLAVE_QUP_2 QCOM_ICC_TAG_ALWAYS>;
	interconnect-names = "qup-core",
			     "qup-config";
	pinctrl-0 = <&qup_uart14_default>;
	pinctrl-names = "default";
};

&uart15 {
	clocks = <&negcc NE_GCC_QUPV3_WRAP2_S1_CLK>;
	clock-names = "se";
	interconnects = <&clk_virt MASTER_QUP_CORE_2 QCOM_ICC_TAG_ALWAYS
			 &clk_virt SLAVE_QUP_CORE_2 QCOM_ICC_TAG_ALWAYS>,
			<&hscnoc MASTER_APPSS_PROC QCOM_ICC_TAG_ALWAYS
			 &config_noc SLAVE_QUP_2 QCOM_ICC_TAG_ALWAYS>;
	interconnect-names = "qup-core",
			     "qup-config";
	pinctrl-0 = <&qup_uart15_default>;
	pinctrl-names = "default";
};

&uart16 {
	clocks = <&negcc NE_GCC_QUPV3_WRAP2_S2_CLK>;
	clock-names = "se";
	interconnects = <&clk_virt MASTER_QUP_CORE_2 QCOM_ICC_TAG_ALWAYS
			 &clk_virt SLAVE_QUP_CORE_2 QCOM_ICC_TAG_ALWAYS>,
			<&hscnoc MASTER_APPSS_PROC QCOM_ICC_TAG_ALWAYS
			 &config_noc SLAVE_QUP_2 QCOM_ICC_TAG_ALWAYS>;
	interconnect-names = "qup-core",
			     "qup-config";
	pinctrl-0 = <&qup_uart16_default>;
	pinctrl-names = "default";
};

&uart17 {
	clocks = <&negcc NE_GCC_QUPV3_WRAP2_S3_CLK>;
	clock-names = "se";
	interconnects = <&clk_virt MASTER_QUP_CORE_2 QCOM_ICC_TAG_ALWAYS
			 &clk_virt SLAVE_QUP_CORE_2 QCOM_ICC_TAG_ALWAYS>,
			<&hscnoc MASTER_APPSS_PROC QCOM_ICC_TAG_ALWAYS
			 &config_noc SLAVE_QUP_2 QCOM_ICC_TAG_ALWAYS>;
	interconnect-names = "qup-core",
			     "qup-config";
	pinctrl-0 = <&qup_uart17_default>;
	pinctrl-names = "default";
};

&uart18 {
	clocks = <&negcc NE_GCC_QUPV3_WRAP2_S4_CLK>;
	clock-names = "se";
	interconnects = <&clk_virt MASTER_QUP_CORE_2 QCOM_ICC_TAG_ALWAYS
			 &clk_virt SLAVE_QUP_CORE_2 QCOM_ICC_TAG_ALWAYS>,
			<&hscnoc MASTER_APPSS_PROC QCOM_ICC_TAG_ALWAYS
			 &config_noc SLAVE_QUP_2 QCOM_ICC_TAG_ALWAYS>;
	interconnect-names = "qup-core",
			     "qup-config";
	pinctrl-0 = <&qup_uart18_default>;
	pinctrl-names = "default";
};

&uart19 {
	clocks = <&negcc NE_GCC_QUPV3_WRAP2_S5_CLK>;
	clock-names = "se";
	interconnects = <&clk_virt MASTER_QUP_CORE_2 QCOM_ICC_TAG_ALWAYS
			 &clk_virt SLAVE_QUP_CORE_2 QCOM_ICC_TAG_ALWAYS>,
			<&hscnoc MASTER_APPSS_PROC QCOM_ICC_TAG_ALWAYS
			 &config_noc SLAVE_QUP_2 QCOM_ICC_TAG_ALWAYS>;
	interconnect-names = "qup-core",
			     "qup-config";
	pinctrl-0 = <&qup_uart19_default>;
	pinctrl-names = "default";
};

&uart20 {
	clocks = <&negcc NE_GCC_QUPV3_WRAP2_S6_CLK>;
	clock-names = "se";
	interconnects = <&clk_virt MASTER_QUP_CORE_2 QCOM_ICC_TAG_ALWAYS
			 &clk_virt SLAVE_QUP_CORE_2 QCOM_ICC_TAG_ALWAYS>,
			<&hscnoc MASTER_APPSS_PROC QCOM_ICC_TAG_ALWAYS
			 &config_noc SLAVE_QUP_2 QCOM_ICC_TAG_ALWAYS>;
	interconnect-names = "qup-core",
			     "qup-config";
	pinctrl-0 = <&qup_uart20_default>;
	pinctrl-names = "default";
};

&ufs_mem_hc {
	clocks = <&negcc NE_GCC_UFS_PHY_AXI_CLK>,
		 <&negcc NE_GCC_AGGRE_NOC_UFS_PHY_AXI_CLK>,
		 <&negcc NE_GCC_UFS_PHY_AHB_CLK>,
		 <&negcc NE_GCC_UFS_PHY_UNIPRO_CORE_CLK>,
		 <&tcsrcc TCSR_UFS_CLKREF_EN>,
		 <&negcc NE_GCC_UFS_PHY_TX_SYMBOL_0_CLK>,
		 <&negcc NE_GCC_UFS_PHY_RX_SYMBOL_0_CLK>,
		 <&negcc NE_GCC_UFS_PHY_RX_SYMBOL_1_CLK>;
	clock-names = "core_clk",
		      "bus_aggr_clk",
		      "iface_clk",
		      "core_clk_unipro",
		      "ref_clk",
		      "tx_lane0_sync_clk",
		      "rx_lane0_sync_clk",
		      "rx_lane1_sync_clk";

	resets = <&negcc NE_GCC_UFS_PHY_BCR>;
	reset-names = "rst";

	interconnects = <&aggre1_noc_tile MASTER_UFS_MEM QCOM_ICC_TAG_ALWAYS
			 &mc_virt SLAVE_EBI1 QCOM_ICC_TAG_ALWAYS>,
			<&hscnoc MASTER_APPSS_PROC QCOM_ICC_TAG_ACTIVE_ONLY
			 &config_noc SLAVE_UFS_MEM_CFG QCOM_ICC_TAG_ACTIVE_ONLY>;
	interconnect-names = "ufs-ddr",
			     "cpu-ufs";

	phys = <&ufs_mem_phy>;
	phy-names = "ufsphy";

	power-domains = <&negcc NE_GCC_UFS_PHY_GDSC>;
	operating-points-v2 = <&ufs_opp_table>;
	required-opps = <&rpmhpd_opp_nom>;
	qcom,ice = <&ice>;
	#reset-cells = <1>;

	ufs_opp_table: opp-table {
		compatible = "operating-points-v2";

		opp-100000000 {
			opp-hz = /bits/ 64 <100000000>,
				 /bits/ 64 <0>,
				 /bits/ 64 <0>,
				 /bits/ 64 <100000000>,
				 /bits/ 64 <0>,
				 /bits/ 64 <0>,
				 /bits/ 64 <0>,
				 /bits/ 64 <0>;
			required-opps = <&rpmhpd_opp_low_svs>;
		};

		opp-201500000 {
			opp-hz = /bits/ 64 <201500000>,
				 /bits/ 64 <0>,
				 /bits/ 64 <0>,
				 /bits/ 64 <201500000>,
				 /bits/ 64 <0>,
				 /bits/ 64 <0>,
				 /bits/ 64 <0>,
				 /bits/ 64 <0>;
			required-opps = <&rpmhpd_opp_svs>;
		};

		opp-403000000 {
			opp-hz = /bits/ 64 <403000000>,
				 /bits/ 64 <0>,
				 /bits/ 64 <0>,
				 /bits/ 64 <403000000>,
				 /bits/ 64 <0>,
				 /bits/ 64 <0>,
				 /bits/ 64 <0>,
				 /bits/ 64 <0>;
			required-opps = <&rpmhpd_opp_nom>;
		};
	};
};

&usb_0 {
	clocks = <&negcc NE_GCC_CNOC_USB3_PRIM_AXI_CLK>,
		 <&negcc NE_GCC_USB31_PRIM_MASTER_CLK>,
		 <&negcc NE_GCC_AGGRE_NOC_USB3_PRIM_AXI_CLK>,
		 <&negcc NE_GCC_USB31_PRIM_SLEEP_CLK>,
		 <&negcc NE_GCC_USB31_PRIM_MOCK_UTMI_CLK>,
		 <&tcsrcc TCSR_USB3_0_CLKREF_EN>;
	clock-names = "cfg_noc",
		      "core",
		      "iface",
		      "sleep",
		      "mock_utmi",
		      "xo";

	assigned-clocks = <&negcc NE_GCC_USB31_PRIM_MOCK_UTMI_CLK>,
			  <&negcc NE_GCC_USB31_PRIM_MASTER_CLK>;
	assigned-clock-rates = <19200000>, <200000000>;

	power-domains = <&negcc NE_GCC_USB31_PRIM_GDSC>;
	required-opps = <&rpmhpd_opp_nom>;

	resets = <&negcc NE_GCC_USB31_PRIM_BCR>;

	interconnects = <&aggre1_noc_tile MASTER_USB3_0 QCOM_ICC_TAG_ALWAYS
			 &mc_virt SLAVE_EBI1 QCOM_ICC_TAG_ALWAYS>,
			<&hscnoc MASTER_APPSS_PROC QCOM_ICC_TAG_ALWAYS
			 &config_noc SLAVE_USB3_0 QCOM_ICC_TAG_ALWAYS>;
	interconnect-names = "usb-ddr",
			     "apps-usb";

	phys = <&usb_0_hsphy>,
	       <&usb_0_qmpphy QMP_USB43DP_USB3_PHY>;
	phy-names = "usb2-phy",
		    "usb3-phy";

	ports {
		#address-cells = <1>;
		#size-cells = <0>;

		port@0 {
			reg = <0>;

			usb_0_dwc3_hs: endpoint {
			};
		};

		port@1 {
			reg = <1>;

			usb_0_dwc3_ss: endpoint {
				remote-endpoint = <&usb_0_qmpphy_usb_ss_in>;
			};
		};
	};
};

&usb_1 {
	clocks = <&negcc NE_GCC_CNOC_USB3_SEC_AXI_CLK>,
		 <&negcc NE_GCC_USB31_SEC_MASTER_CLK>,
		 <&negcc NE_GCC_AGGRE_NOC_USB3_SEC_AXI_CLK>,
		 <&negcc NE_GCC_USB31_SEC_SLEEP_CLK>,
		 <&negcc NE_GCC_USB31_SEC_MOCK_UTMI_CLK>,
		 <&tcsrcc TCSR_USB3_1_CLKREF_EN>;
	clock-names = "cfg_noc",
		      "core",
		      "iface",
		      "sleep",
		      "mock_utmi",
		      "xo";

	assigned-clocks = <&negcc NE_GCC_USB31_SEC_MOCK_UTMI_CLK>,
			  <&negcc NE_GCC_USB31_SEC_MASTER_CLK>;
	assigned-clock-rates = <19200000>, <200000000>;

	power-domains = <&negcc NE_GCC_USB31_SEC_GDSC>;
	required-opps = <&rpmhpd_opp_nom>;

	resets = <&negcc NE_GCC_USB31_SEC_BCR>;

	interconnects = <&aggre1_noc_tile MASTER_USB3_1 QCOM_ICC_TAG_ALWAYS
			 &mc_virt SLAVE_EBI1 QCOM_ICC_TAG_ALWAYS>,
			<&hscnoc MASTER_APPSS_PROC QCOM_ICC_TAG_ALWAYS
			 &config_noc SLAVE_USB3_1 QCOM_ICC_TAG_ALWAYS>;
	interconnect-names = "usb-ddr",
			     "apps-usb";

	phys = <&usb_1_hsphy>,
	       <&usb_1_qmpphy QMP_USB43DP_USB3_PHY>;
	phy-names = "usb2-phy",
		    "usb3-phy";

	ports {
		#address-cells = <1>;
		#size-cells = <0>;

		port@0 {
			reg = <0>;

			usb_1_dwc3_hs: endpoint {
			};
		};

		port@1 {
			reg = <1>;

			usb_1_dwc3_ss: endpoint {
				remote-endpoint = <&usb_1_qmpphy_usb_ss_in>;
			};
		};
	};
};

&usb_2 {
	clocks = <&negcc NE_GCC_CNOC_USB2_AXI_CLK>,
		 <&negcc NE_GCC_USB20_MASTER_CLK>,
		 <&negcc NE_GCC_AGGRE_NOC_USB2_AXI_CLK>,
		 <&negcc NE_GCC_USB20_SLEEP_CLK>,
		 <&negcc NE_GCC_USB20_MOCK_UTMI_CLK>,
		 <&tcsrcc TCSR_USB2_2_CLKREF_EN>;
	clock-names = "cfg_noc",
		      "core",
		      "iface",
		      "sleep",
		      "mock_utmi",
		      "xo";

	assigned-clocks = <&negcc NE_GCC_USB20_MOCK_UTMI_CLK>,
			  <&negcc NE_GCC_USB20_MASTER_CLK>;
	assigned-clock-rates = <19200000>, <120000000>;

	power-domains = <&negcc NE_GCC_USB20_PRIM_GDSC>;
	required-opps = <&rpmhpd_opp_nom>;

	resets = <&negcc NE_GCC_USB20_PRIM_BCR>;

	interconnects = <&aggre1_noc_tile MASTER_USB2 QCOM_ICC_TAG_ALWAYS
			 &mc_virt SLAVE_EBI1 QCOM_ICC_TAG_ALWAYS>,
			<&hscnoc MASTER_APPSS_PROC QCOM_ICC_TAG_ALWAYS
			 &config_noc SLAVE_USB2 QCOM_ICC_TAG_ALWAYS>;
	interconnect-names = "usb-ddr",
			     "apps-usb";

	phys = <&usb_2_hsphy>;
	phy-names = "usb2-phy";

	maximum-speed = "high-speed";
	qcom,select-utmi-as-pipe-clk;
};
